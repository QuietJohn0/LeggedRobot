/******************************************************************************
* ASAP2 file: CAN_2_Legs.a2l
* Academic License - for use in teaching, academic research, and meeting
* course requirements at degree granting institutions only. Not for
* government, commercial, or other organizational use.
* Code generation for model "CAN_2_Legs".
* Model version : 1.5
* Simulink Coder version : 10.3 R2021a
* C source code generated on : Mon Aug 23 14:12:36 2021
* Target selection: slrealtime.tlc
* Embedded hardware selection: Intel->x86-64 (Linux 64)
* Code generation objectives: Unspecified
* Validation result: Not run
* (add additional file header information here)
******************************************************************************/ ASAP2_VERSION 1 71
/begin PROJECT ProjectName "Project Comment Goes Here"
/begin HEADER "Header Comments go here" /end HEADER
/begin MODULE ModuleName "Module Comment Goes Here"
/begin IF_DATA XCP
 /begin PROTOCOL_LAYER 0x0100 0x03E8 0x00C8 0x0000 0x0000 0x0000 0x0000 0x0000 0xFC 0x0578 BYTE_ORDER_MSB_LAST ADDRESS_GRANULARITY_BYTE OPTIONAL_CMD ALLOC_ODT_ENTRY OPTIONAL_CMD ALLOC_ODT OPTIONAL_CMD ALLOC_DAQ OPTIONAL_CMD FREE_DAQ OPTIONAL_CMD GET_DAQ_RESOLUTION_INFO OPTIONAL_CMD GET_DAQ_PROCESSOR_INFO OPTIONAL_CMD START_STOP_SYNCH OPTIONAL_CMD START_STOP_DAQ_LIST OPTIONAL_CMD SET_DAQ_LIST_MODE OPTIONAL_CMD WRITE_DAQ OPTIONAL_CMD SET_DAQ_PTR OPTIONAL_CMD GET_CAL_PAGE OPTIONAL_CMD SET_CAL_PAGE OPTIONAL_CMD COPY_CAL_PAGE OPTIONAL_CMD SHORT_DOWNLOAD OPTIONAL_CMD DOWNLOAD_MAX OPTIONAL_CMD DOWNLOAD OPTIONAL_CMD SHORT_UPLOAD OPTIONAL_CMD UPLOAD OPTIONAL_CMD SET_MTA /end PROTOCOL_LAYER
 /begin DAQ DYNAMIC 0x0000 0x0080 0x00 OPTIMISATION_TYPE_DEFAULT ADDRESS_EXTENSION_FREE IDENTIFICATION_FIELD_TYPE_RELATIVE_WORD_ALIGNED GRANULARITY_ODT_ENTRY_SIZE_DAQ_BYTE 0xFF OVERLOAD_INDICATION_PID PRESCALER_SUPPORTED /begin STIM GRANULARITY_ODT_ENTRY_SIZE_STIM_BYTE 0xFF /end STIM /begin TIMESTAMP_SUPPORTED 0x0001 SIZE_DWORD UNIT_1US TIMESTAMP_FIXED /end TIMESTAMP_SUPPORTED /begin EVENT "100 ms" "100 ms" 0x0000 DAQ 0xFF 0x01 0x08 0x00 /end EVENT /end DAQ
 /begin XCP_ON_UDP_IP 0x0100 0x15B3 ADDRESS "192.168.7.5" /end XCP_ON_UDP_IP
/end IF_DATA
/begin MOD_PAR "MOD PAR Comment Goes Here"
 /begin MEMORY_SEGMENT CAN_2_Legs_cal_impl "CAN_2_Legs_cal_impl" DATA FLASH INTERN 0x00217020 0x6A0 -1 -1 -1 -1 -1
  /begin IF_DATA XCP
   /begin SEGMENT 0x00 0x02 0x00 0x00 0x00
    /begin PAGE 0x00 ECU_ACCESS_DONT_CARE XCP_READ_ACCESS_DONT_CARE XCP_WRITE_ACCESS_NOT_ALLOWED /end PAGE
    /begin PAGE 0x01 ECU_ACCESS_DONT_CARE XCP_READ_ACCESS_DONT_CARE XCP_WRITE_ACCESS_DONT_CARE /end PAGE
   /end SEGMENT
  /end IF_DATA
 /end MEMORY_SEGMENT
/end MOD_PAR
/begin MOD_COMMON "Mod Common Comment Here" BYTE_ORDER MSB_LAST ALIGNMENT_BYTE 1 ALIGNMENT_WORD 2 ALIGNMENT_LONG 8 ALIGNMENT_FLOAT32_IEEE 4 ALIGNMENT_FLOAT64_IEEE 8 ALIGNMENT_INT64 4 /end MOD_COMMON
/begin CHARACTERISTIC CAN_2_Legs_cal_impl.CANRead_P1 "" VAL_BLK 0x00217050 Scalar_FLOAT64_IEEE 0 CAN_2_Legs_CM_double -1.7E+308 1.7E+308 MATRIX_DIM 6 1 /end CHARACTERISTIC
/begin CHARACTERISTIC CAN_2_Legs_cal_impl.CANRead_P1_o "" VAL_BLK 0x00217100 Scalar_FLOAT64_IEEE 0 CAN_2_Legs_CM_double -1.7E+308 1.7E+308 MATRIX_DIM 6 1 /end CHARACTERISTIC
/begin CHARACTERISTIC CAN_2_Legs_cal_impl.CANSetup_P1 "" VAL_BLK 0x00217188 Scalar_FLOAT64_IEEE 0 CAN_2_Legs_CM_double -1.7E+308 1.7E+308 MATRIX_DIM 40 1 /end CHARACTERISTIC
/begin CHARACTERISTIC CAN_2_Legs_cal_impl.CANSetup_P2 "" VALUE 0x002172D8 Scalar_FLOAT64_IEEE 0 CAN_2_Legs_CM_double -1.7E+308 1.7E+308 /end CHARACTERISTIC
/begin CHARACTERISTIC CAN_2_Legs_cal_impl.CANSetup_P3 "" VALUE 0x002172F0 Scalar_FLOAT64_IEEE 0 CAN_2_Legs_CM_double -1.7E+308 1.7E+308 /end CHARACTERISTIC
/begin CHARACTERISTIC CAN_2_Legs_cal_impl.CANStatus_P1 "" VALUE 0x00217368 Scalar_FLOAT64_IEEE 0 CAN_2_Legs_CM_double -1.7E+308 1.7E+308 /end CHARACTERISTIC
/begin CHARACTERISTIC CAN_2_Legs_cal_impl.CANStatus_P10 "" VALUE 0x00217440 Scalar_FLOAT64_IEEE 0 CAN_2_Legs_CM_double -1.7E+308 1.7E+308 /end CHARACTERISTIC
/begin CHARACTERISTIC CAN_2_Legs_cal_impl.CANStatus_P11 "" VALUE 0x00217458 Scalar_FLOAT64_IEEE 0 CAN_2_Legs_CM_double -1.7E+308 1.7E+308 /end CHARACTERISTIC
/begin CHARACTERISTIC CAN_2_Legs_cal_impl.CANStatus_P12 "" VALUE 0x00217470 Scalar_FLOAT64_IEEE 0 CAN_2_Legs_CM_double -1.7E+308 1.7E+308 /end CHARACTERISTIC
/begin CHARACTERISTIC CAN_2_Legs_cal_impl.CANStatus_P13 "" VALUE 0x00217488 Scalar_FLOAT64_IEEE 0 CAN_2_Legs_CM_double -1.7E+308 1.7E+308 /end CHARACTERISTIC
/begin CHARACTERISTIC CAN_2_Legs_cal_impl.CANStatus_P14 "" VALUE 0x002174A0 Scalar_FLOAT64_IEEE 0 CAN_2_Legs_CM_double -1.7E+308 1.7E+308 /end CHARACTERISTIC
/begin CHARACTERISTIC CAN_2_Legs_cal_impl.CANStatus_P15 "" VALUE 0x002174B8 Scalar_FLOAT64_IEEE 0 CAN_2_Legs_CM_double -1.7E+308 1.7E+308 /end CHARACTERISTIC
/begin CHARACTERISTIC CAN_2_Legs_cal_impl.CANStatus_P16 "" VALUE 0x002174D0 Scalar_FLOAT64_IEEE 0 CAN_2_Legs_CM_double -1.7E+308 1.7E+308 /end CHARACTERISTIC
/begin CHARACTERISTIC CAN_2_Legs_cal_impl.CANStatus_P17 "" VALUE 0x002174E8 Scalar_FLOAT64_IEEE 0 CAN_2_Legs_CM_double -1.7E+308 1.7E+308 /end CHARACTERISTIC
/begin CHARACTERISTIC CAN_2_Legs_cal_impl.CANStatus_P18 "" VALUE 0x00217500 Scalar_FLOAT64_IEEE 0 CAN_2_Legs_CM_double -1.7E+308 1.7E+308 /end CHARACTERISTIC
/begin CHARACTERISTIC CAN_2_Legs_cal_impl.CANStatus_P19 "" VALUE 0x00217518 Scalar_FLOAT64_IEEE 0 CAN_2_Legs_CM_double -1.7E+308 1.7E+308 /end CHARACTERISTIC
/begin CHARACTERISTIC CAN_2_Legs_cal_impl.CANStatus_P2 "" VALUE 0x00217380 Scalar_FLOAT64_IEEE 0 CAN_2_Legs_CM_double -1.7E+308 1.7E+308 /end CHARACTERISTIC
/begin CHARACTERISTIC CAN_2_Legs_cal_impl.CANStatus_P20 "" VALUE 0x00217530 Scalar_FLOAT64_IEEE 0 CAN_2_Legs_CM_double -1.7E+308 1.7E+308 /end CHARACTERISTIC
/begin CHARACTERISTIC CAN_2_Legs_cal_impl.CANStatus_P21 "" VALUE 0x00217548 Scalar_FLOAT64_IEEE 0 CAN_2_Legs_CM_double -1.7E+308 1.7E+308 /end CHARACTERISTIC
/begin CHARACTERISTIC CAN_2_Legs_cal_impl.CANStatus_P22 "" VALUE 0x00217560 Scalar_FLOAT64_IEEE 0 CAN_2_Legs_CM_double -1.7E+308 1.7E+308 /end CHARACTERISTIC
/begin CHARACTERISTIC CAN_2_Legs_cal_impl.CANStatus_P23 "" VALUE 0x00217578 Scalar_FLOAT64_IEEE 0 CAN_2_Legs_CM_double -1.7E+308 1.7E+308 /end CHARACTERISTIC
/begin CHARACTERISTIC CAN_2_Legs_cal_impl.CANStatus_P24 "" VALUE 0x00217590 Scalar_FLOAT64_IEEE 0 CAN_2_Legs_CM_double -1.7E+308 1.7E+308 /end CHARACTERISTIC
/begin CHARACTERISTIC CAN_2_Legs_cal_impl.CANStatus_P25 "" VALUE 0x002175A8 Scalar_FLOAT64_IEEE 0 CAN_2_Legs_CM_double -1.7E+308 1.7E+308 /end CHARACTERISTIC
/begin CHARACTERISTIC CAN_2_Legs_cal_impl.CANStatus_P26 "" VALUE 0x002175C0 Scalar_FLOAT64_IEEE 0 CAN_2_Legs_CM_double -1.7E+308 1.7E+308 /end CHARACTERISTIC
/begin CHARACTERISTIC CAN_2_Legs_cal_impl.CANStatus_P27 "" VALUE 0x002175D8 Scalar_FLOAT64_IEEE 0 CAN_2_Legs_CM_double -1.7E+308 1.7E+308 /end CHARACTERISTIC
/begin CHARACTERISTIC CAN_2_Legs_cal_impl.CANStatus_P28 "" VALUE 0x002175F0 Scalar_FLOAT64_IEEE 0 CAN_2_Legs_CM_double -1.7E+308 1.7E+308 /end CHARACTERISTIC
/begin CHARACTERISTIC CAN_2_Legs_cal_impl.CANStatus_P29 "" VALUE 0x00217608 Scalar_FLOAT64_IEEE 0 CAN_2_Legs_CM_double -1.7E+308 1.7E+308 /end CHARACTERISTIC
/begin CHARACTERISTIC CAN_2_Legs_cal_impl.CANStatus_P3 "" VALUE 0x00217398 Scalar_FLOAT64_IEEE 0 CAN_2_Legs_CM_double -1.7E+308 1.7E+308 /end CHARACTERISTIC
/begin CHARACTERISTIC CAN_2_Legs_cal_impl.CANStatus_P30 "" VALUE 0x00217620 Scalar_FLOAT64_IEEE 0 CAN_2_Legs_CM_double -1.7E+308 1.7E+308 /end CHARACTERISTIC
/begin CHARACTERISTIC CAN_2_Legs_cal_impl.CANStatus_P31 "" VALUE 0x00217638 Scalar_FLOAT64_IEEE 0 CAN_2_Legs_CM_double -1.7E+308 1.7E+308 /end CHARACTERISTIC
/begin CHARACTERISTIC CAN_2_Legs_cal_impl.CANStatus_P32 "" VALUE 0x00217650 Scalar_FLOAT64_IEEE 0 CAN_2_Legs_CM_double -1.7E+308 1.7E+308 /end CHARACTERISTIC
/begin CHARACTERISTIC CAN_2_Legs_cal_impl.CANStatus_P33 "" VALUE 0x00217668 Scalar_FLOAT64_IEEE 0 CAN_2_Legs_CM_double -1.7E+308 1.7E+308 /end CHARACTERISTIC
/begin CHARACTERISTIC CAN_2_Legs_cal_impl.CANStatus_P34 "" VALUE 0x00217680 Scalar_FLOAT64_IEEE 0 CAN_2_Legs_CM_double -1.7E+308 1.7E+308 /end CHARACTERISTIC
/begin CHARACTERISTIC CAN_2_Legs_cal_impl.CANStatus_P4 "" VALUE 0x002173B0 Scalar_FLOAT64_IEEE 0 CAN_2_Legs_CM_double -1.7E+308 1.7E+308 /end CHARACTERISTIC
/begin CHARACTERISTIC CAN_2_Legs_cal_impl.CANStatus_P5 "" VALUE 0x002173C8 Scalar_FLOAT64_IEEE 0 CAN_2_Legs_CM_double -1.7E+308 1.7E+308 /end CHARACTERISTIC
/begin CHARACTERISTIC CAN_2_Legs_cal_impl.CANStatus_P6 "" VALUE 0x002173E0 Scalar_FLOAT64_IEEE 0 CAN_2_Legs_CM_double -1.7E+308 1.7E+308 /end CHARACTERISTIC
/begin CHARACTERISTIC CAN_2_Legs_cal_impl.CANStatus_P7 "" VALUE 0x002173F8 Scalar_FLOAT64_IEEE 0 CAN_2_Legs_CM_double -1.7E+308 1.7E+308 /end CHARACTERISTIC
/begin CHARACTERISTIC CAN_2_Legs_cal_impl.CANStatus_P8 "" VALUE 0x00217410 Scalar_FLOAT64_IEEE 0 CAN_2_Legs_CM_double -1.7E+308 1.7E+308 /end CHARACTERISTIC
/begin CHARACTERISTIC CAN_2_Legs_cal_impl.CANStatus_P9 "" VALUE 0x00217428 Scalar_FLOAT64_IEEE 0 CAN_2_Legs_CM_double -1.7E+308 1.7E+308 /end CHARACTERISTIC
/begin CHARACTERISTIC CAN_2_Legs_cal_impl.CANWrite1_P1 "" VAL_BLK 0x00217098 Scalar_FLOAT64_IEEE 0 CAN_2_Legs_CM_double -1.7E+308 1.7E+308 MATRIX_DIM 7 1 /end CHARACTERISTIC
/begin CHARACTERISTIC CAN_2_Legs_cal_impl.CANWrite1_P1_j "" VAL_BLK 0x00217140 Scalar_FLOAT64_IEEE 0 CAN_2_Legs_CM_double -1.7E+308 1.7E+308 MATRIX_DIM 7 1 /end CHARACTERISTIC
/begin CHARACTERISTIC CAN_2_Legs_cal_impl.Constant10_Value "" VALUE 0x00217348 Scalar_FLOAT64_IEEE 0 CAN_2_Legs_CM_double -1.7E+308 1.7E+308 /end CHARACTERISTIC
/begin CHARACTERISTIC CAN_2_Legs_cal_impl.Constant11_Value "" VALUE 0x00217350 Scalar_FLOAT64_IEEE 0 CAN_2_Legs_CM_double -1.7E+308 1.7E+308 /end CHARACTERISTIC
/begin CHARACTERISTIC CAN_2_Legs_cal_impl.Constant1_Value "" VALUE 0x002172F8 Scalar_FLOAT64_IEEE 0 CAN_2_Legs_CM_double -1.7E+308 1.7E+308 /end CHARACTERISTIC
/begin CHARACTERISTIC CAN_2_Legs_cal_impl.Constant1_Value_e "" VAL_BLK 0x002176AA Scalar_UBYTE 0 CAN_2_Legs_CM_uint8 0 255 MATRIX_DIM 8 1 /end CHARACTERISTIC
/begin CHARACTERISTIC CAN_2_Legs_cal_impl.Constant1_Value_m "" VAL_BLK 0x00217691 Scalar_UBYTE 0 CAN_2_Legs_CM_uint8 0 255 MATRIX_DIM 8 1 /end CHARACTERISTIC
/begin CHARACTERISTIC CAN_2_Legs_cal_impl.Constant2_Value "" VALUE 0x00217308 Scalar_FLOAT64_IEEE 0 CAN_2_Legs_CM_double -1.7E+308 1.7E+308 /end CHARACTERISTIC
/begin CHARACTERISTIC CAN_2_Legs_cal_impl.Constant2_Value_g "" VAL_BLK 0x00217699 Scalar_UBYTE 0 CAN_2_Legs_CM_uint8 0 255 MATRIX_DIM 8 1 /end CHARACTERISTIC
/begin CHARACTERISTIC CAN_2_Legs_cal_impl.Constant2_Value_k "" VAL_BLK 0x002176B2 Scalar_UBYTE 0 CAN_2_Legs_CM_uint8 0 255 MATRIX_DIM 8 1 /end CHARACTERISTIC
/begin CHARACTERISTIC CAN_2_Legs_cal_impl.Constant3_Value "" VALUE 0x00217310 Scalar_FLOAT64_IEEE 0 CAN_2_Legs_CM_double -1.7E+308 1.7E+308 /end CHARACTERISTIC
/begin CHARACTERISTIC CAN_2_Legs_cal_impl.Constant4_Value "" VALUE 0x00217318 Scalar_FLOAT64_IEEE 0 CAN_2_Legs_CM_double -1.7E+308 1.7E+308 /end CHARACTERISTIC
/begin CHARACTERISTIC CAN_2_Legs_cal_impl.Constant5_Value "" VALUE 0x00217320 Scalar_FLOAT64_IEEE 0 CAN_2_Legs_CM_double -1.7E+308 1.7E+308 /end CHARACTERISTIC
/begin CHARACTERISTIC CAN_2_Legs_cal_impl.Constant7_Value "" VALUE 0x00217328 Scalar_FLOAT64_IEEE 0 CAN_2_Legs_CM_double -1.7E+308 1.7E+308 /end CHARACTERISTIC
/begin CHARACTERISTIC CAN_2_Legs_cal_impl.Constant8_Value "" VALUE 0x00217338 Scalar_FLOAT64_IEEE 0 CAN_2_Legs_CM_double -1.7E+308 1.7E+308 /end CHARACTERISTIC
/begin CHARACTERISTIC CAN_2_Legs_cal_impl.Constant9_Value "" VALUE 0x00217340 Scalar_FLOAT64_IEEE 0 CAN_2_Legs_CM_double -1.7E+308 1.7E+308 /end CHARACTERISTIC
/begin CHARACTERISTIC CAN_2_Legs_cal_impl.Constant_Value "" VALUE 0x00217300 Scalar_FLOAT64_IEEE 0 CAN_2_Legs_CM_double -1.7E+308 1.7E+308 /end CHARACTERISTIC
/begin CHARACTERISTIC CAN_2_Legs_cal_impl.Constant_Value_i "" VAL_BLK 0x002176A2 Scalar_UBYTE 0 CAN_2_Legs_CM_uint8 0 255 MATRIX_DIM 8 1 /end CHARACTERISTIC
/begin CHARACTERISTIC CAN_2_Legs_cal_impl.Constant_Value_l "" VAL_BLK 0x00217689 Scalar_UBYTE 0 CAN_2_Legs_CM_uint8 0 255 MATRIX_DIM 8 1 /end CHARACTERISTIC
/begin CHARACTERISTIC CAN_2_Legs_cal_impl.Gain_Gain "" VALUE 0x00217080 Scalar_FLOAT64_IEEE 0 CAN_2_Legs_CM_double -1.7E+308 1.7E+308 /end CHARACTERISTIC
/begin CHARACTERISTIC CAN_2_Legs_cal_impl.Gain_Gain_j "" VALUE 0x00217330 Scalar_FLOAT64_IEEE 0 CAN_2_Legs_CM_double -1.7E+308 1.7E+308 /end CHARACTERISTIC
/begin CHARACTERISTIC CAN_2_Legs_cal_impl.Outport1_Y0 "" VALUE 0x00217028 Scalar_FLOAT64_IEEE 0 CAN_2_Legs_CM_double -1.7E+308 1.7E+308 /end CHARACTERISTIC
/begin CHARACTERISTIC CAN_2_Legs_cal_impl.Outport1_Y0_c "" VALUE 0x002170D8 Scalar_FLOAT64_IEEE 0 CAN_2_Legs_CM_double -1.7E+308 1.7E+308 /end CHARACTERISTIC
/begin CHARACTERISTIC CAN_2_Legs_cal_impl.Outport2_Y0 "" VALUE 0x00217030 Scalar_FLOAT64_IEEE 0 CAN_2_Legs_CM_double -1.7E+308 1.7E+308 /end CHARACTERISTIC
/begin CHARACTERISTIC CAN_2_Legs_cal_impl.Outport2_Y0_j "" VALUE 0x002170E0 Scalar_FLOAT64_IEEE 0 CAN_2_Legs_CM_double -1.7E+308 1.7E+308 /end CHARACTERISTIC
/begin CHARACTERISTIC CAN_2_Legs_cal_impl.Outport3_Y0 "" VALUE 0x00217038 Scalar_FLOAT64_IEEE 0 CAN_2_Legs_CM_double -1.7E+308 1.7E+308 /end CHARACTERISTIC
/begin CHARACTERISTIC CAN_2_Legs_cal_impl.Outport3_Y0_c "" VALUE 0x002170E8 Scalar_FLOAT64_IEEE 0 CAN_2_Legs_CM_double -1.7E+308 1.7E+308 /end CHARACTERISTIC
/begin CHARACTERISTIC CAN_2_Legs_cal_impl.Outport4_Y0 "" VALUE 0x00217688 Scalar_UBYTE 0 CAN_2_Legs_CM_uint8 0 255 /end CHARACTERISTIC
/begin CHARACTERISTIC CAN_2_Legs_cal_impl.Outport4_Y0_l "" VALUE 0x002176A1 Scalar_UBYTE 0 CAN_2_Legs_CM_uint8 0 255 /end CHARACTERISTIC
/begin CHARACTERISTIC CAN_2_Legs_cal_impl.Outport_Y0 "" VALUE 0x00217020 Scalar_FLOAT64_IEEE 0 CAN_2_Legs_CM_double -1.7E+308 1.7E+308 /end CHARACTERISTIC
/begin CHARACTERISTIC CAN_2_Legs_cal_impl.Outport_Y0_e "" VALUE 0x002170D0 Scalar_FLOAT64_IEEE 0 CAN_2_Legs_CM_double -1.7E+308 1.7E+308 /end CHARACTERISTIC
/begin MEASUREMENT CAN_2_Legs_B.BytePacking "" UBYTE CAN_2_Legs_CM_uint8 0 0 0 255 LAYOUT COLUMN_DIR MATRIX_DIM 8 ECU_ADDRESS 0x0021A9F0 /end MEASUREMENT
/begin MEASUREMENT CAN_2_Legs_B.BytePacking_o "" UBYTE CAN_2_Legs_CM_uint8 0 0 0 255 LAYOUT COLUMN_DIR MATRIX_DIM 8 ECU_ADDRESS 0x0021AA09 /end MEASUREMENT
/begin MEASUREMENT CAN_2_Legs_B.CANRead_o1 "" UBYTE CAN_2_Legs_CM_logical 0 0 0 1 ECU_ADDRESS 0x0021AA1A /end MEASUREMENT
/begin MEASUREMENT CAN_2_Legs_B.CANRead_o1_e "" UBYTE CAN_2_Legs_CM_logical 0 0 0 1 ECU_ADDRESS 0x0021AA1B /end MEASUREMENT
/begin MEASUREMENT CAN_2_Legs_B.CANUnpack_o1 "" FLOAT64_IEEE CAN_2_Legs_CM_double 0 0 -1.7E+308 1.7E+308 ECU_ADDRESS 0x0021A950 /end MEASUREMENT
/begin MEASUREMENT CAN_2_Legs_B.CANUnpack_o1_o "" FLOAT64_IEEE CAN_2_Legs_CM_double 0 0 -1.7E+308 1.7E+308 ECU_ADDRESS 0x0021A990 /end MEASUREMENT
/begin MEASUREMENT CAN_2_Legs_B.CANUnpack_o2 "" FLOAT64_IEEE CAN_2_Legs_CM_double 0 0 -1.7E+308 1.7E+308 ECU_ADDRESS 0x0021A958 /end MEASUREMENT
/begin MEASUREMENT CAN_2_Legs_B.CANUnpack_o2_m "" FLOAT64_IEEE CAN_2_Legs_CM_double 0 0 -1.7E+308 1.7E+308 ECU_ADDRESS 0x0021A998 /end MEASUREMENT
/begin MEASUREMENT CAN_2_Legs_B.CANUnpack_o3 "" FLOAT64_IEEE CAN_2_Legs_CM_double 0 0 -1.7E+308 1.7E+308 ECU_ADDRESS 0x0021A960 /end MEASUREMENT
/begin MEASUREMENT CAN_2_Legs_B.CANUnpack_o3_o "" FLOAT64_IEEE CAN_2_Legs_CM_double 0 0 -1.7E+308 1.7E+308 ECU_ADDRESS 0x0021A9A0 /end MEASUREMENT
/begin MEASUREMENT CAN_2_Legs_B.CANUnpack_o4 "" FLOAT64_IEEE CAN_2_Legs_CM_double 0 0 -1.7E+308 1.7E+308 ECU_ADDRESS 0x0021A968 /end MEASUREMENT
/begin MEASUREMENT CAN_2_Legs_B.CANUnpack_o4_f "" FLOAT64_IEEE CAN_2_Legs_CM_double 0 0 -1.7E+308 1.7E+308 ECU_ADDRESS 0x0021A9A8 /end MEASUREMENT
/begin MEASUREMENT CAN_2_Legs_B.CANUnpack_o5 "" UBYTE CAN_2_Legs_CM_uint8 0 0 0 255 ECU_ADDRESS 0x0021AA00 /end MEASUREMENT
/begin MEASUREMENT CAN_2_Legs_B.CANUnpack_o5_m "" UBYTE CAN_2_Legs_CM_uint8 0 0 0 255 ECU_ADDRESS 0x0021AA19 /end MEASUREMENT
/begin MEASUREMENT CAN_2_Legs_B.Constant1 "" FLOAT64_IEEE CAN_2_Legs_CM_double 0 0 -1.7E+308 1.7E+308 ECU_ADDRESS 0x0021A920 /end MEASUREMENT
/begin MEASUREMENT CAN_2_Legs_B.Constant2 "" FLOAT64_IEEE CAN_2_Legs_CM_double 0 0 -1.7E+308 1.7E+308 ECU_ADDRESS 0x0021A930 /end MEASUREMENT
/begin MEASUREMENT CAN_2_Legs_B.Constant8 "" FLOAT64_IEEE CAN_2_Legs_CM_double 0 0 -1.7E+308 1.7E+308 ECU_ADDRESS 0x0021A948 /end MEASUREMENT
/begin MEASUREMENT CAN_2_Legs_B.GRF "" FLOAT64_IEEE CAN_2_Legs_CM_double 0 0 -1.7E+308 1.7E+308 ECU_ADDRESS 0x0021A9E0 /end MEASUREMENT
/begin MEASUREMENT CAN_2_Legs_B.Gain "" FLOAT64_IEEE CAN_2_Legs_CM_double 0 0 -1.7E+308 1.7E+308 ECU_ADDRESS 0x0021A940 /end MEASUREMENT
/begin MEASUREMENT CAN_2_Legs_B.Gain_l "" FLOAT64_IEEE CAN_2_Legs_CM_double 0 0 -1.7E+308 1.7E+308 ECU_ADDRESS 0x0021A988 /end MEASUREMENT
/begin MEASUREMENT CAN_2_Legs_B.I_ff "" FLOAT64_IEEE CAN_2_Legs_CM_double 0 0 -1.7E+308 1.7E+308 ECU_ADDRESS 0x0021A980 /end MEASUREMENT
/begin MEASUREMENT CAN_2_Legs_B.I_ff_n "" FLOAT64_IEEE CAN_2_Legs_CM_double 0 0 -1.7E+308 1.7E+308 ECU_ADDRESS 0x0021A9C0 /end MEASUREMENT
/begin MEASUREMENT CAN_2_Legs_B.MultiportSwitch "" UBYTE CAN_2_Legs_CM_uint8 0 0 0 255 LAYOUT COLUMN_DIR MATRIX_DIM 8 ECU_ADDRESS 0x0021A9E8 /end MEASUREMENT
/begin MEASUREMENT CAN_2_Legs_B.MultiportSwitch_f "" UBYTE CAN_2_Legs_CM_uint8 0 0 0 255 LAYOUT COLUMN_DIR MATRIX_DIM 8 ECU_ADDRESS 0x0021AA01 /end MEASUREMENT
/begin MEASUREMENT CAN_2_Legs_B.TmpSignalConversionAtSFunctionI "" FLOAT64_IEEE CAN_2_Legs_CM_double 0 0 -1.7E+308 1.7E+308 LAYOUT COLUMN_DIR MATRIX_DIM 2 ECU_ADDRESS 0x0021A9C8 /end MEASUREMENT
/begin MEASUREMENT CAN_2_Legs_B.b "" UBYTE CAN_2_Legs_CM_uint8 0 0 0 255 LAYOUT COLUMN_DIR MATRIX_DIM 8 ECU_ADDRESS 0x0021A9F8 /end MEASUREMENT
/begin MEASUREMENT CAN_2_Legs_B.b_g "" UBYTE CAN_2_Legs_CM_uint8 0 0 0 255 LAYOUT COLUMN_DIR MATRIX_DIM 8 ECU_ADDRESS 0x0021AA11 /end MEASUREMENT
/begin MEASUREMENT CAN_2_Legs_B.danger "" FLOAT64_IEEE CAN_2_Legs_CM_double 0 0 -1.7E+308 1.7E+308 ECU_ADDRESS 0x0021A9D8 /end MEASUREMENT
/begin MEASUREMENT CAN_2_Legs_B.mode "" FLOAT64_IEEE CAN_2_Legs_CM_double 0 0 -1.7E+308 1.7E+308 ECU_ADDRESS 0x0021A928 /end MEASUREMENT
/begin MEASUREMENT CAN_2_Legs_B.pcp1 "" FLOAT64_IEEE CAN_2_Legs_CM_double 0 0 -1.7E+308 1.7E+308 ECU_ADDRESS 0x0021A938 /end MEASUREMENT
/begin MEASUREMENT CAN_2_Legs_B.position "" FLOAT64_IEEE CAN_2_Legs_CM_double 0 0 -1.7E+308 1.7E+308 ECU_ADDRESS 0x0021A970 /end MEASUREMENT
/begin MEASUREMENT CAN_2_Legs_B.position_f "" FLOAT64_IEEE CAN_2_Legs_CM_double 0 0 -1.7E+308 1.7E+308 ECU_ADDRESS 0x0021A9B0 /end MEASUREMENT
/begin MEASUREMENT CAN_2_Legs_B.velocity "" FLOAT64_IEEE CAN_2_Legs_CM_double 0 0 -1.7E+308 1.7E+308 ECU_ADDRESS 0x0021A978 /end MEASUREMENT
/begin MEASUREMENT CAN_2_Legs_B.velocity_d "" FLOAT64_IEEE CAN_2_Legs_CM_double 0 0 -1.7E+308 1.7E+308 ECU_ADDRESS 0x0021A9B8 /end MEASUREMENT
/begin MEASUREMENT CAN_2_Legs_DW.CANUnpack_ModeSignalID "" SLONG CAN_2_Legs_CM_int_T 0 0 -2147483648 2147483647 ECU_ADDRESS 0x0021A888 /end MEASUREMENT
/begin MEASUREMENT CAN_2_Legs_DW.CANUnpack_ModeSignalID_l "" SLONG CAN_2_Legs_CM_int_T 0 0 -2147483648 2147483647 ECU_ADDRESS 0x0021A898 /end MEASUREMENT
/begin MEASUREMENT CAN_2_Legs_DW.CANUnpack_StatusPortID "" SLONG CAN_2_Legs_CM_int_T 0 0 -2147483648 2147483647 ECU_ADDRESS 0x0021A88C /end MEASUREMENT
/begin MEASUREMENT CAN_2_Legs_DW.CANUnpack_StatusPortID_g "" SLONG CAN_2_Legs_CM_int_T 0 0 -2147483648 2147483647 ECU_ADDRESS 0x0021A89C /end MEASUREMENT
/begin MEASUREMENT CAN_2_Legs_DW.IfActionSubsystem_SubsysRanBC "" SBYTE CAN_2_Legs_CM_int8 0 0 -128 127 ECU_ADDRESS 0x0021A8A0 /end MEASUREMENT
/begin MEASUREMENT CAN_2_Legs_DW.IfActionSubsystem_SubsysRanBC_j "" SBYTE CAN_2_Legs_CM_int8 0 0 -128 127 ECU_ADDRESS 0x0021A8A1 /end MEASUREMENT
/begin COMPU_METHOD CAN_2_Legs_CM_double "" IDENTICAL "%15.10" "" /end COMPU_METHOD
/begin COMPU_METHOD CAN_2_Legs_CM_int8 "" IDENTICAL "%3.0" "" /end COMPU_METHOD
/begin COMPU_METHOD CAN_2_Legs_CM_int_T "" IDENTICAL "customformat" "" /end COMPU_METHOD
/begin COMPU_METHOD CAN_2_Legs_CM_logical "" IDENTICAL "%1.0" "" /end COMPU_METHOD
/begin COMPU_METHOD CAN_2_Legs_CM_uint8 "" IDENTICAL "%3.0" "" /end COMPU_METHOD
/begin RECORD_LAYOUT Scalar_BOOLEAN FNC_VALUES 1 UBYTE COLUMN_DIR DIRECT /end RECORD_LAYOUT
/begin RECORD_LAYOUT Scalar_FLOAT64_IEEE FNC_VALUES 1 FLOAT64_IEEE COLUMN_DIR DIRECT /end RECORD_LAYOUT
/begin RECORD_LAYOUT Scalar_SBYTE FNC_VALUES 1 SBYTE COLUMN_DIR DIRECT /end RECORD_LAYOUT
/begin RECORD_LAYOUT Scalar_SLONG FNC_VALUES 1 SLONG COLUMN_DIR DIRECT /end RECORD_LAYOUT
/begin RECORD_LAYOUT Scalar_UBYTE FNC_VALUES 1 UBYTE COLUMN_DIR DIRECT /end RECORD_LAYOUT
/begin GROUP CAN_2_Legs "CAN_2_Legs" ROOT /end GROUP
/end MODULE
/end PROJECT
