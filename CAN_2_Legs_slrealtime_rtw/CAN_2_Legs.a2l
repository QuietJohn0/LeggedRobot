/******************************************************************************
* ASAP2 file: CAN_2_Legs.a2l
* Academic License - for use in teaching, academic research, and meeting
* course requirements at degree granting institutions only. Not for
* government, commercial, or other organizational use.
* Code generation for model "CAN_2_Legs".
* Model version : 1.3
* Simulink Coder version : 10.3 R2021a
* C source code generated on : Fri Aug 20 17:04:04 2021
* Target selection: slrealtime.tlc
* Embedded hardware selection: Intel->x86-64 (Linux 64)
* Code generation objectives: Unspecified
* Validation result: Not run
* (add additional file header information here)
******************************************************************************/ ASAP2_VERSION 1 71
/begin PROJECT ProjectName "Project Comment Goes Here"
/begin HEADER "Header Comments go here" /end HEADER
/begin MODULE ModuleName "Module Comment Goes Here"
/begin IF_DATA XCP
 /begin PROTOCOL_LAYER 0x0100 0x03E8 0x00C8 0x0000 0x0000 0x0000 0x0000 0x0000 0xFC 0x0578 BYTE_ORDER_MSB_LAST ADDRESS_GRANULARITY_BYTE OPTIONAL_CMD ALLOC_ODT_ENTRY OPTIONAL_CMD ALLOC_ODT OPTIONAL_CMD ALLOC_DAQ OPTIONAL_CMD FREE_DAQ OPTIONAL_CMD GET_DAQ_RESOLUTION_INFO OPTIONAL_CMD GET_DAQ_PROCESSOR_INFO OPTIONAL_CMD START_STOP_SYNCH OPTIONAL_CMD START_STOP_DAQ_LIST OPTIONAL_CMD SET_DAQ_LIST_MODE OPTIONAL_CMD WRITE_DAQ OPTIONAL_CMD SET_DAQ_PTR OPTIONAL_CMD GET_CAL_PAGE OPTIONAL_CMD SET_CAL_PAGE OPTIONAL_CMD COPY_CAL_PAGE OPTIONAL_CMD SHORT_DOWNLOAD OPTIONAL_CMD DOWNLOAD_MAX OPTIONAL_CMD DOWNLOAD OPTIONAL_CMD SHORT_UPLOAD OPTIONAL_CMD UPLOAD OPTIONAL_CMD SET_MTA /end PROTOCOL_LAYER
 /begin DAQ DYNAMIC 0x0000 0x0080 0x00 OPTIMISATION_TYPE_DEFAULT ADDRESS_EXTENSION_FREE IDENTIFICATION_FIELD_TYPE_RELATIVE_WORD_ALIGNED GRANULARITY_ODT_ENTRY_SIZE_DAQ_BYTE 0xFF OVERLOAD_INDICATION_PID PRESCALER_SUPPORTED /begin STIM GRANULARITY_ODT_ENTRY_SIZE_STIM_BYTE 0xFF /end STIM /begin TIMESTAMP_SUPPORTED 0x0001 SIZE_DWORD UNIT_1US TIMESTAMP_FIXED /end TIMESTAMP_SUPPORTED /begin EVENT "1 ms" "1 ms" 0x0000 DAQ 0xFF 0x01 0x06 0x00 /end EVENT /end DAQ
 /begin XCP_ON_UDP_IP 0x0100 0x15B3 ADDRESS "192.168.7.5" /end XCP_ON_UDP_IP
/end IF_DATA
/begin MOD_PAR "MOD PAR Comment Goes Here"
 /begin MEMORY_SEGMENT CAN_2_Legs_cal_impl "CAN_2_Legs_cal_impl" DATA FLASH INTERN 0x00216020 0x690 -1 -1 -1 -1 -1
  /begin IF_DATA XCP
   /begin SEGMENT 0x00 0x02 0x00 0x00 0x00
    /begin PAGE 0x00 ECU_ACCESS_DONT_CARE XCP_READ_ACCESS_DONT_CARE XCP_WRITE_ACCESS_NOT_ALLOWED /end PAGE
    /begin PAGE 0x01 ECU_ACCESS_DONT_CARE XCP_READ_ACCESS_DONT_CARE XCP_WRITE_ACCESS_DONT_CARE /end PAGE
   /end SEGMENT
  /end IF_DATA
 /end MEMORY_SEGMENT
/end MOD_PAR
/begin MOD_COMMON "Mod Common Comment Here" BYTE_ORDER MSB_LAST ALIGNMENT_BYTE 1 ALIGNMENT_WORD 2 ALIGNMENT_LONG 8 ALIGNMENT_FLOAT32_IEEE 4 ALIGNMENT_FLOAT64_IEEE 8 ALIGNMENT_INT64 4 /end MOD_COMMON
/begin CHARACTERISTIC CAN_2_Legs_cal_impl.CANRead_P1 "" VAL_BLK 0x00216050 Scalar_FLOAT64_IEEE 0 CAN_2_Legs_CM_double -1.7E+308 1.7E+308 MATRIX_DIM 6 1 /end CHARACTERISTIC
/begin CHARACTERISTIC CAN_2_Legs_cal_impl.CANRead_P1_o "" VAL_BLK 0x002160F8 Scalar_FLOAT64_IEEE 0 CAN_2_Legs_CM_double -1.7E+308 1.7E+308 MATRIX_DIM 6 1 /end CHARACTERISTIC
/begin CHARACTERISTIC CAN_2_Legs_cal_impl.CANSetup_P1 "" VAL_BLK 0x00216180 Scalar_FLOAT64_IEEE 0 CAN_2_Legs_CM_double -1.7E+308 1.7E+308 MATRIX_DIM 40 1 /end CHARACTERISTIC
/begin CHARACTERISTIC CAN_2_Legs_cal_impl.CANSetup_P2 "" VALUE 0x002162D0 Scalar_FLOAT64_IEEE 0 CAN_2_Legs_CM_double -1.7E+308 1.7E+308 /end CHARACTERISTIC
/begin CHARACTERISTIC CAN_2_Legs_cal_impl.CANSetup_P3 "" VALUE 0x002162E8 Scalar_FLOAT64_IEEE 0 CAN_2_Legs_CM_double -1.7E+308 1.7E+308 /end CHARACTERISTIC
/begin CHARACTERISTIC CAN_2_Legs_cal_impl.CANStatus_P1 "" VALUE 0x00216358 Scalar_FLOAT64_IEEE 0 CAN_2_Legs_CM_double -1.7E+308 1.7E+308 /end CHARACTERISTIC
/begin CHARACTERISTIC CAN_2_Legs_cal_impl.CANStatus_P10 "" VALUE 0x00216430 Scalar_FLOAT64_IEEE 0 CAN_2_Legs_CM_double -1.7E+308 1.7E+308 /end CHARACTERISTIC
/begin CHARACTERISTIC CAN_2_Legs_cal_impl.CANStatus_P11 "" VALUE 0x00216448 Scalar_FLOAT64_IEEE 0 CAN_2_Legs_CM_double -1.7E+308 1.7E+308 /end CHARACTERISTIC
/begin CHARACTERISTIC CAN_2_Legs_cal_impl.CANStatus_P12 "" VALUE 0x00216460 Scalar_FLOAT64_IEEE 0 CAN_2_Legs_CM_double -1.7E+308 1.7E+308 /end CHARACTERISTIC
/begin CHARACTERISTIC CAN_2_Legs_cal_impl.CANStatus_P13 "" VALUE 0x00216478 Scalar_FLOAT64_IEEE 0 CAN_2_Legs_CM_double -1.7E+308 1.7E+308 /end CHARACTERISTIC
/begin CHARACTERISTIC CAN_2_Legs_cal_impl.CANStatus_P14 "" VALUE 0x00216490 Scalar_FLOAT64_IEEE 0 CAN_2_Legs_CM_double -1.7E+308 1.7E+308 /end CHARACTERISTIC
/begin CHARACTERISTIC CAN_2_Legs_cal_impl.CANStatus_P15 "" VALUE 0x002164A8 Scalar_FLOAT64_IEEE 0 CAN_2_Legs_CM_double -1.7E+308 1.7E+308 /end CHARACTERISTIC
/begin CHARACTERISTIC CAN_2_Legs_cal_impl.CANStatus_P16 "" VALUE 0x002164C0 Scalar_FLOAT64_IEEE 0 CAN_2_Legs_CM_double -1.7E+308 1.7E+308 /end CHARACTERISTIC
/begin CHARACTERISTIC CAN_2_Legs_cal_impl.CANStatus_P17 "" VALUE 0x002164D8 Scalar_FLOAT64_IEEE 0 CAN_2_Legs_CM_double -1.7E+308 1.7E+308 /end CHARACTERISTIC
/begin CHARACTERISTIC CAN_2_Legs_cal_impl.CANStatus_P18 "" VALUE 0x002164F0 Scalar_FLOAT64_IEEE 0 CAN_2_Legs_CM_double -1.7E+308 1.7E+308 /end CHARACTERISTIC
/begin CHARACTERISTIC CAN_2_Legs_cal_impl.CANStatus_P19 "" VALUE 0x00216508 Scalar_FLOAT64_IEEE 0 CAN_2_Legs_CM_double -1.7E+308 1.7E+308 /end CHARACTERISTIC
/begin CHARACTERISTIC CAN_2_Legs_cal_impl.CANStatus_P2 "" VALUE 0x00216370 Scalar_FLOAT64_IEEE 0 CAN_2_Legs_CM_double -1.7E+308 1.7E+308 /end CHARACTERISTIC
/begin CHARACTERISTIC CAN_2_Legs_cal_impl.CANStatus_P20 "" VALUE 0x00216520 Scalar_FLOAT64_IEEE 0 CAN_2_Legs_CM_double -1.7E+308 1.7E+308 /end CHARACTERISTIC
/begin CHARACTERISTIC CAN_2_Legs_cal_impl.CANStatus_P21 "" VALUE 0x00216538 Scalar_FLOAT64_IEEE 0 CAN_2_Legs_CM_double -1.7E+308 1.7E+308 /end CHARACTERISTIC
/begin CHARACTERISTIC CAN_2_Legs_cal_impl.CANStatus_P22 "" VALUE 0x00216550 Scalar_FLOAT64_IEEE 0 CAN_2_Legs_CM_double -1.7E+308 1.7E+308 /end CHARACTERISTIC
/begin CHARACTERISTIC CAN_2_Legs_cal_impl.CANStatus_P23 "" VALUE 0x00216568 Scalar_FLOAT64_IEEE 0 CAN_2_Legs_CM_double -1.7E+308 1.7E+308 /end CHARACTERISTIC
/begin CHARACTERISTIC CAN_2_Legs_cal_impl.CANStatus_P24 "" VALUE 0x00216580 Scalar_FLOAT64_IEEE 0 CAN_2_Legs_CM_double -1.7E+308 1.7E+308 /end CHARACTERISTIC
/begin CHARACTERISTIC CAN_2_Legs_cal_impl.CANStatus_P25 "" VALUE 0x00216598 Scalar_FLOAT64_IEEE 0 CAN_2_Legs_CM_double -1.7E+308 1.7E+308 /end CHARACTERISTIC
/begin CHARACTERISTIC CAN_2_Legs_cal_impl.CANStatus_P26 "" VALUE 0x002165B0 Scalar_FLOAT64_IEEE 0 CAN_2_Legs_CM_double -1.7E+308 1.7E+308 /end CHARACTERISTIC
/begin CHARACTERISTIC CAN_2_Legs_cal_impl.CANStatus_P27 "" VALUE 0x002165C8 Scalar_FLOAT64_IEEE 0 CAN_2_Legs_CM_double -1.7E+308 1.7E+308 /end CHARACTERISTIC
/begin CHARACTERISTIC CAN_2_Legs_cal_impl.CANStatus_P28 "" VALUE 0x002165E0 Scalar_FLOAT64_IEEE 0 CAN_2_Legs_CM_double -1.7E+308 1.7E+308 /end CHARACTERISTIC
/begin CHARACTERISTIC CAN_2_Legs_cal_impl.CANStatus_P29 "" VALUE 0x002165F8 Scalar_FLOAT64_IEEE 0 CAN_2_Legs_CM_double -1.7E+308 1.7E+308 /end CHARACTERISTIC
/begin CHARACTERISTIC CAN_2_Legs_cal_impl.CANStatus_P3 "" VALUE 0x00216388 Scalar_FLOAT64_IEEE 0 CAN_2_Legs_CM_double -1.7E+308 1.7E+308 /end CHARACTERISTIC
/begin CHARACTERISTIC CAN_2_Legs_cal_impl.CANStatus_P30 "" VALUE 0x00216610 Scalar_FLOAT64_IEEE 0 CAN_2_Legs_CM_double -1.7E+308 1.7E+308 /end CHARACTERISTIC
/begin CHARACTERISTIC CAN_2_Legs_cal_impl.CANStatus_P31 "" VALUE 0x00216628 Scalar_FLOAT64_IEEE 0 CAN_2_Legs_CM_double -1.7E+308 1.7E+308 /end CHARACTERISTIC
/begin CHARACTERISTIC CAN_2_Legs_cal_impl.CANStatus_P32 "" VALUE 0x00216640 Scalar_FLOAT64_IEEE 0 CAN_2_Legs_CM_double -1.7E+308 1.7E+308 /end CHARACTERISTIC
/begin CHARACTERISTIC CAN_2_Legs_cal_impl.CANStatus_P33 "" VALUE 0x00216658 Scalar_FLOAT64_IEEE 0 CAN_2_Legs_CM_double -1.7E+308 1.7E+308 /end CHARACTERISTIC
/begin CHARACTERISTIC CAN_2_Legs_cal_impl.CANStatus_P34 "" VALUE 0x00216670 Scalar_FLOAT64_IEEE 0 CAN_2_Legs_CM_double -1.7E+308 1.7E+308 /end CHARACTERISTIC
/begin CHARACTERISTIC CAN_2_Legs_cal_impl.CANStatus_P4 "" VALUE 0x002163A0 Scalar_FLOAT64_IEEE 0 CAN_2_Legs_CM_double -1.7E+308 1.7E+308 /end CHARACTERISTIC
/begin CHARACTERISTIC CAN_2_Legs_cal_impl.CANStatus_P5 "" VALUE 0x002163B8 Scalar_FLOAT64_IEEE 0 CAN_2_Legs_CM_double -1.7E+308 1.7E+308 /end CHARACTERISTIC
/begin CHARACTERISTIC CAN_2_Legs_cal_impl.CANStatus_P6 "" VALUE 0x002163D0 Scalar_FLOAT64_IEEE 0 CAN_2_Legs_CM_double -1.7E+308 1.7E+308 /end CHARACTERISTIC
/begin CHARACTERISTIC CAN_2_Legs_cal_impl.CANStatus_P7 "" VALUE 0x002163E8 Scalar_FLOAT64_IEEE 0 CAN_2_Legs_CM_double -1.7E+308 1.7E+308 /end CHARACTERISTIC
/begin CHARACTERISTIC CAN_2_Legs_cal_impl.CANStatus_P8 "" VALUE 0x00216400 Scalar_FLOAT64_IEEE 0 CAN_2_Legs_CM_double -1.7E+308 1.7E+308 /end CHARACTERISTIC
/begin CHARACTERISTIC CAN_2_Legs_cal_impl.CANStatus_P9 "" VALUE 0x00216418 Scalar_FLOAT64_IEEE 0 CAN_2_Legs_CM_double -1.7E+308 1.7E+308 /end CHARACTERISTIC
/begin CHARACTERISTIC CAN_2_Legs_cal_impl.CANWrite1_P1 "" VAL_BLK 0x00216090 Scalar_FLOAT64_IEEE 0 CAN_2_Legs_CM_double -1.7E+308 1.7E+308 MATRIX_DIM 7 1 /end CHARACTERISTIC
/begin CHARACTERISTIC CAN_2_Legs_cal_impl.CANWrite1_P1_j "" VAL_BLK 0x00216138 Scalar_FLOAT64_IEEE 0 CAN_2_Legs_CM_double -1.7E+308 1.7E+308 MATRIX_DIM 7 1 /end CHARACTERISTIC
/begin CHARACTERISTIC CAN_2_Legs_cal_impl.Constant10_Value "" VALUE 0x00216310 Scalar_FLOAT64_IEEE 0 CAN_2_Legs_CM_double -1.7E+308 1.7E+308 /end CHARACTERISTIC
/begin CHARACTERISTIC CAN_2_Legs_cal_impl.Constant11_Value "" VALUE 0x00216318 Scalar_FLOAT64_IEEE 0 CAN_2_Legs_CM_double -1.7E+308 1.7E+308 /end CHARACTERISTIC
/begin CHARACTERISTIC CAN_2_Legs_cal_impl.Constant1_Value "" VALUE 0x00216320 Scalar_FLOAT64_IEEE 0 CAN_2_Legs_CM_double -1.7E+308 1.7E+308 /end CHARACTERISTIC
/begin CHARACTERISTIC CAN_2_Legs_cal_impl.Constant1_Value_e "" VAL_BLK 0x0021669A Scalar_UBYTE 0 CAN_2_Legs_CM_uint8 0 255 MATRIX_DIM 8 1 /end CHARACTERISTIC
/begin CHARACTERISTIC CAN_2_Legs_cal_impl.Constant1_Value_m "" VAL_BLK 0x00216681 Scalar_UBYTE 0 CAN_2_Legs_CM_uint8 0 255 MATRIX_DIM 8 1 /end CHARACTERISTIC
/begin CHARACTERISTIC CAN_2_Legs_cal_impl.Constant2_Value "" VALUE 0x00216328 Scalar_FLOAT64_IEEE 0 CAN_2_Legs_CM_double -1.7E+308 1.7E+308 /end CHARACTERISTIC
/begin CHARACTERISTIC CAN_2_Legs_cal_impl.Constant2_Value_g "" VAL_BLK 0x00216689 Scalar_UBYTE 0 CAN_2_Legs_CM_uint8 0 255 MATRIX_DIM 8 1 /end CHARACTERISTIC
/begin CHARACTERISTIC CAN_2_Legs_cal_impl.Constant2_Value_k "" VAL_BLK 0x002166A2 Scalar_UBYTE 0 CAN_2_Legs_CM_uint8 0 255 MATRIX_DIM 8 1 /end CHARACTERISTIC
/begin CHARACTERISTIC CAN_2_Legs_cal_impl.Constant3_Value "" VALUE 0x00216330 Scalar_FLOAT64_IEEE 0 CAN_2_Legs_CM_double -1.7E+308 1.7E+308 /end CHARACTERISTIC
/begin CHARACTERISTIC CAN_2_Legs_cal_impl.Constant4_Value "" VALUE 0x00216338 Scalar_FLOAT64_IEEE 0 CAN_2_Legs_CM_double -1.7E+308 1.7E+308 /end CHARACTERISTIC
/begin CHARACTERISTIC CAN_2_Legs_cal_impl.Constant5_Value "" VALUE 0x00216340 Scalar_FLOAT64_IEEE 0 CAN_2_Legs_CM_double -1.7E+308 1.7E+308 /end CHARACTERISTIC
/begin CHARACTERISTIC CAN_2_Legs_cal_impl.Constant7_Value "" VALUE 0x002162F8 Scalar_FLOAT64_IEEE 0 CAN_2_Legs_CM_double -1.7E+308 1.7E+308 /end CHARACTERISTIC
/begin CHARACTERISTIC CAN_2_Legs_cal_impl.Constant8_Value "" VALUE 0x00216300 Scalar_FLOAT64_IEEE 0 CAN_2_Legs_CM_double -1.7E+308 1.7E+308 /end CHARACTERISTIC
/begin CHARACTERISTIC CAN_2_Legs_cal_impl.Constant9_Value "" VALUE 0x00216308 Scalar_FLOAT64_IEEE 0 CAN_2_Legs_CM_double -1.7E+308 1.7E+308 /end CHARACTERISTIC
/begin CHARACTERISTIC CAN_2_Legs_cal_impl.Constant_Value "" VALUE 0x002162F0 Scalar_FLOAT64_IEEE 0 CAN_2_Legs_CM_double -1.7E+308 1.7E+308 /end CHARACTERISTIC
/begin CHARACTERISTIC CAN_2_Legs_cal_impl.Constant_Value_i "" VAL_BLK 0x00216692 Scalar_UBYTE 0 CAN_2_Legs_CM_uint8 0 255 MATRIX_DIM 8 1 /end CHARACTERISTIC
/begin CHARACTERISTIC CAN_2_Legs_cal_impl.Constant_Value_l "" VAL_BLK 0x00216679 Scalar_UBYTE 0 CAN_2_Legs_CM_uint8 0 255 MATRIX_DIM 8 1 /end CHARACTERISTIC
/begin CHARACTERISTIC CAN_2_Legs_cal_impl.Outport1_Y0 "" VALUE 0x00216028 Scalar_FLOAT64_IEEE 0 CAN_2_Legs_CM_double -1.7E+308 1.7E+308 /end CHARACTERISTIC
/begin CHARACTERISTIC CAN_2_Legs_cal_impl.Outport1_Y0_c "" VALUE 0x002160D0 Scalar_FLOAT64_IEEE 0 CAN_2_Legs_CM_double -1.7E+308 1.7E+308 /end CHARACTERISTIC
/begin CHARACTERISTIC CAN_2_Legs_cal_impl.Outport2_Y0 "" VALUE 0x00216030 Scalar_FLOAT64_IEEE 0 CAN_2_Legs_CM_double -1.7E+308 1.7E+308 /end CHARACTERISTIC
/begin CHARACTERISTIC CAN_2_Legs_cal_impl.Outport2_Y0_j "" VALUE 0x002160D8 Scalar_FLOAT64_IEEE 0 CAN_2_Legs_CM_double -1.7E+308 1.7E+308 /end CHARACTERISTIC
/begin CHARACTERISTIC CAN_2_Legs_cal_impl.Outport3_Y0 "" VALUE 0x00216038 Scalar_FLOAT64_IEEE 0 CAN_2_Legs_CM_double -1.7E+308 1.7E+308 /end CHARACTERISTIC
/begin CHARACTERISTIC CAN_2_Legs_cal_impl.Outport3_Y0_c "" VALUE 0x002160E0 Scalar_FLOAT64_IEEE 0 CAN_2_Legs_CM_double -1.7E+308 1.7E+308 /end CHARACTERISTIC
/begin CHARACTERISTIC CAN_2_Legs_cal_impl.Outport4_Y0 "" VALUE 0x00216678 Scalar_UBYTE 0 CAN_2_Legs_CM_uint8 0 255 /end CHARACTERISTIC
/begin CHARACTERISTIC CAN_2_Legs_cal_impl.Outport4_Y0_l "" VALUE 0x00216691 Scalar_UBYTE 0 CAN_2_Legs_CM_uint8 0 255 /end CHARACTERISTIC
/begin CHARACTERISTIC CAN_2_Legs_cal_impl.Outport_Y0 "" VALUE 0x00216020 Scalar_FLOAT64_IEEE 0 CAN_2_Legs_CM_double -1.7E+308 1.7E+308 /end CHARACTERISTIC
/begin CHARACTERISTIC CAN_2_Legs_cal_impl.Outport_Y0_e "" VALUE 0x002160C8 Scalar_FLOAT64_IEEE 0 CAN_2_Legs_CM_double -1.7E+308 1.7E+308 /end CHARACTERISTIC
/begin MEASUREMENT CAN_2_Legs_B.BytePacking "" UBYTE CAN_2_Legs_CM_uint8 0 0 0 255 LAYOUT COLUMN_DIR MATRIX_DIM 8 ECU_ADDRESS 0x002199A8 /end MEASUREMENT
/begin MEASUREMENT CAN_2_Legs_B.BytePacking_o "" UBYTE CAN_2_Legs_CM_uint8 0 0 0 255 LAYOUT COLUMN_DIR MATRIX_DIM 8 ECU_ADDRESS 0x002199B9 /end MEASUREMENT
/begin MEASUREMENT CAN_2_Legs_B.CANRead_o1 "" UBYTE CAN_2_Legs_CM_logical 0 0 0 1 ECU_ADDRESS 0x002199C2 /end MEASUREMENT
/begin MEASUREMENT CAN_2_Legs_B.CANRead_o1_e "" UBYTE CAN_2_Legs_CM_logical 0 0 0 1 ECU_ADDRESS 0x002199C3 /end MEASUREMENT
/begin MEASUREMENT CAN_2_Legs_B.CANUnpack_o1 "" FLOAT64_IEEE CAN_2_Legs_CM_double 0 0 -1.7E+308 1.7E+308 ECU_ADDRESS 0x00219960 /end MEASUREMENT
/begin MEASUREMENT CAN_2_Legs_B.CANUnpack_o1_o "" FLOAT64_IEEE CAN_2_Legs_CM_double 0 0 -1.7E+308 1.7E+308 ECU_ADDRESS 0x00219980 /end MEASUREMENT
/begin MEASUREMENT CAN_2_Legs_B.CANUnpack_o2 "" FLOAT64_IEEE CAN_2_Legs_CM_double 0 0 -1.7E+308 1.7E+308 ECU_ADDRESS 0x00219968 /end MEASUREMENT
/begin MEASUREMENT CAN_2_Legs_B.CANUnpack_o2_m "" FLOAT64_IEEE CAN_2_Legs_CM_double 0 0 -1.7E+308 1.7E+308 ECU_ADDRESS 0x00219988 /end MEASUREMENT
/begin MEASUREMENT CAN_2_Legs_B.CANUnpack_o3 "" FLOAT64_IEEE CAN_2_Legs_CM_double 0 0 -1.7E+308 1.7E+308 ECU_ADDRESS 0x00219970 /end MEASUREMENT
/begin MEASUREMENT CAN_2_Legs_B.CANUnpack_o3_o "" FLOAT64_IEEE CAN_2_Legs_CM_double 0 0 -1.7E+308 1.7E+308 ECU_ADDRESS 0x00219990 /end MEASUREMENT
/begin MEASUREMENT CAN_2_Legs_B.CANUnpack_o4 "" FLOAT64_IEEE CAN_2_Legs_CM_double 0 0 -1.7E+308 1.7E+308 ECU_ADDRESS 0x00219978 /end MEASUREMENT
/begin MEASUREMENT CAN_2_Legs_B.CANUnpack_o4_f "" FLOAT64_IEEE CAN_2_Legs_CM_double 0 0 -1.7E+308 1.7E+308 ECU_ADDRESS 0x00219998 /end MEASUREMENT
/begin MEASUREMENT CAN_2_Legs_B.CANUnpack_o5 "" UBYTE CAN_2_Legs_CM_uint8 0 0 0 255 ECU_ADDRESS 0x002199B0 /end MEASUREMENT
/begin MEASUREMENT CAN_2_Legs_B.CANUnpack_o5_m "" UBYTE CAN_2_Legs_CM_uint8 0 0 0 255 ECU_ADDRESS 0x002199C1 /end MEASUREMENT
/begin MEASUREMENT CAN_2_Legs_B.Constant1 "" FLOAT64_IEEE CAN_2_Legs_CM_double 0 0 -1.7E+308 1.7E+308 ECU_ADDRESS 0x00219950 /end MEASUREMENT
/begin MEASUREMENT CAN_2_Legs_B.Constant2 "" FLOAT64_IEEE CAN_2_Legs_CM_double 0 0 -1.7E+308 1.7E+308 ECU_ADDRESS 0x00219958 /end MEASUREMENT
/begin MEASUREMENT CAN_2_Legs_B.Constant7 "" FLOAT64_IEEE CAN_2_Legs_CM_double 0 0 -1.7E+308 1.7E+308 ECU_ADDRESS 0x00219940 /end MEASUREMENT
/begin MEASUREMENT CAN_2_Legs_B.Constant8 "" FLOAT64_IEEE CAN_2_Legs_CM_double 0 0 -1.7E+308 1.7E+308 ECU_ADDRESS 0x00219948 /end MEASUREMENT
/begin MEASUREMENT CAN_2_Legs_B.MultiportSwitch "" UBYTE CAN_2_Legs_CM_uint8 0 0 0 255 LAYOUT COLUMN_DIR MATRIX_DIM 8 ECU_ADDRESS 0x002199A0 /end MEASUREMENT
/begin MEASUREMENT CAN_2_Legs_B.MultiportSwitch_f "" UBYTE CAN_2_Legs_CM_uint8 0 0 0 255 LAYOUT COLUMN_DIR MATRIX_DIM 8 ECU_ADDRESS 0x002199B1 /end MEASUREMENT
/begin MEASUREMENT CAN_2_Legs_B.sf_bytesfloats.I_ff "" FLOAT64_IEEE CAN_2_Legs_CM_double 0 0 -1.7E+308 1.7E+308 ECU_ADDRESS 0x00219A00 /end MEASUREMENT
/begin MEASUREMENT CAN_2_Legs_B.sf_bytesfloats.position "" FLOAT64_IEEE CAN_2_Legs_CM_double 0 0 -1.7E+308 1.7E+308 ECU_ADDRESS 0x002199F0 /end MEASUREMENT
/begin MEASUREMENT CAN_2_Legs_B.sf_bytesfloats.velocity "" FLOAT64_IEEE CAN_2_Legs_CM_double 0 0 -1.7E+308 1.7E+308 ECU_ADDRESS 0x002199F8 /end MEASUREMENT
/begin MEASUREMENT CAN_2_Legs_B.sf_bytesfloats_k.I_ff "" FLOAT64_IEEE CAN_2_Legs_CM_double 0 0 -1.7E+308 1.7E+308 ECU_ADDRESS 0x002199E0 /end MEASUREMENT
/begin MEASUREMENT CAN_2_Legs_B.sf_bytesfloats_k.position "" FLOAT64_IEEE CAN_2_Legs_CM_double 0 0 -1.7E+308 1.7E+308 ECU_ADDRESS 0x002199D0 /end MEASUREMENT
/begin MEASUREMENT CAN_2_Legs_B.sf_bytesfloats_k.velocity "" FLOAT64_IEEE CAN_2_Legs_CM_double 0 0 -1.7E+308 1.7E+308 ECU_ADDRESS 0x002199D8 /end MEASUREMENT
/begin MEASUREMENT CAN_2_Legs_B.sf_floatsbytes.b "" UBYTE CAN_2_Legs_CM_uint8 0 0 0 255 LAYOUT COLUMN_DIR MATRIX_DIM 8 ECU_ADDRESS 0x002199E8 /end MEASUREMENT
/begin MEASUREMENT CAN_2_Legs_B.sf_floatsbytes_o.b "" UBYTE CAN_2_Legs_CM_uint8 0 0 0 255 LAYOUT COLUMN_DIR MATRIX_DIM 8 ECU_ADDRESS 0x002199C4 /end MEASUREMENT
/begin MEASUREMENT CAN_2_Legs_DW.CANUnpack_ModeSignalID "" SLONG CAN_2_Legs_CM_int_T 0 0 -2147483648 2147483647 ECU_ADDRESS 0x002198A8 /end MEASUREMENT
/begin MEASUREMENT CAN_2_Legs_DW.CANUnpack_ModeSignalID_l "" SLONG CAN_2_Legs_CM_int_T 0 0 -2147483648 2147483647 ECU_ADDRESS 0x002198B8 /end MEASUREMENT
/begin MEASUREMENT CAN_2_Legs_DW.CANUnpack_StatusPortID "" SLONG CAN_2_Legs_CM_int_T 0 0 -2147483648 2147483647 ECU_ADDRESS 0x002198AC /end MEASUREMENT
/begin MEASUREMENT CAN_2_Legs_DW.CANUnpack_StatusPortID_g "" SLONG CAN_2_Legs_CM_int_T 0 0 -2147483648 2147483647 ECU_ADDRESS 0x002198BC /end MEASUREMENT
/begin MEASUREMENT CAN_2_Legs_DW.IfActionSubsystem_SubsysRanBC "" SBYTE CAN_2_Legs_CM_int8 0 0 -128 127 ECU_ADDRESS 0x002198C0 /end MEASUREMENT
/begin MEASUREMENT CAN_2_Legs_DW.IfActionSubsystem_SubsysRanBC_j "" SBYTE CAN_2_Legs_CM_int8 0 0 -128 127 ECU_ADDRESS 0x002198C1 /end MEASUREMENT
/begin COMPU_METHOD CAN_2_Legs_CM_double "" IDENTICAL "%15.10" "" /end COMPU_METHOD
/begin COMPU_METHOD CAN_2_Legs_CM_int8 "" IDENTICAL "%3.0" "" /end COMPU_METHOD
/begin COMPU_METHOD CAN_2_Legs_CM_int_T "" IDENTICAL "customformat" "" /end COMPU_METHOD
/begin COMPU_METHOD CAN_2_Legs_CM_logical "" IDENTICAL "%1.0" "" /end COMPU_METHOD
/begin COMPU_METHOD CAN_2_Legs_CM_uint8 "" IDENTICAL "%3.0" "" /end COMPU_METHOD
/begin RECORD_LAYOUT Scalar_BOOLEAN FNC_VALUES 1 UBYTE COLUMN_DIR DIRECT /end RECORD_LAYOUT
/begin RECORD_LAYOUT Scalar_FLOAT64_IEEE FNC_VALUES 1 FLOAT64_IEEE COLUMN_DIR DIRECT /end RECORD_LAYOUT
/begin RECORD_LAYOUT Scalar_SBYTE FNC_VALUES 1 SBYTE COLUMN_DIR DIRECT /end RECORD_LAYOUT
/begin RECORD_LAYOUT Scalar_SLONG FNC_VALUES 1 SLONG COLUMN_DIR DIRECT /end RECORD_LAYOUT
/begin RECORD_LAYOUT Scalar_UBYTE FNC_VALUES 1 UBYTE COLUMN_DIR DIRECT /end RECORD_LAYOUT
/begin GROUP CAN_2_Legs "CAN_2_Legs" ROOT /end GROUP
/end MODULE
/end PROJECT
