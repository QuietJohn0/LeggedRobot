/******************************************************************************
* ASAP2 file: CAN_2_Legs_stateflow.a2l
* Academic License - for use in teaching, academic research, and meeting
* course requirements at degree granting institutions only. Not for
* government, commercial, or other organizational use.
* Code generation for model "CAN_2_Legs_stateflow".
* Model version : 1.11
* Simulink Coder version : 10.3 R2021a
* C source code generated on : Tue Aug 24 15:02:45 2021
* Target selection: slrealtime.tlc
* Embedded hardware selection: Intel->x86-64 (Linux 64)
* Code generation objectives: Unspecified
* Validation result: Not run
* (add additional file header information here)
******************************************************************************/ ASAP2_VERSION 1 71
/begin PROJECT ProjectName "Project Comment Goes Here"
/begin HEADER "Header Comments go here" /end HEADER
/begin MODULE ModuleName "Module Comment Goes Here"
/begin IF_DATA XCP
 /begin PROTOCOL_LAYER 0x0100 0x03E8 0x00C8 0x0000 0x0000 0x0000 0x0000 0x0000 0xFC 0x0578 BYTE_ORDER_MSB_LAST ADDRESS_GRANULARITY_BYTE OPTIONAL_CMD ALLOC_ODT_ENTRY OPTIONAL_CMD ALLOC_ODT OPTIONAL_CMD ALLOC_DAQ OPTIONAL_CMD FREE_DAQ OPTIONAL_CMD GET_DAQ_RESOLUTION_INFO OPTIONAL_CMD GET_DAQ_PROCESSOR_INFO OPTIONAL_CMD START_STOP_SYNCH OPTIONAL_CMD START_STOP_DAQ_LIST OPTIONAL_CMD SET_DAQ_LIST_MODE OPTIONAL_CMD WRITE_DAQ OPTIONAL_CMD SET_DAQ_PTR OPTIONAL_CMD GET_CAL_PAGE OPTIONAL_CMD SET_CAL_PAGE OPTIONAL_CMD COPY_CAL_PAGE OPTIONAL_CMD SHORT_DOWNLOAD OPTIONAL_CMD DOWNLOAD_MAX OPTIONAL_CMD DOWNLOAD OPTIONAL_CMD SHORT_UPLOAD OPTIONAL_CMD UPLOAD OPTIONAL_CMD SET_MTA /end PROTOCOL_LAYER
 /begin DAQ DYNAMIC 0x0000 0x0080 0x00 OPTIMISATION_TYPE_DEFAULT ADDRESS_EXTENSION_FREE IDENTIFICATION_FIELD_TYPE_RELATIVE_WORD_ALIGNED GRANULARITY_ODT_ENTRY_SIZE_DAQ_BYTE 0xFF OVERLOAD_INDICATION_PID PRESCALER_SUPPORTED /begin STIM GRANULARITY_ODT_ENTRY_SIZE_STIM_BYTE 0xFF /end STIM /begin TIMESTAMP_SUPPORTED 0x0001 SIZE_DWORD UNIT_1US TIMESTAMP_FIXED /end TIMESTAMP_SUPPORTED /begin EVENT "1 ms" "1 ms" 0x0000 DAQ 0xFF 0x01 0x06 0x00 /end EVENT /end DAQ
 /begin XCP_ON_UDP_IP 0x0100 0x15B3 ADDRESS "192.168.7.5" /end XCP_ON_UDP_IP
/end IF_DATA
/begin MOD_PAR "MOD PAR Comment Goes Here"
 /begin MEMORY_SEGMENT CAN_2_Legs_stateflow_cal_impl "CAN_2_Legs_stateflow_cal_impl" DATA FLASH INTERN 0x00217020 0x698 -1 -1 -1 -1 -1
  /begin IF_DATA XCP
   /begin SEGMENT 0x00 0x02 0x00 0x00 0x00
    /begin PAGE 0x00 ECU_ACCESS_DONT_CARE XCP_READ_ACCESS_DONT_CARE XCP_WRITE_ACCESS_NOT_ALLOWED /end PAGE
    /begin PAGE 0x01 ECU_ACCESS_DONT_CARE XCP_READ_ACCESS_DONT_CARE XCP_WRITE_ACCESS_DONT_CARE /end PAGE
   /end SEGMENT
  /end IF_DATA
 /end MEMORY_SEGMENT
/end MOD_PAR
/begin MOD_COMMON "Mod Common Comment Here" BYTE_ORDER MSB_LAST ALIGNMENT_BYTE 1 ALIGNMENT_WORD 2 ALIGNMENT_LONG 8 ALIGNMENT_FLOAT32_IEEE 4 ALIGNMENT_FLOAT64_IEEE 8 ALIGNMENT_INT64 4 /end MOD_COMMON
/begin CHARACTERISTIC CAN_2_Legs_stateflow_cal_impl.CANRead_P1 "" VAL_BLK 0x00217050 Scalar_FLOAT64_IEEE 0 CAN_2_Legs_stateflow_CM_double -1.7E+308 1.7E+308 MATRIX_DIM 6 1 /end CHARACTERISTIC
/begin CHARACTERISTIC CAN_2_Legs_stateflow_cal_impl.CANRead_P1_o "" VAL_BLK 0x002170F8 Scalar_FLOAT64_IEEE 0 CAN_2_Legs_stateflow_CM_double -1.7E+308 1.7E+308 MATRIX_DIM 6 1 /end CHARACTERISTIC
/begin CHARACTERISTIC CAN_2_Legs_stateflow_cal_impl.CANSetup_P1 "" VAL_BLK 0x00217180 Scalar_FLOAT64_IEEE 0 CAN_2_Legs_stateflow_CM_double -1.7E+308 1.7E+308 MATRIX_DIM 40 1 /end CHARACTERISTIC
/begin CHARACTERISTIC CAN_2_Legs_stateflow_cal_impl.CANSetup_P2 "" VALUE 0x002172D0 Scalar_FLOAT64_IEEE 0 CAN_2_Legs_stateflow_CM_double -1.7E+308 1.7E+308 /end CHARACTERISTIC
/begin CHARACTERISTIC CAN_2_Legs_stateflow_cal_impl.CANSetup_P3 "" VALUE 0x002172E8 Scalar_FLOAT64_IEEE 0 CAN_2_Legs_stateflow_CM_double -1.7E+308 1.7E+308 /end CHARACTERISTIC
/begin CHARACTERISTIC CAN_2_Legs_stateflow_cal_impl.CANStatus_P1 "" VALUE 0x00217360 Scalar_FLOAT64_IEEE 0 CAN_2_Legs_stateflow_CM_double -1.7E+308 1.7E+308 /end CHARACTERISTIC
/begin CHARACTERISTIC CAN_2_Legs_stateflow_cal_impl.CANStatus_P10 "" VALUE 0x00217438 Scalar_FLOAT64_IEEE 0 CAN_2_Legs_stateflow_CM_double -1.7E+308 1.7E+308 /end CHARACTERISTIC
/begin CHARACTERISTIC CAN_2_Legs_stateflow_cal_impl.CANStatus_P11 "" VALUE 0x00217450 Scalar_FLOAT64_IEEE 0 CAN_2_Legs_stateflow_CM_double -1.7E+308 1.7E+308 /end CHARACTERISTIC
/begin CHARACTERISTIC CAN_2_Legs_stateflow_cal_impl.CANStatus_P12 "" VALUE 0x00217468 Scalar_FLOAT64_IEEE 0 CAN_2_Legs_stateflow_CM_double -1.7E+308 1.7E+308 /end CHARACTERISTIC
/begin CHARACTERISTIC CAN_2_Legs_stateflow_cal_impl.CANStatus_P13 "" VALUE 0x00217480 Scalar_FLOAT64_IEEE 0 CAN_2_Legs_stateflow_CM_double -1.7E+308 1.7E+308 /end CHARACTERISTIC
/begin CHARACTERISTIC CAN_2_Legs_stateflow_cal_impl.CANStatus_P14 "" VALUE 0x00217498 Scalar_FLOAT64_IEEE 0 CAN_2_Legs_stateflow_CM_double -1.7E+308 1.7E+308 /end CHARACTERISTIC
/begin CHARACTERISTIC CAN_2_Legs_stateflow_cal_impl.CANStatus_P15 "" VALUE 0x002174B0 Scalar_FLOAT64_IEEE 0 CAN_2_Legs_stateflow_CM_double -1.7E+308 1.7E+308 /end CHARACTERISTIC
/begin CHARACTERISTIC CAN_2_Legs_stateflow_cal_impl.CANStatus_P16 "" VALUE 0x002174C8 Scalar_FLOAT64_IEEE 0 CAN_2_Legs_stateflow_CM_double -1.7E+308 1.7E+308 /end CHARACTERISTIC
/begin CHARACTERISTIC CAN_2_Legs_stateflow_cal_impl.CANStatus_P17 "" VALUE 0x002174E0 Scalar_FLOAT64_IEEE 0 CAN_2_Legs_stateflow_CM_double -1.7E+308 1.7E+308 /end CHARACTERISTIC
/begin CHARACTERISTIC CAN_2_Legs_stateflow_cal_impl.CANStatus_P18 "" VALUE 0x002174F8 Scalar_FLOAT64_IEEE 0 CAN_2_Legs_stateflow_CM_double -1.7E+308 1.7E+308 /end CHARACTERISTIC
/begin CHARACTERISTIC CAN_2_Legs_stateflow_cal_impl.CANStatus_P19 "" VALUE 0x00217510 Scalar_FLOAT64_IEEE 0 CAN_2_Legs_stateflow_CM_double -1.7E+308 1.7E+308 /end CHARACTERISTIC
/begin CHARACTERISTIC CAN_2_Legs_stateflow_cal_impl.CANStatus_P2 "" VALUE 0x00217378 Scalar_FLOAT64_IEEE 0 CAN_2_Legs_stateflow_CM_double -1.7E+308 1.7E+308 /end CHARACTERISTIC
/begin CHARACTERISTIC CAN_2_Legs_stateflow_cal_impl.CANStatus_P20 "" VALUE 0x00217528 Scalar_FLOAT64_IEEE 0 CAN_2_Legs_stateflow_CM_double -1.7E+308 1.7E+308 /end CHARACTERISTIC
/begin CHARACTERISTIC CAN_2_Legs_stateflow_cal_impl.CANStatus_P21 "" VALUE 0x00217540 Scalar_FLOAT64_IEEE 0 CAN_2_Legs_stateflow_CM_double -1.7E+308 1.7E+308 /end CHARACTERISTIC
/begin CHARACTERISTIC CAN_2_Legs_stateflow_cal_impl.CANStatus_P22 "" VALUE 0x00217558 Scalar_FLOAT64_IEEE 0 CAN_2_Legs_stateflow_CM_double -1.7E+308 1.7E+308 /end CHARACTERISTIC
/begin CHARACTERISTIC CAN_2_Legs_stateflow_cal_impl.CANStatus_P23 "" VALUE 0x00217570 Scalar_FLOAT64_IEEE 0 CAN_2_Legs_stateflow_CM_double -1.7E+308 1.7E+308 /end CHARACTERISTIC
/begin CHARACTERISTIC CAN_2_Legs_stateflow_cal_impl.CANStatus_P24 "" VALUE 0x00217588 Scalar_FLOAT64_IEEE 0 CAN_2_Legs_stateflow_CM_double -1.7E+308 1.7E+308 /end CHARACTERISTIC
/begin CHARACTERISTIC CAN_2_Legs_stateflow_cal_impl.CANStatus_P25 "" VALUE 0x002175A0 Scalar_FLOAT64_IEEE 0 CAN_2_Legs_stateflow_CM_double -1.7E+308 1.7E+308 /end CHARACTERISTIC
/begin CHARACTERISTIC CAN_2_Legs_stateflow_cal_impl.CANStatus_P26 "" VALUE 0x002175B8 Scalar_FLOAT64_IEEE 0 CAN_2_Legs_stateflow_CM_double -1.7E+308 1.7E+308 /end CHARACTERISTIC
/begin CHARACTERISTIC CAN_2_Legs_stateflow_cal_impl.CANStatus_P27 "" VALUE 0x002175D0 Scalar_FLOAT64_IEEE 0 CAN_2_Legs_stateflow_CM_double -1.7E+308 1.7E+308 /end CHARACTERISTIC
/begin CHARACTERISTIC CAN_2_Legs_stateflow_cal_impl.CANStatus_P28 "" VALUE 0x002175E8 Scalar_FLOAT64_IEEE 0 CAN_2_Legs_stateflow_CM_double -1.7E+308 1.7E+308 /end CHARACTERISTIC
/begin CHARACTERISTIC CAN_2_Legs_stateflow_cal_impl.CANStatus_P29 "" VALUE 0x00217600 Scalar_FLOAT64_IEEE 0 CAN_2_Legs_stateflow_CM_double -1.7E+308 1.7E+308 /end CHARACTERISTIC
/begin CHARACTERISTIC CAN_2_Legs_stateflow_cal_impl.CANStatus_P3 "" VALUE 0x00217390 Scalar_FLOAT64_IEEE 0 CAN_2_Legs_stateflow_CM_double -1.7E+308 1.7E+308 /end CHARACTERISTIC
/begin CHARACTERISTIC CAN_2_Legs_stateflow_cal_impl.CANStatus_P30 "" VALUE 0x00217618 Scalar_FLOAT64_IEEE 0 CAN_2_Legs_stateflow_CM_double -1.7E+308 1.7E+308 /end CHARACTERISTIC
/begin CHARACTERISTIC CAN_2_Legs_stateflow_cal_impl.CANStatus_P31 "" VALUE 0x00217630 Scalar_FLOAT64_IEEE 0 CAN_2_Legs_stateflow_CM_double -1.7E+308 1.7E+308 /end CHARACTERISTIC
/begin CHARACTERISTIC CAN_2_Legs_stateflow_cal_impl.CANStatus_P32 "" VALUE 0x00217648 Scalar_FLOAT64_IEEE 0 CAN_2_Legs_stateflow_CM_double -1.7E+308 1.7E+308 /end CHARACTERISTIC
/begin CHARACTERISTIC CAN_2_Legs_stateflow_cal_impl.CANStatus_P33 "" VALUE 0x00217660 Scalar_FLOAT64_IEEE 0 CAN_2_Legs_stateflow_CM_double -1.7E+308 1.7E+308 /end CHARACTERISTIC
/begin CHARACTERISTIC CAN_2_Legs_stateflow_cal_impl.CANStatus_P34 "" VALUE 0x00217678 Scalar_FLOAT64_IEEE 0 CAN_2_Legs_stateflow_CM_double -1.7E+308 1.7E+308 /end CHARACTERISTIC
/begin CHARACTERISTIC CAN_2_Legs_stateflow_cal_impl.CANStatus_P4 "" VALUE 0x002173A8 Scalar_FLOAT64_IEEE 0 CAN_2_Legs_stateflow_CM_double -1.7E+308 1.7E+308 /end CHARACTERISTIC
/begin CHARACTERISTIC CAN_2_Legs_stateflow_cal_impl.CANStatus_P5 "" VALUE 0x002173C0 Scalar_FLOAT64_IEEE 0 CAN_2_Legs_stateflow_CM_double -1.7E+308 1.7E+308 /end CHARACTERISTIC
/begin CHARACTERISTIC CAN_2_Legs_stateflow_cal_impl.CANStatus_P6 "" VALUE 0x002173D8 Scalar_FLOAT64_IEEE 0 CAN_2_Legs_stateflow_CM_double -1.7E+308 1.7E+308 /end CHARACTERISTIC
/begin CHARACTERISTIC CAN_2_Legs_stateflow_cal_impl.CANStatus_P7 "" VALUE 0x002173F0 Scalar_FLOAT64_IEEE 0 CAN_2_Legs_stateflow_CM_double -1.7E+308 1.7E+308 /end CHARACTERISTIC
/begin CHARACTERISTIC CAN_2_Legs_stateflow_cal_impl.CANStatus_P8 "" VALUE 0x00217408 Scalar_FLOAT64_IEEE 0 CAN_2_Legs_stateflow_CM_double -1.7E+308 1.7E+308 /end CHARACTERISTIC
/begin CHARACTERISTIC CAN_2_Legs_stateflow_cal_impl.CANStatus_P9 "" VALUE 0x00217420 Scalar_FLOAT64_IEEE 0 CAN_2_Legs_stateflow_CM_double -1.7E+308 1.7E+308 /end CHARACTERISTIC
/begin CHARACTERISTIC CAN_2_Legs_stateflow_cal_impl.CANWrite1_P1 "" VAL_BLK 0x00217090 Scalar_FLOAT64_IEEE 0 CAN_2_Legs_stateflow_CM_double -1.7E+308 1.7E+308 MATRIX_DIM 7 1 /end CHARACTERISTIC
/begin CHARACTERISTIC CAN_2_Legs_stateflow_cal_impl.CANWrite1_P1_j "" VAL_BLK 0x00217138 Scalar_FLOAT64_IEEE 0 CAN_2_Legs_stateflow_CM_double -1.7E+308 1.7E+308 MATRIX_DIM 7 1 /end CHARACTERISTIC
/begin CHARACTERISTIC CAN_2_Legs_stateflow_cal_impl.Constant10_Value "" VALUE 0x00217340 Scalar_FLOAT64_IEEE 0 CAN_2_Legs_stateflow_CM_double -1.7E+308 1.7E+308 /end CHARACTERISTIC
/begin CHARACTERISTIC CAN_2_Legs_stateflow_cal_impl.Constant11_Value "" VALUE 0x00217348 Scalar_FLOAT64_IEEE 0 CAN_2_Legs_stateflow_CM_double -1.7E+308 1.7E+308 /end CHARACTERISTIC
/begin CHARACTERISTIC CAN_2_Legs_stateflow_cal_impl.Constant1_Value "" VALUE 0x002172F0 Scalar_FLOAT64_IEEE 0 CAN_2_Legs_stateflow_CM_double -1.7E+308 1.7E+308 /end CHARACTERISTIC
/begin CHARACTERISTIC CAN_2_Legs_stateflow_cal_impl.Constant1_Value_e "" VAL_BLK 0x002176A2 Scalar_UBYTE 0 CAN_2_Legs_stateflow_CM_uint8 0 255 MATRIX_DIM 8 1 /end CHARACTERISTIC
/begin CHARACTERISTIC CAN_2_Legs_stateflow_cal_impl.Constant1_Value_m "" VAL_BLK 0x00217689 Scalar_UBYTE 0 CAN_2_Legs_stateflow_CM_uint8 0 255 MATRIX_DIM 8 1 /end CHARACTERISTIC
/begin CHARACTERISTIC CAN_2_Legs_stateflow_cal_impl.Constant2_Value "" VALUE 0x00217308 Scalar_FLOAT64_IEEE 0 CAN_2_Legs_stateflow_CM_double -1.7E+308 1.7E+308 /end CHARACTERISTIC
/begin CHARACTERISTIC CAN_2_Legs_stateflow_cal_impl.Constant2_Value_g "" VAL_BLK 0x00217691 Scalar_UBYTE 0 CAN_2_Legs_stateflow_CM_uint8 0 255 MATRIX_DIM 8 1 /end CHARACTERISTIC
/begin CHARACTERISTIC CAN_2_Legs_stateflow_cal_impl.Constant2_Value_k "" VAL_BLK 0x002176AA Scalar_UBYTE 0 CAN_2_Legs_stateflow_CM_uint8 0 255 MATRIX_DIM 8 1 /end CHARACTERISTIC
/begin CHARACTERISTIC CAN_2_Legs_stateflow_cal_impl.Constant3_Value "" VALUE 0x00217310 Scalar_FLOAT64_IEEE 0 CAN_2_Legs_stateflow_CM_double -1.7E+308 1.7E+308 /end CHARACTERISTIC
/begin CHARACTERISTIC CAN_2_Legs_stateflow_cal_impl.Constant4_Value "" VALUE 0x00217318 Scalar_FLOAT64_IEEE 0 CAN_2_Legs_stateflow_CM_double -1.7E+308 1.7E+308 /end CHARACTERISTIC
/begin CHARACTERISTIC CAN_2_Legs_stateflow_cal_impl.Constant5_Value "" VALUE 0x00217320 Scalar_FLOAT64_IEEE 0 CAN_2_Legs_stateflow_CM_double -1.7E+308 1.7E+308 /end CHARACTERISTIC
/begin CHARACTERISTIC CAN_2_Legs_stateflow_cal_impl.Constant8_Value "" VALUE 0x00217330 Scalar_FLOAT64_IEEE 0 CAN_2_Legs_stateflow_CM_double -1.7E+308 1.7E+308 /end CHARACTERISTIC
/begin CHARACTERISTIC CAN_2_Legs_stateflow_cal_impl.Constant9_Value "" VALUE 0x00217338 Scalar_FLOAT64_IEEE 0 CAN_2_Legs_stateflow_CM_double -1.7E+308 1.7E+308 /end CHARACTERISTIC
/begin CHARACTERISTIC CAN_2_Legs_stateflow_cal_impl.Constant_Value "" VALUE 0x00217300 Scalar_FLOAT64_IEEE 0 CAN_2_Legs_stateflow_CM_double -1.7E+308 1.7E+308 /end CHARACTERISTIC
/begin CHARACTERISTIC CAN_2_Legs_stateflow_cal_impl.Constant_Value_i "" VAL_BLK 0x0021769A Scalar_UBYTE 0 CAN_2_Legs_stateflow_CM_uint8 0 255 MATRIX_DIM 8 1 /end CHARACTERISTIC
/begin CHARACTERISTIC CAN_2_Legs_stateflow_cal_impl.Constant_Value_l "" VAL_BLK 0x00217681 Scalar_UBYTE 0 CAN_2_Legs_stateflow_CM_uint8 0 255 MATRIX_DIM 8 1 /end CHARACTERISTIC
/begin CHARACTERISTIC CAN_2_Legs_stateflow_cal_impl.Delay_InitialCondition "" VALUE 0x002172F8 Scalar_FLOAT64_IEEE 0 CAN_2_Legs_stateflow_CM_double -1.7E+308 1.7E+308 /end CHARACTERISTIC
/begin CHARACTERISTIC CAN_2_Legs_stateflow_cal_impl.Gain_Gain "" VALUE 0x00217328 Scalar_FLOAT64_IEEE 0 CAN_2_Legs_stateflow_CM_double -1.7E+308 1.7E+308 /end CHARACTERISTIC
/begin CHARACTERISTIC CAN_2_Legs_stateflow_cal_impl.Outport1_Y0 "" VALUE 0x00217028 Scalar_FLOAT64_IEEE 0 CAN_2_Legs_stateflow_CM_double -1.7E+308 1.7E+308 /end CHARACTERISTIC
/begin CHARACTERISTIC CAN_2_Legs_stateflow_cal_impl.Outport1_Y0_c "" VALUE 0x002170D0 Scalar_FLOAT64_IEEE 0 CAN_2_Legs_stateflow_CM_double -1.7E+308 1.7E+308 /end CHARACTERISTIC
/begin CHARACTERISTIC CAN_2_Legs_stateflow_cal_impl.Outport2_Y0 "" VALUE 0x00217030 Scalar_FLOAT64_IEEE 0 CAN_2_Legs_stateflow_CM_double -1.7E+308 1.7E+308 /end CHARACTERISTIC
/begin CHARACTERISTIC CAN_2_Legs_stateflow_cal_impl.Outport2_Y0_j "" VALUE 0x002170D8 Scalar_FLOAT64_IEEE 0 CAN_2_Legs_stateflow_CM_double -1.7E+308 1.7E+308 /end CHARACTERISTIC
/begin CHARACTERISTIC CAN_2_Legs_stateflow_cal_impl.Outport3_Y0 "" VALUE 0x00217038 Scalar_FLOAT64_IEEE 0 CAN_2_Legs_stateflow_CM_double -1.7E+308 1.7E+308 /end CHARACTERISTIC
/begin CHARACTERISTIC CAN_2_Legs_stateflow_cal_impl.Outport3_Y0_c "" VALUE 0x002170E0 Scalar_FLOAT64_IEEE 0 CAN_2_Legs_stateflow_CM_double -1.7E+308 1.7E+308 /end CHARACTERISTIC
/begin CHARACTERISTIC CAN_2_Legs_stateflow_cal_impl.Outport4_Y0 "" VALUE 0x00217680 Scalar_UBYTE 0 CAN_2_Legs_stateflow_CM_uint8 0 255 /end CHARACTERISTIC
/begin CHARACTERISTIC CAN_2_Legs_stateflow_cal_impl.Outport4_Y0_l "" VALUE 0x00217699 Scalar_UBYTE 0 CAN_2_Legs_stateflow_CM_uint8 0 255 /end CHARACTERISTIC
/begin CHARACTERISTIC CAN_2_Legs_stateflow_cal_impl.Outport_Y0 "" VALUE 0x00217020 Scalar_FLOAT64_IEEE 0 CAN_2_Legs_stateflow_CM_double -1.7E+308 1.7E+308 /end CHARACTERISTIC
/begin CHARACTERISTIC CAN_2_Legs_stateflow_cal_impl.Outport_Y0_e "" VALUE 0x002170C8 Scalar_FLOAT64_IEEE 0 CAN_2_Legs_stateflow_CM_double -1.7E+308 1.7E+308 /end CHARACTERISTIC
/begin MEASUREMENT CAN_2_Legs_stateflow_B.BytePacking "" UBYTE CAN_2_Legs_stateflow_CM_uint8 0 0 0 255 LAYOUT COLUMN_DIR MATRIX_DIM 8 ECU_ADDRESS 0x0021AA58 /end MEASUREMENT
/begin MEASUREMENT CAN_2_Legs_stateflow_B.BytePacking_o "" UBYTE CAN_2_Legs_stateflow_CM_uint8 0 0 0 255 LAYOUT COLUMN_DIR MATRIX_DIM 8 ECU_ADDRESS 0x0021AA69 /end MEASUREMENT
/begin MEASUREMENT CAN_2_Legs_stateflow_B.CANRead_o1 "" UBYTE CAN_2_Legs_stateflow_CM_logical 0 0 0 1 ECU_ADDRESS 0x0021AA72 /end MEASUREMENT
/begin MEASUREMENT CAN_2_Legs_stateflow_B.CANRead_o1_e "" UBYTE CAN_2_Legs_stateflow_CM_logical 0 0 0 1 ECU_ADDRESS 0x0021AA73 /end MEASUREMENT
/begin MEASUREMENT CAN_2_Legs_stateflow_B.CANUnpack_o1 "" FLOAT64_IEEE CAN_2_Legs_stateflow_CM_double 0 0 -1.7E+308 1.7E+308 ECU_ADDRESS 0x0021A9D0 /end MEASUREMENT
/begin MEASUREMENT CAN_2_Legs_stateflow_B.CANUnpack_o1_o "" FLOAT64_IEEE CAN_2_Legs_stateflow_CM_double 0 0 -1.7E+308 1.7E+308 ECU_ADDRESS 0x0021A9F0 /end MEASUREMENT
/begin MEASUREMENT CAN_2_Legs_stateflow_B.CANUnpack_o2 "" FLOAT64_IEEE CAN_2_Legs_stateflow_CM_double 0 0 -1.7E+308 1.7E+308 ECU_ADDRESS 0x0021A9D8 /end MEASUREMENT
/begin MEASUREMENT CAN_2_Legs_stateflow_B.CANUnpack_o2_m "" FLOAT64_IEEE CAN_2_Legs_stateflow_CM_double 0 0 -1.7E+308 1.7E+308 ECU_ADDRESS 0x0021A9F8 /end MEASUREMENT
/begin MEASUREMENT CAN_2_Legs_stateflow_B.CANUnpack_o3 "" FLOAT64_IEEE CAN_2_Legs_stateflow_CM_double 0 0 -1.7E+308 1.7E+308 ECU_ADDRESS 0x0021A9E0 /end MEASUREMENT
/begin MEASUREMENT CAN_2_Legs_stateflow_B.CANUnpack_o3_o "" FLOAT64_IEEE CAN_2_Legs_stateflow_CM_double 0 0 -1.7E+308 1.7E+308 ECU_ADDRESS 0x0021AA00 /end MEASUREMENT
/begin MEASUREMENT CAN_2_Legs_stateflow_B.CANUnpack_o4 "" FLOAT64_IEEE CAN_2_Legs_stateflow_CM_double 0 0 -1.7E+308 1.7E+308 ECU_ADDRESS 0x0021A9E8 /end MEASUREMENT
/begin MEASUREMENT CAN_2_Legs_stateflow_B.CANUnpack_o4_f "" FLOAT64_IEEE CAN_2_Legs_stateflow_CM_double 0 0 -1.7E+308 1.7E+308 ECU_ADDRESS 0x0021AA08 /end MEASUREMENT
/begin MEASUREMENT CAN_2_Legs_stateflow_B.CANUnpack_o5 "" UBYTE CAN_2_Legs_stateflow_CM_uint8 0 0 0 255 ECU_ADDRESS 0x0021AA60 /end MEASUREMENT
/begin MEASUREMENT CAN_2_Legs_stateflow_B.CANUnpack_o5_m "" UBYTE CAN_2_Legs_stateflow_CM_uint8 0 0 0 255 ECU_ADDRESS 0x0021AA71 /end MEASUREMENT
/begin MEASUREMENT CAN_2_Legs_stateflow_B.Constant "" FLOAT64_IEEE CAN_2_Legs_stateflow_CM_double 0 0 -1.7E+308 1.7E+308 ECU_ADDRESS 0x0021A9B0 /end MEASUREMENT
/begin MEASUREMENT CAN_2_Legs_stateflow_B.Constant1 "" FLOAT64_IEEE CAN_2_Legs_stateflow_CM_double 0 0 -1.7E+308 1.7E+308 ECU_ADDRESS 0x0021A9A0 /end MEASUREMENT
/begin MEASUREMENT CAN_2_Legs_stateflow_B.Constant2 "" FLOAT64_IEEE CAN_2_Legs_stateflow_CM_double 0 0 -1.7E+308 1.7E+308 ECU_ADDRESS 0x0021A9B8 /end MEASUREMENT
/begin MEASUREMENT CAN_2_Legs_stateflow_B.Constant8 "" FLOAT64_IEEE CAN_2_Legs_stateflow_CM_double 0 0 -1.7E+308 1.7E+308 ECU_ADDRESS 0x0021A9C8 /end MEASUREMENT
/begin MEASUREMENT CAN_2_Legs_stateflow_B.Delay "" FLOAT64_IEEE CAN_2_Legs_stateflow_CM_double 0 0 -1.7E+308 1.7E+308 ECU_ADDRESS 0x0021A9A8 /end MEASUREMENT
/begin MEASUREMENT CAN_2_Legs_stateflow_B.GRF "" FLOAT64_IEEE CAN_2_Legs_stateflow_CM_double 0 0 -1.7E+308 1.7E+308 ECU_ADDRESS 0x0021AA28 /end MEASUREMENT
/begin MEASUREMENT CAN_2_Legs_stateflow_B.Gain "" FLOAT64_IEEE CAN_2_Legs_stateflow_CM_double 0 0 -1.7E+308 1.7E+308 ECU_ADDRESS 0x0021A9C0 /end MEASUREMENT
/begin MEASUREMENT CAN_2_Legs_stateflow_B.MultiportSwitch "" UBYTE CAN_2_Legs_stateflow_CM_uint8 0 0 0 255 LAYOUT COLUMN_DIR MATRIX_DIM 8 ECU_ADDRESS 0x0021AA50 /end MEASUREMENT
/begin MEASUREMENT CAN_2_Legs_stateflow_B.MultiportSwitch_f "" UBYTE CAN_2_Legs_stateflow_CM_uint8 0 0 0 255 LAYOUT COLUMN_DIR MATRIX_DIM 8 ECU_ADDRESS 0x0021AA61 /end MEASUREMENT
/begin MEASUREMENT CAN_2_Legs_stateflow_B.TmpSignalConversionAtSFunctionI "" FLOAT64_IEEE CAN_2_Legs_stateflow_CM_double 0 0 -1.7E+308 1.7E+308 LAYOUT COLUMN_DIR MATRIX_DIM 2 ECU_ADDRESS 0x0021AA10 /end MEASUREMENT
/begin MEASUREMENT CAN_2_Legs_stateflow_B.c "" FLOAT64_IEEE CAN_2_Legs_stateflow_CM_double 0 0 -1.7E+308 1.7E+308 ECU_ADDRESS 0x0021AA48 /end MEASUREMENT
/begin MEASUREMENT CAN_2_Legs_stateflow_B.danger "" FLOAT64_IEEE CAN_2_Legs_stateflow_CM_double 0 0 -1.7E+308 1.7E+308 ECU_ADDRESS 0x0021AA20 /end MEASUREMENT
/begin MEASUREMENT CAN_2_Legs_stateflow_B.sf_bytesfloats.I_ff "" FLOAT64_IEEE CAN_2_Legs_stateflow_CM_double 0 0 -1.7E+308 1.7E+308 ECU_ADDRESS 0x0021AAB0 /end MEASUREMENT
/begin MEASUREMENT CAN_2_Legs_stateflow_B.sf_bytesfloats.position "" FLOAT64_IEEE CAN_2_Legs_stateflow_CM_double 0 0 -1.7E+308 1.7E+308 ECU_ADDRESS 0x0021AAA0 /end MEASUREMENT
/begin MEASUREMENT CAN_2_Legs_stateflow_B.sf_bytesfloats.velocity "" FLOAT64_IEEE CAN_2_Legs_stateflow_CM_double 0 0 -1.7E+308 1.7E+308 ECU_ADDRESS 0x0021AAA8 /end MEASUREMENT
/begin MEASUREMENT CAN_2_Legs_stateflow_B.sf_bytesfloats_k.I_ff "" FLOAT64_IEEE CAN_2_Legs_stateflow_CM_double 0 0 -1.7E+308 1.7E+308 ECU_ADDRESS 0x0021AA90 /end MEASUREMENT
/begin MEASUREMENT CAN_2_Legs_stateflow_B.sf_bytesfloats_k.position "" FLOAT64_IEEE CAN_2_Legs_stateflow_CM_double 0 0 -1.7E+308 1.7E+308 ECU_ADDRESS 0x0021AA80 /end MEASUREMENT
/begin MEASUREMENT CAN_2_Legs_stateflow_B.sf_bytesfloats_k.velocity "" FLOAT64_IEEE CAN_2_Legs_stateflow_CM_double 0 0 -1.7E+308 1.7E+308 ECU_ADDRESS 0x0021AA88 /end MEASUREMENT
/begin MEASUREMENT CAN_2_Legs_stateflow_B.sf_floatsbytes.b "" UBYTE CAN_2_Legs_stateflow_CM_uint8 0 0 0 255 LAYOUT COLUMN_DIR MATRIX_DIM 8 ECU_ADDRESS 0x0021AA98 /end MEASUREMENT
/begin MEASUREMENT CAN_2_Legs_stateflow_B.sf_floatsbytes_o.b "" UBYTE CAN_2_Legs_stateflow_CM_uint8 0 0 0 255 LAYOUT COLUMN_DIR MATRIX_DIM 8 ECU_ADDRESS 0x0021AA74 /end MEASUREMENT
/begin MEASUREMENT CAN_2_Legs_stateflow_B.stop "" FLOAT64_IEEE CAN_2_Legs_stateflow_CM_double 0 0 -1.7E+308 1.7E+308 ECU_ADDRESS 0x0021AA30 /end MEASUREMENT
/begin MEASUREMENT CAN_2_Legs_stateflow_B.theta1 "" FLOAT64_IEEE CAN_2_Legs_stateflow_CM_double 0 0 -1.7E+308 1.7E+308 ECU_ADDRESS 0x0021AA38 /end MEASUREMENT
/begin MEASUREMENT CAN_2_Legs_stateflow_B.theta2 "" FLOAT64_IEEE CAN_2_Legs_stateflow_CM_double 0 0 -1.7E+308 1.7E+308 ECU_ADDRESS 0x0021AA40 /end MEASUREMENT
/begin MEASUREMENT CAN_2_Legs_stateflow_DW.CANUnpack_ModeSignalID "" SLONG CAN_2_Legs_stateflow_CM_int_T 0 0 -2147483648 2147483647 ECU_ADDRESS 0x0021A90C /end MEASUREMENT
/begin MEASUREMENT CAN_2_Legs_stateflow_DW.CANUnpack_ModeSignalID_l "" SLONG CAN_2_Legs_stateflow_CM_int_T 0 0 -2147483648 2147483647 ECU_ADDRESS 0x0021A91C /end MEASUREMENT
/begin MEASUREMENT CAN_2_Legs_stateflow_DW.CANUnpack_StatusPortID "" SLONG CAN_2_Legs_stateflow_CM_int_T 0 0 -2147483648 2147483647 ECU_ADDRESS 0x0021A910 /end MEASUREMENT
/begin MEASUREMENT CAN_2_Legs_stateflow_DW.CANUnpack_StatusPortID_g "" SLONG CAN_2_Legs_stateflow_CM_int_T 0 0 -2147483648 2147483647 ECU_ADDRESS 0x0021A920 /end MEASUREMENT
/begin MEASUREMENT CAN_2_Legs_stateflow_DW.Delay_DSTATE "" FLOAT64_IEEE CAN_2_Legs_stateflow_CM_double 0 0 -1.7E+308 1.7E+308 ECU_ADDRESS 0x0021A760 /end MEASUREMENT
/begin MEASUREMENT CAN_2_Legs_stateflow_DW.IfActionSubsystem_SubsysRanBC "" SBYTE CAN_2_Legs_stateflow_CM_int8 0 0 -128 127 ECU_ADDRESS 0x0021A926 /end MEASUREMENT
/begin MEASUREMENT CAN_2_Legs_stateflow_DW.IfActionSubsystem_SubsysRanBC_j "" SBYTE CAN_2_Legs_stateflow_CM_int8 0 0 -128 127 ECU_ADDRESS 0x0021A927 /end MEASUREMENT
/begin MEASUREMENT CAN_2_Legs_stateflow_DW.done "" FLOAT64_IEEE CAN_2_Legs_stateflow_CM_double 0 0 -1.7E+308 1.7E+308 ECU_ADDRESS 0x0021A768 /end MEASUREMENT
/begin MEASUREMENT CAN_2_Legs_stateflow_DW.is_Command "" ULONG CAN_2_Legs_stateflow_CM_uint32 0 0 0 2147483646 ECU_ADDRESS 0x0021A878 /end MEASUREMENT
/begin MEASUREMENT CAN_2_Legs_stateflow_DW.is_active_c7_CAN_2_Legs_statefl "" UBYTE CAN_2_Legs_stateflow_CM_uint8 0 0 0 255 ECU_ADDRESS 0x0021A928 /end MEASUREMENT
/begin MEASUREMENT CAN_2_Legs_stateflow_DW.is_c7_CAN_2_Legs_stateflow "" ULONG CAN_2_Legs_stateflow_CM_uint32 0 0 0 2147483646 ECU_ADDRESS 0x0021A874 /end MEASUREMENT
/begin MEASUREMENT CAN_2_Legs_stateflow_DW.pf "" FLOAT64_IEEE CAN_2_Legs_stateflow_CM_double 0 0 -1.7E+308 1.7E+308 ECU_ADDRESS 0x0021A770 /end MEASUREMENT
/begin MEASUREMENT CAN_2_Legs_stateflow_DW.po "" FLOAT64_IEEE CAN_2_Legs_stateflow_CM_double 0 0 -1.7E+308 1.7E+308 ECU_ADDRESS 0x0021A778 /end MEASUREMENT
/begin MEASUREMENT CAN_2_Legs_stateflow_DW.sfEvent "" SLONG CAN_2_Legs_stateflow_CM_int32 0 0 -2147483648 2147483647 ECU_ADDRESS 0x0021A870 /end MEASUREMENT
/begin MEASUREMENT CAN_2_Legs_stateflow_DW.slope "" FLOAT64_IEEE CAN_2_Legs_stateflow_CM_double 0 0 -1.7E+308 1.7E+308 ECU_ADDRESS 0x0021A780 /end MEASUREMENT
/begin MEASUREMENT CAN_2_Legs_stateflow_DW.temporalCounter_i1 "" UWORD CAN_2_Legs_stateflow_CM_uint16 0 0 0 65535 ECU_ADDRESS 0x0021A924 /end MEASUREMENT
/begin MEASUREMENT CAN_2_Legs_stateflow_DW.to "" FLOAT64_IEEE CAN_2_Legs_stateflow_CM_double 0 0 -1.7E+308 1.7E+308 ECU_ADDRESS 0x0021A790 /end MEASUREMENT
/begin MEASUREMENT CAN_2_Legs_stateflow_DW.tstep "" FLOAT64_IEEE CAN_2_Legs_stateflow_CM_double 0 0 -1.7E+308 1.7E+308 ECU_ADDRESS 0x0021A788 /end MEASUREMENT
/begin COMPU_METHOD CAN_2_Legs_stateflow_CM_double "" IDENTICAL "%15.10" "" /end COMPU_METHOD
/begin COMPU_METHOD CAN_2_Legs_stateflow_CM_int32 "" IDENTICAL "%10.0" "" /end COMPU_METHOD
/begin COMPU_METHOD CAN_2_Legs_stateflow_CM_int8 "" IDENTICAL "%3.0" "" /end COMPU_METHOD
/begin COMPU_METHOD CAN_2_Legs_stateflow_CM_int_T "" IDENTICAL "customformat" "" /end COMPU_METHOD
/begin COMPU_METHOD CAN_2_Legs_stateflow_CM_logical "" IDENTICAL "%1.0" "" /end COMPU_METHOD
/begin COMPU_METHOD CAN_2_Legs_stateflow_CM_uint16 "" IDENTICAL "%5.0" "" /end COMPU_METHOD
/begin COMPU_METHOD CAN_2_Legs_stateflow_CM_uint32 "" IDENTICAL "%10.0" "" /end COMPU_METHOD
/begin COMPU_METHOD CAN_2_Legs_stateflow_CM_uint8 "" IDENTICAL "%3.0" "" /end COMPU_METHOD
/begin RECORD_LAYOUT Scalar_BOOLEAN FNC_VALUES 1 UBYTE COLUMN_DIR DIRECT /end RECORD_LAYOUT
/begin RECORD_LAYOUT Scalar_FLOAT64_IEEE FNC_VALUES 1 FLOAT64_IEEE COLUMN_DIR DIRECT /end RECORD_LAYOUT
/begin RECORD_LAYOUT Scalar_SBYTE FNC_VALUES 1 SBYTE COLUMN_DIR DIRECT /end RECORD_LAYOUT
/begin RECORD_LAYOUT Scalar_SLONG FNC_VALUES 1 SLONG COLUMN_DIR DIRECT /end RECORD_LAYOUT
/begin RECORD_LAYOUT Scalar_UBYTE FNC_VALUES 1 UBYTE COLUMN_DIR DIRECT /end RECORD_LAYOUT
/begin RECORD_LAYOUT Scalar_ULONG FNC_VALUES 1 ULONG COLUMN_DIR DIRECT /end RECORD_LAYOUT
/begin RECORD_LAYOUT Scalar_UWORD FNC_VALUES 1 UWORD COLUMN_DIR DIRECT /end RECORD_LAYOUT
/begin GROUP CAN_2_Legs_stateflow "CAN_2_Legs_stateflow" ROOT /end GROUP
/end MODULE
/end PROJECT
