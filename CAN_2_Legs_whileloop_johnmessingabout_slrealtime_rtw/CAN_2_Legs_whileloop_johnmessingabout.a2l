/******************************************************************************
* ASAP2 file: CAN_2_Legs_whileloop_johnmessingabout.a2l
* Academic License - for use in teaching, academic research, and meeting
* course requirements at degree granting institutions only. Not for
* government, commercial, or other organizational use.
* Code generation for model "CAN_2_Legs_whileloop_johnmessingabout".
* Model version : 1.14
* Simulink Coder version : 10.3 R2021a
* C source code generated on : Wed Aug 25 18:14:36 2021
* Target selection: slrealtime.tlc
* Embedded hardware selection: Intel->x86-64 (Linux 64)
* Code generation objectives: Unspecified
* Validation result: Not run
* (add additional file header information here)
******************************************************************************/ ASAP2_VERSION 1 71
/begin PROJECT ProjectName "Project Comment Goes Here"
/begin HEADER "Header Comments go here" /end HEADER
/begin MODULE ModuleName "Module Comment Goes Here"
/begin IF_DATA XCP
 /begin PROTOCOL_LAYER 0x0100 0x03E8 0x00C8 0x0000 0x0000 0x0000 0x0000 0x0000 0xFC 0x0578 BYTE_ORDER_MSB_LAST ADDRESS_GRANULARITY_BYTE OPTIONAL_CMD ALLOC_ODT_ENTRY OPTIONAL_CMD ALLOC_ODT OPTIONAL_CMD ALLOC_DAQ OPTIONAL_CMD FREE_DAQ OPTIONAL_CMD GET_DAQ_RESOLUTION_INFO OPTIONAL_CMD GET_DAQ_PROCESSOR_INFO OPTIONAL_CMD START_STOP_SYNCH OPTIONAL_CMD START_STOP_DAQ_LIST OPTIONAL_CMD SET_DAQ_LIST_MODE OPTIONAL_CMD WRITE_DAQ OPTIONAL_CMD SET_DAQ_PTR OPTIONAL_CMD GET_CAL_PAGE OPTIONAL_CMD SET_CAL_PAGE OPTIONAL_CMD COPY_CAL_PAGE OPTIONAL_CMD SHORT_DOWNLOAD OPTIONAL_CMD DOWNLOAD_MAX OPTIONAL_CMD DOWNLOAD OPTIONAL_CMD SHORT_UPLOAD OPTIONAL_CMD UPLOAD OPTIONAL_CMD SET_MTA /end PROTOCOL_LAYER
 /begin DAQ DYNAMIC 0x0000 0x0080 0x00 OPTIMISATION_TYPE_DEFAULT ADDRESS_EXTENSION_FREE IDENTIFICATION_FIELD_TYPE_RELATIVE_WORD_ALIGNED GRANULARITY_ODT_ENTRY_SIZE_DAQ_BYTE 0xFF OVERLOAD_INDICATION_PID PRESCALER_SUPPORTED /begin STIM GRANULARITY_ODT_ENTRY_SIZE_STIM_BYTE 0xFF /end STIM /begin TIMESTAMP_SUPPORTED 0x0001 SIZE_DWORD UNIT_1US TIMESTAMP_FIXED /end TIMESTAMP_SUPPORTED /begin EVENT "100 ms" "100 ms" 0x0000 DAQ 0xFF 0x01 0x08 0x00 /end EVENT /end DAQ
 /begin XCP_ON_UDP_IP 0x0100 0x15B3 ADDRESS "192.168.7.5" /end XCP_ON_UDP_IP
/end IF_DATA
/begin MOD_PAR "MOD PAR Comment Goes Here"
 /begin MEMORY_SEGMENT CAN_2_Legs_whileloop_j_cal_impl "CAN_2_Legs_whileloop_j_cal_impl" DATA FLASH INTERN 0x00217020 0x680 -1 -1 -1 -1 -1
  /begin IF_DATA XCP
   /begin SEGMENT 0x00 0x02 0x00 0x00 0x00
    /begin PAGE 0x00 ECU_ACCESS_DONT_CARE XCP_READ_ACCESS_DONT_CARE XCP_WRITE_ACCESS_NOT_ALLOWED /end PAGE
    /begin PAGE 0x01 ECU_ACCESS_DONT_CARE XCP_READ_ACCESS_DONT_CARE XCP_WRITE_ACCESS_DONT_CARE /end PAGE
   /end SEGMENT
  /end IF_DATA
 /end MEMORY_SEGMENT
/end MOD_PAR
/begin MOD_COMMON "Mod Common Comment Here" BYTE_ORDER MSB_LAST ALIGNMENT_BYTE 1 ALIGNMENT_WORD 2 ALIGNMENT_LONG 8 ALIGNMENT_FLOAT32_IEEE 4 ALIGNMENT_FLOAT64_IEEE 8 ALIGNMENT_INT64 4 /end MOD_COMMON
/begin CHARACTERISTIC CAN_2_Legs_whileloop_j_cal_impl.CANRead_P1 "" VAL_BLK 0x00217100 Scalar_FLOAT64_IEEE 0 CAN_2_Legs_whileloop_johnmessingabout_CM_double -1.7E+308 1.7E+308 MATRIX_DIM 6 1 /end CHARACTERISTIC
/begin CHARACTERISTIC CAN_2_Legs_whileloop_j_cal_impl.CANSetup_P1 "" VAL_BLK 0x00217140 Scalar_FLOAT64_IEEE 0 CAN_2_Legs_whileloop_johnmessingabout_CM_double -1.7E+308 1.7E+308 MATRIX_DIM 40 1 /end CHARACTERISTIC
/begin CHARACTERISTIC CAN_2_Legs_whileloop_j_cal_impl.CANSetup_P2 "" VALUE 0x00217290 Scalar_FLOAT64_IEEE 0 CAN_2_Legs_whileloop_johnmessingabout_CM_double -1.7E+308 1.7E+308 /end CHARACTERISTIC
/begin CHARACTERISTIC CAN_2_Legs_whileloop_j_cal_impl.CANSetup_P3 "" VALUE 0x002172A8 Scalar_FLOAT64_IEEE 0 CAN_2_Legs_whileloop_johnmessingabout_CM_double -1.7E+308 1.7E+308 /end CHARACTERISTIC
/begin CHARACTERISTIC CAN_2_Legs_whileloop_j_cal_impl.CANStatus_P1 "" VALUE 0x00217348 Scalar_FLOAT64_IEEE 0 CAN_2_Legs_whileloop_johnmessingabout_CM_double -1.7E+308 1.7E+308 /end CHARACTERISTIC
/begin CHARACTERISTIC CAN_2_Legs_whileloop_j_cal_impl.CANStatus_P10 "" VALUE 0x00217420 Scalar_FLOAT64_IEEE 0 CAN_2_Legs_whileloop_johnmessingabout_CM_double -1.7E+308 1.7E+308 /end CHARACTERISTIC
/begin CHARACTERISTIC CAN_2_Legs_whileloop_j_cal_impl.CANStatus_P11 "" VALUE 0x00217438 Scalar_FLOAT64_IEEE 0 CAN_2_Legs_whileloop_johnmessingabout_CM_double -1.7E+308 1.7E+308 /end CHARACTERISTIC
/begin CHARACTERISTIC CAN_2_Legs_whileloop_j_cal_impl.CANStatus_P12 "" VALUE 0x00217450 Scalar_FLOAT64_IEEE 0 CAN_2_Legs_whileloop_johnmessingabout_CM_double -1.7E+308 1.7E+308 /end CHARACTERISTIC
/begin CHARACTERISTIC CAN_2_Legs_whileloop_j_cal_impl.CANStatus_P13 "" VALUE 0x00217468 Scalar_FLOAT64_IEEE 0 CAN_2_Legs_whileloop_johnmessingabout_CM_double -1.7E+308 1.7E+308 /end CHARACTERISTIC
/begin CHARACTERISTIC CAN_2_Legs_whileloop_j_cal_impl.CANStatus_P14 "" VALUE 0x00217480 Scalar_FLOAT64_IEEE 0 CAN_2_Legs_whileloop_johnmessingabout_CM_double -1.7E+308 1.7E+308 /end CHARACTERISTIC
/begin CHARACTERISTIC CAN_2_Legs_whileloop_j_cal_impl.CANStatus_P15 "" VALUE 0x00217498 Scalar_FLOAT64_IEEE 0 CAN_2_Legs_whileloop_johnmessingabout_CM_double -1.7E+308 1.7E+308 /end CHARACTERISTIC
/begin CHARACTERISTIC CAN_2_Legs_whileloop_j_cal_impl.CANStatus_P16 "" VALUE 0x002174B0 Scalar_FLOAT64_IEEE 0 CAN_2_Legs_whileloop_johnmessingabout_CM_double -1.7E+308 1.7E+308 /end CHARACTERISTIC
/begin CHARACTERISTIC CAN_2_Legs_whileloop_j_cal_impl.CANStatus_P17 "" VALUE 0x002174C8 Scalar_FLOAT64_IEEE 0 CAN_2_Legs_whileloop_johnmessingabout_CM_double -1.7E+308 1.7E+308 /end CHARACTERISTIC
/begin CHARACTERISTIC CAN_2_Legs_whileloop_j_cal_impl.CANStatus_P18 "" VALUE 0x002174E0 Scalar_FLOAT64_IEEE 0 CAN_2_Legs_whileloop_johnmessingabout_CM_double -1.7E+308 1.7E+308 /end CHARACTERISTIC
/begin CHARACTERISTIC CAN_2_Legs_whileloop_j_cal_impl.CANStatus_P19 "" VALUE 0x002174F8 Scalar_FLOAT64_IEEE 0 CAN_2_Legs_whileloop_johnmessingabout_CM_double -1.7E+308 1.7E+308 /end CHARACTERISTIC
/begin CHARACTERISTIC CAN_2_Legs_whileloop_j_cal_impl.CANStatus_P2 "" VALUE 0x00217360 Scalar_FLOAT64_IEEE 0 CAN_2_Legs_whileloop_johnmessingabout_CM_double -1.7E+308 1.7E+308 /end CHARACTERISTIC
/begin CHARACTERISTIC CAN_2_Legs_whileloop_j_cal_impl.CANStatus_P20 "" VALUE 0x00217510 Scalar_FLOAT64_IEEE 0 CAN_2_Legs_whileloop_johnmessingabout_CM_double -1.7E+308 1.7E+308 /end CHARACTERISTIC
/begin CHARACTERISTIC CAN_2_Legs_whileloop_j_cal_impl.CANStatus_P21 "" VALUE 0x00217528 Scalar_FLOAT64_IEEE 0 CAN_2_Legs_whileloop_johnmessingabout_CM_double -1.7E+308 1.7E+308 /end CHARACTERISTIC
/begin CHARACTERISTIC CAN_2_Legs_whileloop_j_cal_impl.CANStatus_P22 "" VALUE 0x00217540 Scalar_FLOAT64_IEEE 0 CAN_2_Legs_whileloop_johnmessingabout_CM_double -1.7E+308 1.7E+308 /end CHARACTERISTIC
/begin CHARACTERISTIC CAN_2_Legs_whileloop_j_cal_impl.CANStatus_P23 "" VALUE 0x00217558 Scalar_FLOAT64_IEEE 0 CAN_2_Legs_whileloop_johnmessingabout_CM_double -1.7E+308 1.7E+308 /end CHARACTERISTIC
/begin CHARACTERISTIC CAN_2_Legs_whileloop_j_cal_impl.CANStatus_P24 "" VALUE 0x00217570 Scalar_FLOAT64_IEEE 0 CAN_2_Legs_whileloop_johnmessingabout_CM_double -1.7E+308 1.7E+308 /end CHARACTERISTIC
/begin CHARACTERISTIC CAN_2_Legs_whileloop_j_cal_impl.CANStatus_P25 "" VALUE 0x00217588 Scalar_FLOAT64_IEEE 0 CAN_2_Legs_whileloop_johnmessingabout_CM_double -1.7E+308 1.7E+308 /end CHARACTERISTIC
/begin CHARACTERISTIC CAN_2_Legs_whileloop_j_cal_impl.CANStatus_P26 "" VALUE 0x002175A0 Scalar_FLOAT64_IEEE 0 CAN_2_Legs_whileloop_johnmessingabout_CM_double -1.7E+308 1.7E+308 /end CHARACTERISTIC
/begin CHARACTERISTIC CAN_2_Legs_whileloop_j_cal_impl.CANStatus_P27 "" VALUE 0x002175B8 Scalar_FLOAT64_IEEE 0 CAN_2_Legs_whileloop_johnmessingabout_CM_double -1.7E+308 1.7E+308 /end CHARACTERISTIC
/begin CHARACTERISTIC CAN_2_Legs_whileloop_j_cal_impl.CANStatus_P28 "" VALUE 0x002175D0 Scalar_FLOAT64_IEEE 0 CAN_2_Legs_whileloop_johnmessingabout_CM_double -1.7E+308 1.7E+308 /end CHARACTERISTIC
/begin CHARACTERISTIC CAN_2_Legs_whileloop_j_cal_impl.CANStatus_P29 "" VALUE 0x002175E8 Scalar_FLOAT64_IEEE 0 CAN_2_Legs_whileloop_johnmessingabout_CM_double -1.7E+308 1.7E+308 /end CHARACTERISTIC
/begin CHARACTERISTIC CAN_2_Legs_whileloop_j_cal_impl.CANStatus_P3 "" VALUE 0x00217378 Scalar_FLOAT64_IEEE 0 CAN_2_Legs_whileloop_johnmessingabout_CM_double -1.7E+308 1.7E+308 /end CHARACTERISTIC
/begin CHARACTERISTIC CAN_2_Legs_whileloop_j_cal_impl.CANStatus_P30 "" VALUE 0x00217600 Scalar_FLOAT64_IEEE 0 CAN_2_Legs_whileloop_johnmessingabout_CM_double -1.7E+308 1.7E+308 /end CHARACTERISTIC
/begin CHARACTERISTIC CAN_2_Legs_whileloop_j_cal_impl.CANStatus_P31 "" VALUE 0x00217618 Scalar_FLOAT64_IEEE 0 CAN_2_Legs_whileloop_johnmessingabout_CM_double -1.7E+308 1.7E+308 /end CHARACTERISTIC
/begin CHARACTERISTIC CAN_2_Legs_whileloop_j_cal_impl.CANStatus_P32 "" VALUE 0x00217630 Scalar_FLOAT64_IEEE 0 CAN_2_Legs_whileloop_johnmessingabout_CM_double -1.7E+308 1.7E+308 /end CHARACTERISTIC
/begin CHARACTERISTIC CAN_2_Legs_whileloop_j_cal_impl.CANStatus_P33 "" VALUE 0x00217648 Scalar_FLOAT64_IEEE 0 CAN_2_Legs_whileloop_johnmessingabout_CM_double -1.7E+308 1.7E+308 /end CHARACTERISTIC
/begin CHARACTERISTIC CAN_2_Legs_whileloop_j_cal_impl.CANStatus_P34 "" VALUE 0x00217660 Scalar_FLOAT64_IEEE 0 CAN_2_Legs_whileloop_johnmessingabout_CM_double -1.7E+308 1.7E+308 /end CHARACTERISTIC
/begin CHARACTERISTIC CAN_2_Legs_whileloop_j_cal_impl.CANStatus_P4 "" VALUE 0x00217390 Scalar_FLOAT64_IEEE 0 CAN_2_Legs_whileloop_johnmessingabout_CM_double -1.7E+308 1.7E+308 /end CHARACTERISTIC
/begin CHARACTERISTIC CAN_2_Legs_whileloop_j_cal_impl.CANStatus_P5 "" VALUE 0x002173A8 Scalar_FLOAT64_IEEE 0 CAN_2_Legs_whileloop_johnmessingabout_CM_double -1.7E+308 1.7E+308 /end CHARACTERISTIC
/begin CHARACTERISTIC CAN_2_Legs_whileloop_j_cal_impl.CANStatus_P6 "" VALUE 0x002173C0 Scalar_FLOAT64_IEEE 0 CAN_2_Legs_whileloop_johnmessingabout_CM_double -1.7E+308 1.7E+308 /end CHARACTERISTIC
/begin CHARACTERISTIC CAN_2_Legs_whileloop_j_cal_impl.CANStatus_P7 "" VALUE 0x002173D8 Scalar_FLOAT64_IEEE 0 CAN_2_Legs_whileloop_johnmessingabout_CM_double -1.7E+308 1.7E+308 /end CHARACTERISTIC
/begin CHARACTERISTIC CAN_2_Legs_whileloop_j_cal_impl.CANStatus_P8 "" VALUE 0x002173F0 Scalar_FLOAT64_IEEE 0 CAN_2_Legs_whileloop_johnmessingabout_CM_double -1.7E+308 1.7E+308 /end CHARACTERISTIC
/begin CHARACTERISTIC CAN_2_Legs_whileloop_j_cal_impl.CANStatus_P9 "" VALUE 0x00217408 Scalar_FLOAT64_IEEE 0 CAN_2_Legs_whileloop_johnmessingabout_CM_double -1.7E+308 1.7E+308 /end CHARACTERISTIC
/begin CHARACTERISTIC CAN_2_Legs_whileloop_j_cal_impl.CANWrite1_P1 "" VAL_BLK 0x00217030 Scalar_FLOAT64_IEEE 0 CAN_2_Legs_whileloop_johnmessingabout_CM_double -1.7E+308 1.7E+308 MATRIX_DIM 7 1 /end CHARACTERISTIC
/begin CHARACTERISTIC CAN_2_Legs_whileloop_j_cal_impl.CANWrite1_P1_j "" VAL_BLK 0x00217078 Scalar_FLOAT64_IEEE 0 CAN_2_Legs_whileloop_johnmessingabout_CM_double -1.7E+308 1.7E+308 MATRIX_DIM 7 1 /end CHARACTERISTIC
/begin CHARACTERISTIC CAN_2_Legs_whileloop_j_cal_impl.Constant10_Value "" VALUE 0x002172E0 Scalar_FLOAT64_IEEE 0 CAN_2_Legs_whileloop_johnmessingabout_CM_double -1.7E+308 1.7E+308 /end CHARACTERISTIC
/begin CHARACTERISTIC CAN_2_Legs_whileloop_j_cal_impl.Constant11_Value "" VALUE 0x002172E8 Scalar_FLOAT64_IEEE 0 CAN_2_Legs_whileloop_johnmessingabout_CM_double -1.7E+308 1.7E+308 /end CHARACTERISTIC
/begin CHARACTERISTIC CAN_2_Legs_whileloop_j_cal_impl.Constant1_Value "" VALUE 0x002172F0 Scalar_FLOAT64_IEEE 0 CAN_2_Legs_whileloop_johnmessingabout_CM_double -1.7E+308 1.7E+308 /end CHARACTERISTIC
/begin CHARACTERISTIC CAN_2_Legs_whileloop_j_cal_impl.Constant1_Value_e "" VAL_BLK 0x00217688 Scalar_UBYTE 0 CAN_2_Legs_whileloop_johnmessingabout_CM_uint8 0 255 MATRIX_DIM 8 1 /end CHARACTERISTIC
/begin CHARACTERISTIC CAN_2_Legs_whileloop_j_cal_impl.Constant1_Value_m "" VAL_BLK 0x00217670 Scalar_UBYTE 0 CAN_2_Legs_whileloop_johnmessingabout_CM_uint8 0 255 MATRIX_DIM 8 1 /end CHARACTERISTIC
/begin CHARACTERISTIC CAN_2_Legs_whileloop_j_cal_impl.Constant2_Value "" VALUE 0x002172F8 Scalar_FLOAT64_IEEE 0 CAN_2_Legs_whileloop_johnmessingabout_CM_double -1.7E+308 1.7E+308 /end CHARACTERISTIC
/begin CHARACTERISTIC CAN_2_Legs_whileloop_j_cal_impl.Constant2_Value_g "" VAL_BLK 0x00217678 Scalar_UBYTE 0 CAN_2_Legs_whileloop_johnmessingabout_CM_uint8 0 255 MATRIX_DIM 8 1 /end CHARACTERISTIC
/begin CHARACTERISTIC CAN_2_Legs_whileloop_j_cal_impl.Constant2_Value_k "" VAL_BLK 0x00217690 Scalar_UBYTE 0 CAN_2_Legs_whileloop_johnmessingabout_CM_uint8 0 255 MATRIX_DIM 8 1 /end CHARACTERISTIC
/begin CHARACTERISTIC CAN_2_Legs_whileloop_j_cal_impl.Constant3_Value "" VALUE 0x00217300 Scalar_FLOAT64_IEEE 0 CAN_2_Legs_whileloop_johnmessingabout_CM_double -1.7E+308 1.7E+308 /end CHARACTERISTIC
/begin CHARACTERISTIC CAN_2_Legs_whileloop_j_cal_impl.Constant4_Value "" VALUE 0x00217308 Scalar_FLOAT64_IEEE 0 CAN_2_Legs_whileloop_johnmessingabout_CM_double -1.7E+308 1.7E+308 /end CHARACTERISTIC
/begin CHARACTERISTIC CAN_2_Legs_whileloop_j_cal_impl.Constant5_Value "" VALUE 0x00217310 Scalar_FLOAT64_IEEE 0 CAN_2_Legs_whileloop_johnmessingabout_CM_double -1.7E+308 1.7E+308 /end CHARACTERISTIC
/begin CHARACTERISTIC CAN_2_Legs_whileloop_j_cal_impl.Constant6_Value "" VALUE 0x002172C8 Scalar_FLOAT64_IEEE 0 CAN_2_Legs_whileloop_johnmessingabout_CM_double -1.7E+308 1.7E+308 /end CHARACTERISTIC
/begin CHARACTERISTIC CAN_2_Legs_whileloop_j_cal_impl.Constant7_Value "" VALUE 0x002172B8 Scalar_FLOAT64_IEEE 0 CAN_2_Legs_whileloop_johnmessingabout_CM_double -1.7E+308 1.7E+308 /end CHARACTERISTIC
/begin CHARACTERISTIC CAN_2_Legs_whileloop_j_cal_impl.Constant8_Value "" VALUE 0x002172D0 Scalar_FLOAT64_IEEE 0 CAN_2_Legs_whileloop_johnmessingabout_CM_double -1.7E+308 1.7E+308 /end CHARACTERISTIC
/begin CHARACTERISTIC CAN_2_Legs_whileloop_j_cal_impl.Constant9_Value "" VALUE 0x002172D8 Scalar_FLOAT64_IEEE 0 CAN_2_Legs_whileloop_johnmessingabout_CM_double -1.7E+308 1.7E+308 /end CHARACTERISTIC
/begin CHARACTERISTIC CAN_2_Legs_whileloop_j_cal_impl.Constant_Value "" VALUE 0x002172B0 Scalar_FLOAT64_IEEE 0 CAN_2_Legs_whileloop_johnmessingabout_CM_double -1.7E+308 1.7E+308 /end CHARACTERISTIC
/begin CHARACTERISTIC CAN_2_Legs_whileloop_j_cal_impl.Constant_Value_i "" VAL_BLK 0x00217680 Scalar_UBYTE 0 CAN_2_Legs_whileloop_johnmessingabout_CM_uint8 0 255 MATRIX_DIM 8 1 /end CHARACTERISTIC
/begin CHARACTERISTIC CAN_2_Legs_whileloop_j_cal_impl.Constant_Value_l "" VAL_BLK 0x00217668 Scalar_UBYTE 0 CAN_2_Legs_whileloop_johnmessingabout_CM_uint8 0 255 MATRIX_DIM 8 1 /end CHARACTERISTIC
/begin CHARACTERISTIC CAN_2_Legs_whileloop_j_cal_impl.Curr1_Y0 "" VALUE 0x002170C0 Scalar_FLOAT64_IEEE 0 CAN_2_Legs_whileloop_johnmessingabout_CM_double -1.7E+308 1.7E+308 /end CHARACTERISTIC
/begin CHARACTERISTIC CAN_2_Legs_whileloop_j_cal_impl.Curr2_Y0 "" VALUE 0x002170E0 Scalar_FLOAT64_IEEE 0 CAN_2_Legs_whileloop_johnmessingabout_CM_double -1.7E+308 1.7E+308 /end CHARACTERISTIC
/begin CHARACTERISTIC CAN_2_Legs_whileloop_j_cal_impl.DataStoreMemory1_InitialValue "" VALUE 0x00217320 Scalar_FLOAT64_IEEE 0 CAN_2_Legs_whileloop_johnmessingabout_CM_double -1.7E+308 1.7E+308 /end CHARACTERISTIC
/begin CHARACTERISTIC CAN_2_Legs_whileloop_j_cal_impl.DataStoreMemory1_InitialValue_k "" VALUE 0x00217330 Scalar_FLOAT64_IEEE 0 CAN_2_Legs_whileloop_johnmessingabout_CM_double -1.7E+308 1.7E+308 /end CHARACTERISTIC
/begin CHARACTERISTIC CAN_2_Legs_whileloop_j_cal_impl.DataStoreMemory_InitialValue "" VALUE 0x00217318 Scalar_FLOAT64_IEEE 0 CAN_2_Legs_whileloop_johnmessingabout_CM_double -1.7E+308 1.7E+308 /end CHARACTERISTIC
/begin CHARACTERISTIC CAN_2_Legs_whileloop_j_cal_impl.DataStoreMemory_InitialValue_n "" VALUE 0x00217328 Scalar_FLOAT64_IEEE 0 CAN_2_Legs_whileloop_johnmessingabout_CM_double -1.7E+308 1.7E+308 /end CHARACTERISTIC
/begin CHARACTERISTIC CAN_2_Legs_whileloop_j_cal_impl.Gain_Gain "" VALUE 0x002172C0 Scalar_FLOAT64_IEEE 0 CAN_2_Legs_whileloop_johnmessingabout_CM_double -1.7E+308 1.7E+308 /end CHARACTERISTIC
/begin CHARACTERISTIC CAN_2_Legs_whileloop_j_cal_impl.ID1_Y0 "" VALUE 0x002170C8 Scalar_FLOAT64_IEEE 0 CAN_2_Legs_whileloop_johnmessingabout_CM_double -1.7E+308 1.7E+308 /end CHARACTERISTIC
/begin CHARACTERISTIC CAN_2_Legs_whileloop_j_cal_impl.ID2_Y0 "" VALUE 0x002170E8 Scalar_FLOAT64_IEEE 0 CAN_2_Legs_whileloop_johnmessingabout_CM_double -1.7E+308 1.7E+308 /end CHARACTERISTIC
/begin CHARACTERISTIC CAN_2_Legs_whileloop_j_cal_impl.P1_Y0 "" VALUE 0x002170B0 Scalar_FLOAT64_IEEE 0 CAN_2_Legs_whileloop_johnmessingabout_CM_double -1.7E+308 1.7E+308 /end CHARACTERISTIC
/begin CHARACTERISTIC CAN_2_Legs_whileloop_j_cal_impl.P3_Y0 "" VALUE 0x002170D0 Scalar_FLOAT64_IEEE 0 CAN_2_Legs_whileloop_johnmessingabout_CM_double -1.7E+308 1.7E+308 /end CHARACTERISTIC
/begin CHARACTERISTIC CAN_2_Legs_whileloop_j_cal_impl.Status1_Y0 "" VALUE 0x00217698 Scalar_UBYTE 0 CAN_2_Legs_whileloop_johnmessingabout_CM_uint8 0 255 /end CHARACTERISTIC
/begin CHARACTERISTIC CAN_2_Legs_whileloop_j_cal_impl.Status2_Y0 "" VALUE 0x00217699 Scalar_UBYTE 0 CAN_2_Legs_whileloop_johnmessingabout_CM_uint8 0 255 /end CHARACTERISTIC
/begin CHARACTERISTIC CAN_2_Legs_whileloop_j_cal_impl.V1_Y0 "" VALUE 0x002170B8 Scalar_FLOAT64_IEEE 0 CAN_2_Legs_whileloop_johnmessingabout_CM_double -1.7E+308 1.7E+308 /end CHARACTERISTIC
/begin CHARACTERISTIC CAN_2_Legs_whileloop_j_cal_impl.V2_Y0 "" VALUE 0x002170D8 Scalar_FLOAT64_IEEE 0 CAN_2_Legs_whileloop_johnmessingabout_CM_double -1.7E+308 1.7E+308 /end CHARACTERISTIC
/begin MEASUREMENT CAN_2_Legs_whileloop_johnmessingabout_B.BytePacking "" UBYTE CAN_2_Legs_whileloop_johnmessingabout_CM_uint8 0 0 0 255 LAYOUT COLUMN_DIR MATRIX_DIM 8 ECU_ADDRESS 0x0021A2CE /end MEASUREMENT
/begin MEASUREMENT CAN_2_Legs_whileloop_johnmessingabout_B.BytePacking_o "" UBYTE CAN_2_Legs_whileloop_johnmessingabout_CM_uint8 0 0 0 255 LAYOUT COLUMN_DIR MATRIX_DIM 8 ECU_ADDRESS 0x0021A2DE /end MEASUREMENT
/begin MEASUREMENT CAN_2_Legs_whileloop_johnmessingabout_B.CANRead_o1 "" UBYTE CAN_2_Legs_whileloop_johnmessingabout_CM_logical 0 0 0 1 ECU_ADDRESS 0x0021A2E6 /end MEASUREMENT
/begin MEASUREMENT CAN_2_Legs_whileloop_johnmessingabout_B.CANUnpack_o1 "" FLOAT64_IEEE CAN_2_Legs_whileloop_johnmessingabout_CM_double 0 0 -1.7E+308 1.7E+308 ECU_ADDRESS 0x0021A230 /end MEASUREMENT
/begin MEASUREMENT CAN_2_Legs_whileloop_johnmessingabout_B.CANUnpack_o1_f "" FLOAT64_IEEE CAN_2_Legs_whileloop_johnmessingabout_CM_double 0 0 -1.7E+308 1.7E+308 ECU_ADDRESS 0x0021A250 /end MEASUREMENT
/begin MEASUREMENT CAN_2_Legs_whileloop_johnmessingabout_B.CANUnpack_o2 "" FLOAT64_IEEE CAN_2_Legs_whileloop_johnmessingabout_CM_double 0 0 -1.7E+308 1.7E+308 ECU_ADDRESS 0x0021A238 /end MEASUREMENT
/begin MEASUREMENT CAN_2_Legs_whileloop_johnmessingabout_B.CANUnpack_o2_l "" FLOAT64_IEEE CAN_2_Legs_whileloop_johnmessingabout_CM_double 0 0 -1.7E+308 1.7E+308 ECU_ADDRESS 0x0021A258 /end MEASUREMENT
/begin MEASUREMENT CAN_2_Legs_whileloop_johnmessingabout_B.CANUnpack_o3 "" FLOAT64_IEEE CAN_2_Legs_whileloop_johnmessingabout_CM_double 0 0 -1.7E+308 1.7E+308 ECU_ADDRESS 0x0021A240 /end MEASUREMENT
/begin MEASUREMENT CAN_2_Legs_whileloop_johnmessingabout_B.CANUnpack_o3_k "" FLOAT64_IEEE CAN_2_Legs_whileloop_johnmessingabout_CM_double 0 0 -1.7E+308 1.7E+308 ECU_ADDRESS 0x0021A260 /end MEASUREMENT
/begin MEASUREMENT CAN_2_Legs_whileloop_johnmessingabout_B.CANUnpack_o4 "" FLOAT64_IEEE CAN_2_Legs_whileloop_johnmessingabout_CM_double 0 0 -1.7E+308 1.7E+308 ECU_ADDRESS 0x0021A248 /end MEASUREMENT
/begin MEASUREMENT CAN_2_Legs_whileloop_johnmessingabout_B.CANUnpack_o4_i "" FLOAT64_IEEE CAN_2_Legs_whileloop_johnmessingabout_CM_double 0 0 -1.7E+308 1.7E+308 ECU_ADDRESS 0x0021A268 /end MEASUREMENT
/begin MEASUREMENT CAN_2_Legs_whileloop_johnmessingabout_B.CANUnpack_o5 "" UBYTE CAN_2_Legs_whileloop_johnmessingabout_CM_uint8 0 0 0 255 ECU_ADDRESS 0x0021A2C4 /end MEASUREMENT
/begin MEASUREMENT CAN_2_Legs_whileloop_johnmessingabout_B.CANUnpack_o5_p "" UBYTE CAN_2_Legs_whileloop_johnmessingabout_CM_uint8 0 0 0 255 ECU_ADDRESS 0x0021A2C5 /end MEASUREMENT
/begin MEASUREMENT CAN_2_Legs_whileloop_johnmessingabout_B.Clock "" FLOAT64_IEEE CAN_2_Legs_whileloop_johnmessingabout_CM_double 0 0 -1.7E+308 1.7E+308 ECU_ADDRESS 0x0021A1D8 /end MEASUREMENT
/begin MEASUREMENT CAN_2_Legs_whileloop_johnmessingabout_B.Clock_m "" FLOAT64_IEEE CAN_2_Legs_whileloop_johnmessingabout_CM_double 0 0 -1.7E+308 1.7E+308 ECU_ADDRESS 0x0021A208 /end MEASUREMENT
/begin MEASUREMENT CAN_2_Legs_whileloop_johnmessingabout_B.Constant2 "" FLOAT64_IEEE CAN_2_Legs_whileloop_johnmessingabout_CM_double 0 0 -1.7E+308 1.7E+308 ECU_ADDRESS 0x0021A220 /end MEASUREMENT
/begin MEASUREMENT CAN_2_Legs_whileloop_johnmessingabout_B.Constant8 "" FLOAT64_IEEE CAN_2_Legs_whileloop_johnmessingabout_CM_double 0 0 -1.7E+308 1.7E+308 ECU_ADDRESS 0x0021A1F8 /end MEASUREMENT
/begin MEASUREMENT CAN_2_Legs_whileloop_johnmessingabout_B.DataStoreRead "" FLOAT64_IEEE CAN_2_Legs_whileloop_johnmessingabout_CM_double 0 0 -1.7E+308 1.7E+308 ECU_ADDRESS 0x0021A1D0 /end MEASUREMENT
/begin MEASUREMENT CAN_2_Legs_whileloop_johnmessingabout_B.DataStoreRead1 "" FLOAT64_IEEE CAN_2_Legs_whileloop_johnmessingabout_CM_double 0 0 -1.7E+308 1.7E+308 ECU_ADDRESS 0x0021A1E0 /end MEASUREMENT
/begin MEASUREMENT CAN_2_Legs_whileloop_johnmessingabout_B.DataStoreRead1_e "" FLOAT64_IEEE CAN_2_Legs_whileloop_johnmessingabout_CM_double 0 0 -1.7E+308 1.7E+308 ECU_ADDRESS 0x0021A210 /end MEASUREMENT
/begin MEASUREMENT CAN_2_Legs_whileloop_johnmessingabout_B.DataStoreRead_i "" FLOAT64_IEEE CAN_2_Legs_whileloop_johnmessingabout_CM_double 0 0 -1.7E+308 1.7E+308 ECU_ADDRESS 0x0021A200 /end MEASUREMENT
/begin MEASUREMENT CAN_2_Legs_whileloop_johnmessingabout_B.Delay "" FLOAT64_IEEE CAN_2_Legs_whileloop_johnmessingabout_CM_double 0 0 -1.7E+308 1.7E+308 ECU_ADDRESS 0x0021A1F0 /end MEASUREMENT
/begin MEASUREMENT CAN_2_Legs_whileloop_johnmessingabout_B.Delay_i "" FLOAT64_IEEE CAN_2_Legs_whileloop_johnmessingabout_CM_double 0 0 -1.7E+308 1.7E+308 ECU_ADDRESS 0x0021A218 /end MEASUREMENT
/begin MEASUREMENT CAN_2_Legs_whileloop_johnmessingabout_B.GRF "" FLOAT64_IEEE CAN_2_Legs_whileloop_johnmessingabout_CM_double 0 0 -1.7E+308 1.7E+308 ECU_ADDRESS 0x0021A2B8 /end MEASUREMENT
/begin MEASUREMENT CAN_2_Legs_whileloop_johnmessingabout_B.Gain "" FLOAT64_IEEE CAN_2_Legs_whileloop_johnmessingabout_CM_double 0 0 -1.7E+308 1.7E+308 ECU_ADDRESS 0x0021A1E8 /end MEASUREMENT
/begin MEASUREMENT CAN_2_Legs_whileloop_johnmessingabout_B.MultiportSwitch "" UBYTE CAN_2_Legs_whileloop_johnmessingabout_CM_uint8 0 0 0 255 LAYOUT COLUMN_DIR MATRIX_DIM 8 ECU_ADDRESS 0x0021A2C6 /end MEASUREMENT
/begin MEASUREMENT CAN_2_Legs_whileloop_johnmessingabout_B.MultiportSwitch_f "" UBYTE CAN_2_Legs_whileloop_johnmessingabout_CM_uint8 0 0 0 255 LAYOUT COLUMN_DIR MATRIX_DIM 8 ECU_ADDRESS 0x0021A2D6 /end MEASUREMENT
/begin MEASUREMENT CAN_2_Legs_whileloop_johnmessingabout_B.Subsystem.Clock1 "" FLOAT64_IEEE CAN_2_Legs_whileloop_johnmessingabout_CM_double 0 0 -1.7E+308 1.7E+308 ECU_ADDRESS 0x0021A320 /end MEASUREMENT
/begin MEASUREMENT CAN_2_Legs_whileloop_johnmessingabout_B.Subsystem_d.Clock1 "" FLOAT64_IEEE CAN_2_Legs_whileloop_johnmessingabout_CM_double 0 0 -1.7E+308 1.7E+308 ECU_ADDRESS 0x0021A318 /end MEASUREMENT
/begin MEASUREMENT CAN_2_Legs_whileloop_johnmessingabout_B.TmpSignalConversionAtSFunctio_i "" FLOAT64_IEEE CAN_2_Legs_whileloop_johnmessingabout_CM_double 0 0 -1.7E+308 1.7E+308 LAYOUT COLUMN_DIR MATRIX_DIM 2 ECU_ADDRESS 0x0021A2A8 /end MEASUREMENT
/begin MEASUREMENT CAN_2_Legs_whileloop_johnmessingabout_B.TmpSignalConversionAtSFunctio_l "" FLOAT64_IEEE CAN_2_Legs_whileloop_johnmessingabout_CM_double 0 0 -1.7E+308 1.7E+308 LAYOUT COLUMN_DIR MATRIX_DIM 2 ECU_ADDRESS 0x0021A298 /end MEASUREMENT
/begin MEASUREMENT CAN_2_Legs_whileloop_johnmessingabout_B.TmpSignalConversionAtSFunctionI "" FLOAT64_IEEE CAN_2_Legs_whileloop_johnmessingabout_CM_double 0 0 -1.7E+308 1.7E+308 LAYOUT COLUMN_DIR MATRIX_DIM 2 ECU_ADDRESS 0x0021A280 /end MEASUREMENT
/begin MEASUREMENT CAN_2_Legs_whileloop_johnmessingabout_B.WhileIterator "" SLONG CAN_2_Legs_whileloop_johnmessingabout_CM_int32 0 0 -2147483648 2147483647 ECU_ADDRESS 0x0021A2C0 /end MEASUREMENT
/begin MEASUREMENT CAN_2_Legs_whileloop_johnmessingabout_B.danger "" FLOAT64_IEEE CAN_2_Legs_whileloop_johnmessingabout_CM_double 0 0 -1.7E+308 1.7E+308 ECU_ADDRESS 0x0021A290 /end MEASUREMENT
/begin MEASUREMENT CAN_2_Legs_whileloop_johnmessingabout_B.mode "" FLOAT64_IEEE CAN_2_Legs_whileloop_johnmessingabout_CM_double 0 0 -1.7E+308 1.7E+308 ECU_ADDRESS 0x0021A1C8 /end MEASUREMENT
/begin MEASUREMENT CAN_2_Legs_whileloop_johnmessingabout_B.p "" FLOAT64_IEEE CAN_2_Legs_whileloop_johnmessingabout_CM_double 0 0 -1.7E+308 1.7E+308 ECU_ADDRESS 0x0021A270 /end MEASUREMENT
/begin MEASUREMENT CAN_2_Legs_whileloop_johnmessingabout_B.p_p "" FLOAT64_IEEE CAN_2_Legs_whileloop_johnmessingabout_CM_double 0 0 -1.7E+308 1.7E+308 ECU_ADDRESS 0x0021A278 /end MEASUREMENT
/begin MEASUREMENT CAN_2_Legs_whileloop_johnmessingabout_B.pcp1 "" FLOAT64_IEEE CAN_2_Legs_whileloop_johnmessingabout_CM_double 0 0 -1.7E+308 1.7E+308 ECU_ADDRESS 0x0021A228 /end MEASUREMENT
/begin MEASUREMENT CAN_2_Legs_whileloop_johnmessingabout_B.sf_bytesfloats.I_ff "" FLOAT64_IEEE CAN_2_Legs_whileloop_johnmessingabout_CM_double 0 0 -1.7E+308 1.7E+308 ECU_ADDRESS 0x0021A310 /end MEASUREMENT
/begin MEASUREMENT CAN_2_Legs_whileloop_johnmessingabout_B.sf_bytesfloats.position "" FLOAT64_IEEE CAN_2_Legs_whileloop_johnmessingabout_CM_double 0 0 -1.7E+308 1.7E+308 ECU_ADDRESS 0x0021A300 /end MEASUREMENT
/begin MEASUREMENT CAN_2_Legs_whileloop_johnmessingabout_B.sf_bytesfloats.velocity "" FLOAT64_IEEE CAN_2_Legs_whileloop_johnmessingabout_CM_double 0 0 -1.7E+308 1.7E+308 ECU_ADDRESS 0x0021A308 /end MEASUREMENT
/begin MEASUREMENT CAN_2_Legs_whileloop_johnmessingabout_B.sf_bytesfloats_e.I_ff "" FLOAT64_IEEE CAN_2_Legs_whileloop_johnmessingabout_CM_double 0 0 -1.7E+308 1.7E+308 ECU_ADDRESS 0x0021A2F8 /end MEASUREMENT
/begin MEASUREMENT CAN_2_Legs_whileloop_johnmessingabout_B.sf_bytesfloats_e.position "" FLOAT64_IEEE CAN_2_Legs_whileloop_johnmessingabout_CM_double 0 0 -1.7E+308 1.7E+308 ECU_ADDRESS 0x0021A2E8 /end MEASUREMENT
/begin MEASUREMENT CAN_2_Legs_whileloop_johnmessingabout_B.sf_bytesfloats_e.velocity "" FLOAT64_IEEE CAN_2_Legs_whileloop_johnmessingabout_CM_double 0 0 -1.7E+308 1.7E+308 ECU_ADDRESS 0x0021A2F0 /end MEASUREMENT
/begin MEASUREMENT CAN_2_Legs_whileloop_johnmessingabout_B.sf_floatsbytes.b "" UBYTE CAN_2_Legs_whileloop_johnmessingabout_CM_uint8 0 0 0 255 LAYOUT COLUMN_DIR MATRIX_DIM 8 ECU_ADDRESS 0x0021A330 /end MEASUREMENT
/begin MEASUREMENT CAN_2_Legs_whileloop_johnmessingabout_B.sf_floatsbytes_o.b "" UBYTE CAN_2_Legs_whileloop_johnmessingabout_CM_uint8 0 0 0 255 LAYOUT COLUMN_DIR MATRIX_DIM 8 ECU_ADDRESS 0x0021A328 /end MEASUREMENT
/begin MEASUREMENT CAN_2_Legs_whileloop_johnmessingabout_DW.CANUnpack_ModeSignalID "" SLONG CAN_2_Legs_whileloop_johnmessingabout_CM_int_T 0 0 -2147483648 2147483647 ECU_ADDRESS 0x0021A150 /end MEASUREMENT
/begin MEASUREMENT CAN_2_Legs_whileloop_johnmessingabout_DW.CANUnpack_ModeSignalID_d "" SLONG CAN_2_Legs_whileloop_johnmessingabout_CM_int_T 0 0 -2147483648 2147483647 ECU_ADDRESS 0x0021A158 /end MEASUREMENT
/begin MEASUREMENT CAN_2_Legs_whileloop_johnmessingabout_DW.CANUnpack_StatusPortID "" SLONG CAN_2_Legs_whileloop_johnmessingabout_CM_int_T 0 0 -2147483648 2147483647 ECU_ADDRESS 0x0021A154 /end MEASUREMENT
/begin MEASUREMENT CAN_2_Legs_whileloop_johnmessingabout_DW.CANUnpack_StatusPortID_f "" SLONG CAN_2_Legs_whileloop_johnmessingabout_CM_int_T 0 0 -2147483648 2147483647 ECU_ADDRESS 0x0021A15C /end MEASUREMENT
/begin MEASUREMENT CAN_2_Legs_whileloop_johnmessingabout_DW.Delay_DSTATE "" FLOAT64_IEEE CAN_2_Legs_whileloop_johnmessingabout_CM_double 0 0 -1.7E+308 1.7E+308 ECU_ADDRESS 0x00219FE0 /end MEASUREMENT
/begin MEASUREMENT CAN_2_Legs_whileloop_johnmessingabout_DW.Delay_DSTATE_b "" FLOAT64_IEEE CAN_2_Legs_whileloop_johnmessingabout_CM_double 0 0 -1.7E+308 1.7E+308 ECU_ADDRESS 0x00219FE8 /end MEASUREMENT
/begin MEASUREMENT CAN_2_Legs_whileloop_johnmessingabout_DW.If_ActiveSubsystem "" SBYTE CAN_2_Legs_whileloop_johnmessingabout_CM_int8 0 0 -128 127 ECU_ADDRESS 0x0021A170 /end MEASUREMENT
/begin MEASUREMENT CAN_2_Legs_whileloop_johnmessingabout_DW.If_ActiveSubsystem_b "" SBYTE CAN_2_Legs_whileloop_johnmessingabout_CM_int8 0 0 -128 127 ECU_ADDRESS 0x0021A171 /end MEASUREMENT
/begin MEASUREMENT CAN_2_Legs_whileloop_johnmessingabout_DW.Subsystem.Subsystem_SubsysRanBC "" SBYTE CAN_2_Legs_whileloop_johnmessingabout_CM_int8 0 0 -128 127 ECU_ADDRESS 0x0021A175 /end MEASUREMENT
/begin MEASUREMENT CAN_2_Legs_whileloop_johnmessingabout_DW.Subsystem_d.Subsystem_SubsysRanBC "" SBYTE CAN_2_Legs_whileloop_johnmessingabout_CM_int8 0 0 -128 127 ECU_ADDRESS 0x0021A174 /end MEASUREMENT
/begin MEASUREMENT CAN_2_Legs_whileloop_johnmessingabout_DW.icLoad "" UBYTE CAN_2_Legs_whileloop_johnmessingabout_CM_logical 0 0 0 1 ECU_ADDRESS 0x0021A172 /end MEASUREMENT
/begin MEASUREMENT CAN_2_Legs_whileloop_johnmessingabout_DW.icLoad_j "" UBYTE CAN_2_Legs_whileloop_johnmessingabout_CM_logical 0 0 0 1 ECU_ADDRESS 0x0021A173 /end MEASUREMENT
/begin MEASUREMENT CAN_2_Legs_whileloop_johnmessingabout_DW.po "" FLOAT64_IEEE CAN_2_Legs_whileloop_johnmessingabout_CM_double 0 0 -1.7E+308 1.7E+308 ECU_ADDRESS 0x00219FF8 /end MEASUREMENT
/begin MEASUREMENT CAN_2_Legs_whileloop_johnmessingabout_DW.po_m "" FLOAT64_IEEE CAN_2_Legs_whileloop_johnmessingabout_CM_double 0 0 -1.7E+308 1.7E+308 ECU_ADDRESS 0x0021A008 /end MEASUREMENT
/begin MEASUREMENT CAN_2_Legs_whileloop_johnmessingabout_DW.to "" FLOAT64_IEEE CAN_2_Legs_whileloop_johnmessingabout_CM_double 0 0 -1.7E+308 1.7E+308 ECU_ADDRESS 0x00219FF0 /end MEASUREMENT
/begin MEASUREMENT CAN_2_Legs_whileloop_johnmessingabout_DW.to_f "" FLOAT64_IEEE CAN_2_Legs_whileloop_johnmessingabout_CM_double 0 0 -1.7E+308 1.7E+308 ECU_ADDRESS 0x0021A000 /end MEASUREMENT
/begin COMPU_METHOD CAN_2_Legs_whileloop_johnmessingabout_CM_double "" IDENTICAL "%15.10" "" /end COMPU_METHOD
/begin COMPU_METHOD CAN_2_Legs_whileloop_johnmessingabout_CM_int32 "" IDENTICAL "%10.0" "" /end COMPU_METHOD
/begin COMPU_METHOD CAN_2_Legs_whileloop_johnmessingabout_CM_int8 "" IDENTICAL "%3.0" "" /end COMPU_METHOD
/begin COMPU_METHOD CAN_2_Legs_whileloop_johnmessingabout_CM_int_T "" IDENTICAL "customformat" "" /end COMPU_METHOD
/begin COMPU_METHOD CAN_2_Legs_whileloop_johnmessingabout_CM_logical "" IDENTICAL "%1.0" "" /end COMPU_METHOD
/begin COMPU_METHOD CAN_2_Legs_whileloop_johnmessingabout_CM_uint8 "" IDENTICAL "%3.0" "" /end COMPU_METHOD
/begin RECORD_LAYOUT Scalar_BOOLEAN FNC_VALUES 1 UBYTE COLUMN_DIR DIRECT /end RECORD_LAYOUT
/begin RECORD_LAYOUT Scalar_FLOAT64_IEEE FNC_VALUES 1 FLOAT64_IEEE COLUMN_DIR DIRECT /end RECORD_LAYOUT
/begin RECORD_LAYOUT Scalar_SBYTE FNC_VALUES 1 SBYTE COLUMN_DIR DIRECT /end RECORD_LAYOUT
/begin RECORD_LAYOUT Scalar_SLONG FNC_VALUES 1 SLONG COLUMN_DIR DIRECT /end RECORD_LAYOUT
/begin RECORD_LAYOUT Scalar_UBYTE FNC_VALUES 1 UBYTE COLUMN_DIR DIRECT /end RECORD_LAYOUT
/begin GROUP CAN_2_Legs_whileloop_johnmessingabout "CAN_2_Legs_whileloop_johnmessingabout" ROOT /end GROUP
/end MODULE
/end PROJECT
