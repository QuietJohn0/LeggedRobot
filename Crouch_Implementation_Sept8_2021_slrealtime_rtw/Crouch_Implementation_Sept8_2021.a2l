/******************************************************************************
* ASAP2 file: Crouch_Implementation_Sept8_2021.a2l
* Academic License - for use in teaching, academic research, and meeting
* course requirements at degree granting institutions only. Not for
* government, commercial, or other organizational use.
* Code generation for model "Crouch_Implementation_Sept8_2021".
* Model version : 1.38
* Simulink Coder version : 10.3 R2021a
* C source code generated on : Wed Sep 08 13:57:15 2021
* Target selection: slrealtime.tlc
* Embedded hardware selection: Intel->x86-64 (Linux 64)
* Code generation objectives: Unspecified
* Validation result: Not run
* (add additional file header information here)
******************************************************************************/ ASAP2_VERSION 1 71
/begin PROJECT ProjectName "Project Comment Goes Here"
/begin HEADER "Header Comments go here" /end HEADER
/begin MODULE ModuleName "Module Comment Goes Here"
/begin IF_DATA XCP
 /begin PROTOCOL_LAYER 0x0100 0x03E8 0x00C8 0x0000 0x0000 0x0000 0x0000 0x0000 0xFC 0x0578 BYTE_ORDER_MSB_LAST ADDRESS_GRANULARITY_BYTE OPTIONAL_CMD ALLOC_ODT_ENTRY OPTIONAL_CMD ALLOC_ODT OPTIONAL_CMD ALLOC_DAQ OPTIONAL_CMD FREE_DAQ OPTIONAL_CMD GET_DAQ_RESOLUTION_INFO OPTIONAL_CMD GET_DAQ_PROCESSOR_INFO OPTIONAL_CMD START_STOP_SYNCH OPTIONAL_CMD START_STOP_DAQ_LIST OPTIONAL_CMD SET_DAQ_LIST_MODE OPTIONAL_CMD WRITE_DAQ OPTIONAL_CMD SET_DAQ_PTR OPTIONAL_CMD GET_CAL_PAGE OPTIONAL_CMD SET_CAL_PAGE OPTIONAL_CMD COPY_CAL_PAGE OPTIONAL_CMD SHORT_DOWNLOAD OPTIONAL_CMD DOWNLOAD_MAX OPTIONAL_CMD DOWNLOAD OPTIONAL_CMD SHORT_UPLOAD OPTIONAL_CMD UPLOAD OPTIONAL_CMD SET_MTA /end PROTOCOL_LAYER
 /begin DAQ DYNAMIC 0x0000 0x0080 0x00 OPTIMISATION_TYPE_DEFAULT ADDRESS_EXTENSION_FREE IDENTIFICATION_FIELD_TYPE_RELATIVE_WORD_ALIGNED GRANULARITY_ODT_ENTRY_SIZE_DAQ_BYTE 0xFF OVERLOAD_INDICATION_PID PRESCALER_SUPPORTED /begin STIM GRANULARITY_ODT_ENTRY_SIZE_STIM_BYTE 0xFF /end STIM /begin TIMESTAMP_SUPPORTED 0x0001 SIZE_DWORD UNIT_1US TIMESTAMP_FIXED /end TIMESTAMP_SUPPORTED /begin EVENT "1 ms" "1 ms" 0x0000 DAQ 0xFF 0x01 0x06 0x00 /end EVENT /end DAQ
 /begin XCP_ON_UDP_IP 0x0100 0x15B3 ADDRESS "192.168.7.5" /end XCP_ON_UDP_IP
/end IF_DATA
/begin MOD_PAR "MOD PAR Comment Goes Here"
 /begin MEMORY_SEGMENT Crouch_Implementation__cal_impl "Crouch_Implementation__cal_impl" DATA FLASH INTERN 0x00218020 0x630 -1 -1 -1 -1 -1
  /begin IF_DATA XCP
   /begin SEGMENT 0x00 0x02 0x00 0x00 0x00
    /begin PAGE 0x00 ECU_ACCESS_DONT_CARE XCP_READ_ACCESS_DONT_CARE XCP_WRITE_ACCESS_NOT_ALLOWED /end PAGE
    /begin PAGE 0x01 ECU_ACCESS_DONT_CARE XCP_READ_ACCESS_DONT_CARE XCP_WRITE_ACCESS_DONT_CARE /end PAGE
   /end SEGMENT
  /end IF_DATA
 /end MEMORY_SEGMENT
/end MOD_PAR
/begin MOD_COMMON "Mod Common Comment Here" BYTE_ORDER MSB_LAST ALIGNMENT_BYTE 1 ALIGNMENT_WORD 2 ALIGNMENT_LONG 8 ALIGNMENT_FLOAT32_IEEE 4 ALIGNMENT_FLOAT64_IEEE 8 ALIGNMENT_INT64 4 /end MOD_COMMON
/begin CHARACTERISTIC Crouch_Implementation__cal_impl.CANRead_P1 "" VAL_BLK 0x00218100 Scalar_FLOAT64_IEEE 0 Crouch_Implementation_Sept8_2021_CM_double -1.7E+308 1.7E+308 MATRIX_DIM 6 1 /end CHARACTERISTIC
/begin CHARACTERISTIC Crouch_Implementation__cal_impl.CANSetup_P1 "" VAL_BLK 0x00218148 Scalar_FLOAT64_IEEE 0 Crouch_Implementation_Sept8_2021_CM_double -1.7E+308 1.7E+308 MATRIX_DIM 40 1 /end CHARACTERISTIC
/begin CHARACTERISTIC Crouch_Implementation__cal_impl.CANSetup_P2 "" VALUE 0x00218298 Scalar_FLOAT64_IEEE 0 Crouch_Implementation_Sept8_2021_CM_double -1.7E+308 1.7E+308 /end CHARACTERISTIC
/begin CHARACTERISTIC Crouch_Implementation__cal_impl.CANSetup_P3 "" VALUE 0x002182B0 Scalar_FLOAT64_IEEE 0 Crouch_Implementation_Sept8_2021_CM_double -1.7E+308 1.7E+308 /end CHARACTERISTIC
/begin CHARACTERISTIC Crouch_Implementation__cal_impl.CANStatus_P1 "" VALUE 0x002182F8 Scalar_FLOAT64_IEEE 0 Crouch_Implementation_Sept8_2021_CM_double -1.7E+308 1.7E+308 /end CHARACTERISTIC
/begin CHARACTERISTIC Crouch_Implementation__cal_impl.CANStatus_P10 "" VALUE 0x002183D0 Scalar_FLOAT64_IEEE 0 Crouch_Implementation_Sept8_2021_CM_double -1.7E+308 1.7E+308 /end CHARACTERISTIC
/begin CHARACTERISTIC Crouch_Implementation__cal_impl.CANStatus_P11 "" VALUE 0x002183E8 Scalar_FLOAT64_IEEE 0 Crouch_Implementation_Sept8_2021_CM_double -1.7E+308 1.7E+308 /end CHARACTERISTIC
/begin CHARACTERISTIC Crouch_Implementation__cal_impl.CANStatus_P12 "" VALUE 0x00218400 Scalar_FLOAT64_IEEE 0 Crouch_Implementation_Sept8_2021_CM_double -1.7E+308 1.7E+308 /end CHARACTERISTIC
/begin CHARACTERISTIC Crouch_Implementation__cal_impl.CANStatus_P13 "" VALUE 0x00218418 Scalar_FLOAT64_IEEE 0 Crouch_Implementation_Sept8_2021_CM_double -1.7E+308 1.7E+308 /end CHARACTERISTIC
/begin CHARACTERISTIC Crouch_Implementation__cal_impl.CANStatus_P14 "" VALUE 0x00218430 Scalar_FLOAT64_IEEE 0 Crouch_Implementation_Sept8_2021_CM_double -1.7E+308 1.7E+308 /end CHARACTERISTIC
/begin CHARACTERISTIC Crouch_Implementation__cal_impl.CANStatus_P15 "" VALUE 0x00218448 Scalar_FLOAT64_IEEE 0 Crouch_Implementation_Sept8_2021_CM_double -1.7E+308 1.7E+308 /end CHARACTERISTIC
/begin CHARACTERISTIC Crouch_Implementation__cal_impl.CANStatus_P16 "" VALUE 0x00218460 Scalar_FLOAT64_IEEE 0 Crouch_Implementation_Sept8_2021_CM_double -1.7E+308 1.7E+308 /end CHARACTERISTIC
/begin CHARACTERISTIC Crouch_Implementation__cal_impl.CANStatus_P17 "" VALUE 0x00218478 Scalar_FLOAT64_IEEE 0 Crouch_Implementation_Sept8_2021_CM_double -1.7E+308 1.7E+308 /end CHARACTERISTIC
/begin CHARACTERISTIC Crouch_Implementation__cal_impl.CANStatus_P18 "" VALUE 0x00218490 Scalar_FLOAT64_IEEE 0 Crouch_Implementation_Sept8_2021_CM_double -1.7E+308 1.7E+308 /end CHARACTERISTIC
/begin CHARACTERISTIC Crouch_Implementation__cal_impl.CANStatus_P19 "" VALUE 0x002184A8 Scalar_FLOAT64_IEEE 0 Crouch_Implementation_Sept8_2021_CM_double -1.7E+308 1.7E+308 /end CHARACTERISTIC
/begin CHARACTERISTIC Crouch_Implementation__cal_impl.CANStatus_P2 "" VALUE 0x00218310 Scalar_FLOAT64_IEEE 0 Crouch_Implementation_Sept8_2021_CM_double -1.7E+308 1.7E+308 /end CHARACTERISTIC
/begin CHARACTERISTIC Crouch_Implementation__cal_impl.CANStatus_P20 "" VALUE 0x002184C0 Scalar_FLOAT64_IEEE 0 Crouch_Implementation_Sept8_2021_CM_double -1.7E+308 1.7E+308 /end CHARACTERISTIC
/begin CHARACTERISTIC Crouch_Implementation__cal_impl.CANStatus_P21 "" VALUE 0x002184D8 Scalar_FLOAT64_IEEE 0 Crouch_Implementation_Sept8_2021_CM_double -1.7E+308 1.7E+308 /end CHARACTERISTIC
/begin CHARACTERISTIC Crouch_Implementation__cal_impl.CANStatus_P22 "" VALUE 0x002184F0 Scalar_FLOAT64_IEEE 0 Crouch_Implementation_Sept8_2021_CM_double -1.7E+308 1.7E+308 /end CHARACTERISTIC
/begin CHARACTERISTIC Crouch_Implementation__cal_impl.CANStatus_P23 "" VALUE 0x00218508 Scalar_FLOAT64_IEEE 0 Crouch_Implementation_Sept8_2021_CM_double -1.7E+308 1.7E+308 /end CHARACTERISTIC
/begin CHARACTERISTIC Crouch_Implementation__cal_impl.CANStatus_P24 "" VALUE 0x00218520 Scalar_FLOAT64_IEEE 0 Crouch_Implementation_Sept8_2021_CM_double -1.7E+308 1.7E+308 /end CHARACTERISTIC
/begin CHARACTERISTIC Crouch_Implementation__cal_impl.CANStatus_P25 "" VALUE 0x00218538 Scalar_FLOAT64_IEEE 0 Crouch_Implementation_Sept8_2021_CM_double -1.7E+308 1.7E+308 /end CHARACTERISTIC
/begin CHARACTERISTIC Crouch_Implementation__cal_impl.CANStatus_P26 "" VALUE 0x00218550 Scalar_FLOAT64_IEEE 0 Crouch_Implementation_Sept8_2021_CM_double -1.7E+308 1.7E+308 /end CHARACTERISTIC
/begin CHARACTERISTIC Crouch_Implementation__cal_impl.CANStatus_P27 "" VALUE 0x00218568 Scalar_FLOAT64_IEEE 0 Crouch_Implementation_Sept8_2021_CM_double -1.7E+308 1.7E+308 /end CHARACTERISTIC
/begin CHARACTERISTIC Crouch_Implementation__cal_impl.CANStatus_P28 "" VALUE 0x00218580 Scalar_FLOAT64_IEEE 0 Crouch_Implementation_Sept8_2021_CM_double -1.7E+308 1.7E+308 /end CHARACTERISTIC
/begin CHARACTERISTIC Crouch_Implementation__cal_impl.CANStatus_P29 "" VALUE 0x00218598 Scalar_FLOAT64_IEEE 0 Crouch_Implementation_Sept8_2021_CM_double -1.7E+308 1.7E+308 /end CHARACTERISTIC
/begin CHARACTERISTIC Crouch_Implementation__cal_impl.CANStatus_P3 "" VALUE 0x00218328 Scalar_FLOAT64_IEEE 0 Crouch_Implementation_Sept8_2021_CM_double -1.7E+308 1.7E+308 /end CHARACTERISTIC
/begin CHARACTERISTIC Crouch_Implementation__cal_impl.CANStatus_P30 "" VALUE 0x002185B0 Scalar_FLOAT64_IEEE 0 Crouch_Implementation_Sept8_2021_CM_double -1.7E+308 1.7E+308 /end CHARACTERISTIC
/begin CHARACTERISTIC Crouch_Implementation__cal_impl.CANStatus_P31 "" VALUE 0x002185C8 Scalar_FLOAT64_IEEE 0 Crouch_Implementation_Sept8_2021_CM_double -1.7E+308 1.7E+308 /end CHARACTERISTIC
/begin CHARACTERISTIC Crouch_Implementation__cal_impl.CANStatus_P32 "" VALUE 0x002185E0 Scalar_FLOAT64_IEEE 0 Crouch_Implementation_Sept8_2021_CM_double -1.7E+308 1.7E+308 /end CHARACTERISTIC
/begin CHARACTERISTIC Crouch_Implementation__cal_impl.CANStatus_P33 "" VALUE 0x002185F8 Scalar_FLOAT64_IEEE 0 Crouch_Implementation_Sept8_2021_CM_double -1.7E+308 1.7E+308 /end CHARACTERISTIC
/begin CHARACTERISTIC Crouch_Implementation__cal_impl.CANStatus_P34 "" VALUE 0x00218610 Scalar_FLOAT64_IEEE 0 Crouch_Implementation_Sept8_2021_CM_double -1.7E+308 1.7E+308 /end CHARACTERISTIC
/begin CHARACTERISTIC Crouch_Implementation__cal_impl.CANStatus_P4 "" VALUE 0x00218340 Scalar_FLOAT64_IEEE 0 Crouch_Implementation_Sept8_2021_CM_double -1.7E+308 1.7E+308 /end CHARACTERISTIC
/begin CHARACTERISTIC Crouch_Implementation__cal_impl.CANStatus_P5 "" VALUE 0x00218358 Scalar_FLOAT64_IEEE 0 Crouch_Implementation_Sept8_2021_CM_double -1.7E+308 1.7E+308 /end CHARACTERISTIC
/begin CHARACTERISTIC Crouch_Implementation__cal_impl.CANStatus_P6 "" VALUE 0x00218370 Scalar_FLOAT64_IEEE 0 Crouch_Implementation_Sept8_2021_CM_double -1.7E+308 1.7E+308 /end CHARACTERISTIC
/begin CHARACTERISTIC Crouch_Implementation__cal_impl.CANStatus_P7 "" VALUE 0x00218388 Scalar_FLOAT64_IEEE 0 Crouch_Implementation_Sept8_2021_CM_double -1.7E+308 1.7E+308 /end CHARACTERISTIC
/begin CHARACTERISTIC Crouch_Implementation__cal_impl.CANStatus_P8 "" VALUE 0x002183A0 Scalar_FLOAT64_IEEE 0 Crouch_Implementation_Sept8_2021_CM_double -1.7E+308 1.7E+308 /end CHARACTERISTIC
/begin CHARACTERISTIC Crouch_Implementation__cal_impl.CANStatus_P9 "" VALUE 0x002183B8 Scalar_FLOAT64_IEEE 0 Crouch_Implementation_Sept8_2021_CM_double -1.7E+308 1.7E+308 /end CHARACTERISTIC
/begin CHARACTERISTIC Crouch_Implementation__cal_impl.CANWrite1_P1 "" VAL_BLK 0x00218030 Scalar_FLOAT64_IEEE 0 Crouch_Implementation_Sept8_2021_CM_double -1.7E+308 1.7E+308 MATRIX_DIM 7 1 /end CHARACTERISTIC
/begin CHARACTERISTIC Crouch_Implementation__cal_impl.CANWrite1_P1_j "" VAL_BLK 0x00218078 Scalar_FLOAT64_IEEE 0 Crouch_Implementation_Sept8_2021_CM_double -1.7E+308 1.7E+308 MATRIX_DIM 7 1 /end CHARACTERISTIC
/begin CHARACTERISTIC Crouch_Implementation__cal_impl.Constant1_Value "" VAL_BLK 0x00218620 Scalar_UBYTE 0 Crouch_Implementation_Sept8_2021_CM_uint8 0 255 MATRIX_DIM 8 1 /end CHARACTERISTIC
/begin CHARACTERISTIC Crouch_Implementation__cal_impl.Constant1_Value_e "" VAL_BLK 0x00218638 Scalar_UBYTE 0 Crouch_Implementation_Sept8_2021_CM_uint8 0 255 MATRIX_DIM 8 1 /end CHARACTERISTIC
/begin CHARACTERISTIC Crouch_Implementation__cal_impl.Constant2_Value "" VALUE 0x002182E0 Scalar_FLOAT64_IEEE 0 Crouch_Implementation_Sept8_2021_CM_double -1.7E+308 1.7E+308 /end CHARACTERISTIC
/begin CHARACTERISTIC Crouch_Implementation__cal_impl.Constant2_Value_g "" VAL_BLK 0x00218628 Scalar_UBYTE 0 Crouch_Implementation_Sept8_2021_CM_uint8 0 255 MATRIX_DIM 8 1 /end CHARACTERISTIC
/begin CHARACTERISTIC Crouch_Implementation__cal_impl.Constant2_Value_k "" VAL_BLK 0x00218640 Scalar_UBYTE 0 Crouch_Implementation_Sept8_2021_CM_uint8 0 255 MATRIX_DIM 8 1 /end CHARACTERISTIC
/begin CHARACTERISTIC Crouch_Implementation__cal_impl.Constant8_Value "" VALUE 0x002182D8 Scalar_FLOAT64_IEEE 0 Crouch_Implementation_Sept8_2021_CM_double -1.7E+308 1.7E+308 /end CHARACTERISTIC
/begin CHARACTERISTIC Crouch_Implementation__cal_impl.Constant_Value "" VALUE 0x002182C8 Scalar_FLOAT64_IEEE 0 Crouch_Implementation_Sept8_2021_CM_double -1.7E+308 1.7E+308 /end CHARACTERISTIC
/begin CHARACTERISTIC Crouch_Implementation__cal_impl.Constant_Value_i "" VAL_BLK 0x00218630 Scalar_UBYTE 0 Crouch_Implementation_Sept8_2021_CM_uint8 0 255 MATRIX_DIM 8 1 /end CHARACTERISTIC
/begin CHARACTERISTIC Crouch_Implementation__cal_impl.Constant_Value_l "" VAL_BLK 0x00218618 Scalar_UBYTE 0 Crouch_Implementation_Sept8_2021_CM_uint8 0 255 MATRIX_DIM 8 1 /end CHARACTERISTIC
/begin CHARACTERISTIC Crouch_Implementation__cal_impl.Curr1_Y0 "" VALUE 0x002180C0 Scalar_FLOAT64_IEEE 0 Crouch_Implementation_Sept8_2021_CM_double -1.7E+308 1.7E+308 /end CHARACTERISTIC
/begin CHARACTERISTIC Crouch_Implementation__cal_impl.Curr2_Y0 "" VALUE 0x002180E0 Scalar_FLOAT64_IEEE 0 Crouch_Implementation_Sept8_2021_CM_double -1.7E+308 1.7E+308 /end CHARACTERISTIC
/begin CHARACTERISTIC Crouch_Implementation__cal_impl.Delay1_InitialCondition "" VALUE 0x002182C0 Scalar_FLOAT64_IEEE 0 Crouch_Implementation_Sept8_2021_CM_double -1.7E+308 1.7E+308 /end CHARACTERISTIC
/begin CHARACTERISTIC Crouch_Implementation__cal_impl.Delay_InitialCondition "" VALUE 0x002182B8 Scalar_FLOAT64_IEEE 0 Crouch_Implementation_Sept8_2021_CM_double -1.7E+308 1.7E+308 /end CHARACTERISTIC
/begin CHARACTERISTIC Crouch_Implementation__cal_impl.Gain_Gain "" VALUE 0x00218130 Scalar_FLOAT64_IEEE 0 Crouch_Implementation_Sept8_2021_CM_double -1.7E+308 1.7E+308 /end CHARACTERISTIC
/begin CHARACTERISTIC Crouch_Implementation__cal_impl.Gain_Gain_j "" VALUE 0x002182D0 Scalar_FLOAT64_IEEE 0 Crouch_Implementation_Sept8_2021_CM_double -1.7E+308 1.7E+308 /end CHARACTERISTIC
/begin CHARACTERISTIC Crouch_Implementation__cal_impl.ID1_Y0 "" VALUE 0x002180C8 Scalar_FLOAT64_IEEE 0 Crouch_Implementation_Sept8_2021_CM_double -1.7E+308 1.7E+308 /end CHARACTERISTIC
/begin CHARACTERISTIC Crouch_Implementation__cal_impl.ID2_Y0 "" VALUE 0x002180E8 Scalar_FLOAT64_IEEE 0 Crouch_Implementation_Sept8_2021_CM_double -1.7E+308 1.7E+308 /end CHARACTERISTIC
/begin CHARACTERISTIC Crouch_Implementation__cal_impl.P1_Y0 "" VALUE 0x002180B0 Scalar_FLOAT64_IEEE 0 Crouch_Implementation_Sept8_2021_CM_double -1.7E+308 1.7E+308 /end CHARACTERISTIC
/begin CHARACTERISTIC Crouch_Implementation__cal_impl.P2_Y0 "" VALUE 0x002180D0 Scalar_FLOAT64_IEEE 0 Crouch_Implementation_Sept8_2021_CM_double -1.7E+308 1.7E+308 /end CHARACTERISTIC
/begin CHARACTERISTIC Crouch_Implementation__cal_impl.Status1_Y0 "" VALUE 0x00218648 Scalar_UBYTE 0 Crouch_Implementation_Sept8_2021_CM_uint8 0 255 /end CHARACTERISTIC
/begin CHARACTERISTIC Crouch_Implementation__cal_impl.Status2_Y0 "" VALUE 0x00218649 Scalar_UBYTE 0 Crouch_Implementation_Sept8_2021_CM_uint8 0 255 /end CHARACTERISTIC
/begin CHARACTERISTIC Crouch_Implementation__cal_impl.V1_Y0 "" VALUE 0x002180B8 Scalar_FLOAT64_IEEE 0 Crouch_Implementation_Sept8_2021_CM_double -1.7E+308 1.7E+308 /end CHARACTERISTIC
/begin CHARACTERISTIC Crouch_Implementation__cal_impl.V2_Y0 "" VALUE 0x002180D8 Scalar_FLOAT64_IEEE 0 Crouch_Implementation_Sept8_2021_CM_double -1.7E+308 1.7E+308 /end CHARACTERISTIC
/begin MEASUREMENT Crouch_Implementation_Sept8_2021_B.BytePacking "" UBYTE Crouch_Implementation_Sept8_2021_CM_uint8 0 0 0 255 LAYOUT COLUMN_DIR MATRIX_DIM 8 ECU_ADDRESS 0x0021B44E /end MEASUREMENT
/begin MEASUREMENT Crouch_Implementation_Sept8_2021_B.BytePacking_o "" UBYTE Crouch_Implementation_Sept8_2021_CM_uint8 0 0 0 255 LAYOUT COLUMN_DIR MATRIX_DIM 8 ECU_ADDRESS 0x0021B45E /end MEASUREMENT
/begin MEASUREMENT Crouch_Implementation_Sept8_2021_B.CANRead_o1 "" UBYTE Crouch_Implementation_Sept8_2021_CM_logical 0 0 0 1 ECU_ADDRESS 0x0021B466 /end MEASUREMENT
/begin MEASUREMENT Crouch_Implementation_Sept8_2021_B.CANUnpack_o1 "" FLOAT64_IEEE Crouch_Implementation_Sept8_2021_CM_double 0 0 -1.7E+308 1.7E+308 ECU_ADDRESS 0x0021B318 /end MEASUREMENT
/begin MEASUREMENT Crouch_Implementation_Sept8_2021_B.CANUnpack_o1_f "" FLOAT64_IEEE Crouch_Implementation_Sept8_2021_CM_double 0 0 -1.7E+308 1.7E+308 ECU_ADDRESS 0x0021B350 /end MEASUREMENT
/begin MEASUREMENT Crouch_Implementation_Sept8_2021_B.CANUnpack_o2 "" FLOAT64_IEEE Crouch_Implementation_Sept8_2021_CM_double 0 0 -1.7E+308 1.7E+308 ECU_ADDRESS 0x0021B320 /end MEASUREMENT
/begin MEASUREMENT Crouch_Implementation_Sept8_2021_B.CANUnpack_o2_l "" FLOAT64_IEEE Crouch_Implementation_Sept8_2021_CM_double 0 0 -1.7E+308 1.7E+308 ECU_ADDRESS 0x0021B358 /end MEASUREMENT
/begin MEASUREMENT Crouch_Implementation_Sept8_2021_B.CANUnpack_o3 "" FLOAT64_IEEE Crouch_Implementation_Sept8_2021_CM_double 0 0 -1.7E+308 1.7E+308 ECU_ADDRESS 0x0021B328 /end MEASUREMENT
/begin MEASUREMENT Crouch_Implementation_Sept8_2021_B.CANUnpack_o3_k "" FLOAT64_IEEE Crouch_Implementation_Sept8_2021_CM_double 0 0 -1.7E+308 1.7E+308 ECU_ADDRESS 0x0021B360 /end MEASUREMENT
/begin MEASUREMENT Crouch_Implementation_Sept8_2021_B.CANUnpack_o4 "" FLOAT64_IEEE Crouch_Implementation_Sept8_2021_CM_double 0 0 -1.7E+308 1.7E+308 ECU_ADDRESS 0x0021B330 /end MEASUREMENT
/begin MEASUREMENT Crouch_Implementation_Sept8_2021_B.CANUnpack_o4_i "" FLOAT64_IEEE Crouch_Implementation_Sept8_2021_CM_double 0 0 -1.7E+308 1.7E+308 ECU_ADDRESS 0x0021B368 /end MEASUREMENT
/begin MEASUREMENT Crouch_Implementation_Sept8_2021_B.CANUnpack_o5 "" UBYTE Crouch_Implementation_Sept8_2021_CM_uint8 0 0 0 255 ECU_ADDRESS 0x0021B444 /end MEASUREMENT
/begin MEASUREMENT Crouch_Implementation_Sept8_2021_B.CANUnpack_o5_p "" UBYTE Crouch_Implementation_Sept8_2021_CM_uint8 0 0 0 255 ECU_ADDRESS 0x0021B445 /end MEASUREMENT
/begin MEASUREMENT Crouch_Implementation_Sept8_2021_B.Clock "" FLOAT64_IEEE Crouch_Implementation_Sept8_2021_CM_double 0 0 -1.7E+308 1.7E+308 ECU_ADDRESS 0x0021B308 /end MEASUREMENT
/begin MEASUREMENT Crouch_Implementation_Sept8_2021_B.Constant "" FLOAT64_IEEE Crouch_Implementation_Sept8_2021_CM_double 0 0 -1.7E+308 1.7E+308 ECU_ADDRESS 0x0021B2D8 /end MEASUREMENT
/begin MEASUREMENT Crouch_Implementation_Sept8_2021_B.Constant2 "" FLOAT64_IEEE Crouch_Implementation_Sept8_2021_CM_double 0 0 -1.7E+308 1.7E+308 ECU_ADDRESS 0x0021B2F0 /end MEASUREMENT
/begin MEASUREMENT Crouch_Implementation_Sept8_2021_B.Constant8 "" FLOAT64_IEEE Crouch_Implementation_Sept8_2021_CM_double 0 0 -1.7E+308 1.7E+308 ECU_ADDRESS 0x0021B2E8 /end MEASUREMENT
/begin MEASUREMENT Crouch_Implementation_Sept8_2021_B.Current1Derivative "" FLOAT64_IEEE Crouch_Implementation_Sept8_2021_CM_double 0 0 -1.7E+308 1.7E+308 ECU_ADDRESS 0x0021B2F8 /end MEASUREMENT
/begin MEASUREMENT Crouch_Implementation_Sept8_2021_B.Current2Derivative "" FLOAT64_IEEE Crouch_Implementation_Sept8_2021_CM_double 0 0 -1.7E+308 1.7E+308 ECU_ADDRESS 0x0021B300 /end MEASUREMENT
/begin MEASUREMENT Crouch_Implementation_Sept8_2021_B.Delay "" FLOAT64_IEEE Crouch_Implementation_Sept8_2021_CM_double 0 0 -1.7E+308 1.7E+308 ECU_ADDRESS 0x0021B2C8 /end MEASUREMENT
/begin MEASUREMENT Crouch_Implementation_Sept8_2021_B.Delay1 "" FLOAT64_IEEE Crouch_Implementation_Sept8_2021_CM_double 0 0 -1.7E+308 1.7E+308 ECU_ADDRESS 0x0021B2D0 /end MEASUREMENT
/begin MEASUREMENT Crouch_Implementation_Sept8_2021_B.GRF "" FLOAT64_IEEE Crouch_Implementation_Sept8_2021_CM_double 0 0 -1.7E+308 1.7E+308 ECU_ADDRESS 0x0021B3C0 /end MEASUREMENT
/begin MEASUREMENT Crouch_Implementation_Sept8_2021_B.GRF_e "" FLOAT64_IEEE Crouch_Implementation_Sept8_2021_CM_double 0 0 -1.7E+308 1.7E+308 ECU_ADDRESS 0x0021B438 /end MEASUREMENT
/begin MEASUREMENT Crouch_Implementation_Sept8_2021_B.Gain "" FLOAT64_IEEE Crouch_Implementation_Sept8_2021_CM_double 0 0 -1.7E+308 1.7E+308 ECU_ADDRESS 0x0021B2E0 /end MEASUREMENT
/begin MEASUREMENT Crouch_Implementation_Sept8_2021_B.Gain_m "" FLOAT64_IEEE Crouch_Implementation_Sept8_2021_CM_double 0 0 -1.7E+308 1.7E+308 ECU_ADDRESS 0x0021B310 /end MEASUREMENT
/begin MEASUREMENT Crouch_Implementation_Sept8_2021_B.I_ff "" FLOAT64_IEEE Crouch_Implementation_Sept8_2021_CM_double 0 0 -1.7E+308 1.7E+308 ECU_ADDRESS 0x0021B348 /end MEASUREMENT
/begin MEASUREMENT Crouch_Implementation_Sept8_2021_B.I_ff_o "" FLOAT64_IEEE Crouch_Implementation_Sept8_2021_CM_double 0 0 -1.7E+308 1.7E+308 ECU_ADDRESS 0x0021B380 /end MEASUREMENT
/begin MEASUREMENT Crouch_Implementation_Sept8_2021_B.Kd1 "" FLOAT64_IEEE Crouch_Implementation_Sept8_2021_CM_double 0 0 -1.7E+308 1.7E+308 ECU_ADDRESS 0x0021B408 /end MEASUREMENT
/begin MEASUREMENT Crouch_Implementation_Sept8_2021_B.Kd2 "" FLOAT64_IEEE Crouch_Implementation_Sept8_2021_CM_double 0 0 -1.7E+308 1.7E+308 ECU_ADDRESS 0x0021B410 /end MEASUREMENT
/begin MEASUREMENT Crouch_Implementation_Sept8_2021_B.Kp1 "" FLOAT64_IEEE Crouch_Implementation_Sept8_2021_CM_double 0 0 -1.7E+308 1.7E+308 ECU_ADDRESS 0x0021B3F8 /end MEASUREMENT
/begin MEASUREMENT Crouch_Implementation_Sept8_2021_B.Kp2 "" FLOAT64_IEEE Crouch_Implementation_Sept8_2021_CM_double 0 0 -1.7E+308 1.7E+308 ECU_ADDRESS 0x0021B400 /end MEASUREMENT
/begin MEASUREMENT Crouch_Implementation_Sept8_2021_B.MultiportSwitch "" UBYTE Crouch_Implementation_Sept8_2021_CM_uint8 0 0 0 255 LAYOUT COLUMN_DIR MATRIX_DIM 8 ECU_ADDRESS 0x0021B446 /end MEASUREMENT
/begin MEASUREMENT Crouch_Implementation_Sept8_2021_B.MultiportSwitch_f "" UBYTE Crouch_Implementation_Sept8_2021_CM_uint8 0 0 0 255 LAYOUT COLUMN_DIR MATRIX_DIM 8 ECU_ADDRESS 0x0021B456 /end MEASUREMENT
/begin MEASUREMENT Crouch_Implementation_Sept8_2021_B.T1 "" FLOAT64_IEEE Crouch_Implementation_Sept8_2021_CM_double 0 0 -1.7E+308 1.7E+308 ECU_ADDRESS 0x0021B3E8 /end MEASUREMENT
/begin MEASUREMENT Crouch_Implementation_Sept8_2021_B.T2 "" FLOAT64_IEEE Crouch_Implementation_Sept8_2021_CM_double 0 0 -1.7E+308 1.7E+308 ECU_ADDRESS 0x0021B3F0 /end MEASUREMENT
/begin MEASUREMENT Crouch_Implementation_Sept8_2021_B.Tcalc1 "" FLOAT64_IEEE Crouch_Implementation_Sept8_2021_CM_double 0 0 -1.7E+308 1.7E+308 ECU_ADDRESS 0x0021B420 /end MEASUREMENT
/begin MEASUREMENT Crouch_Implementation_Sept8_2021_B.Tcalc2 "" FLOAT64_IEEE Crouch_Implementation_Sept8_2021_CM_double 0 0 -1.7E+308 1.7E+308 ECU_ADDRESS 0x0021B428 /end MEASUREMENT
/begin MEASUREMENT Crouch_Implementation_Sept8_2021_B.TmpSignalConversionAtSFunctio_i "" FLOAT64_IEEE Crouch_Implementation_Sept8_2021_CM_double 0 0 -1.7E+308 1.7E+308 LAYOUT COLUMN_DIR MATRIX_DIM 2 ECU_ADDRESS 0x0021B3B0 /end MEASUREMENT
/begin MEASUREMENT Crouch_Implementation_Sept8_2021_B.TmpSignalConversionAtSFunctio_l "" FLOAT64_IEEE Crouch_Implementation_Sept8_2021_CM_double 0 0 -1.7E+308 1.7E+308 LAYOUT COLUMN_DIR MATRIX_DIM 2 ECU_ADDRESS 0x0021B3A0 /end MEASUREMENT
/begin MEASUREMENT Crouch_Implementation_Sept8_2021_B.TmpSignalConversionAtSFunctionI "" FLOAT64_IEEE Crouch_Implementation_Sept8_2021_CM_double 0 0 -1.7E+308 1.7E+308 LAYOUT COLUMN_DIR MATRIX_DIM 2 ECU_ADDRESS 0x0021B388 /end MEASUREMENT
/begin MEASUREMENT Crouch_Implementation_Sept8_2021_B.WhileIterator "" SLONG Crouch_Implementation_Sept8_2021_CM_int32 0 0 -2147483648 2147483647 ECU_ADDRESS 0x0021B440 /end MEASUREMENT
/begin MEASUREMENT Crouch_Implementation_Sept8_2021_B.c "" FLOAT64_IEEE Crouch_Implementation_Sept8_2021_CM_double 0 0 -1.7E+308 1.7E+308 ECU_ADDRESS 0x0021B3E0 /end MEASUREMENT
/begin MEASUREMENT Crouch_Implementation_Sept8_2021_B.calcForceX "" FLOAT64_IEEE Crouch_Implementation_Sept8_2021_CM_double 0 0 -1.7E+308 1.7E+308 ECU_ADDRESS 0x0021B430 /end MEASUREMENT
/begin MEASUREMENT Crouch_Implementation_Sept8_2021_B.danger "" FLOAT64_IEEE Crouch_Implementation_Sept8_2021_CM_double 0 0 -1.7E+308 1.7E+308 ECU_ADDRESS 0x0021B398 /end MEASUREMENT
/begin MEASUREMENT Crouch_Implementation_Sept8_2021_B.exitY "" FLOAT64_IEEE Crouch_Implementation_Sept8_2021_CM_double 0 0 -1.7E+308 1.7E+308 ECU_ADDRESS 0x0021B418 /end MEASUREMENT
/begin MEASUREMENT Crouch_Implementation_Sept8_2021_B.position "" FLOAT64_IEEE Crouch_Implementation_Sept8_2021_CM_double 0 0 -1.7E+308 1.7E+308 ECU_ADDRESS 0x0021B338 /end MEASUREMENT
/begin MEASUREMENT Crouch_Implementation_Sept8_2021_B.position_j "" FLOAT64_IEEE Crouch_Implementation_Sept8_2021_CM_double 0 0 -1.7E+308 1.7E+308 ECU_ADDRESS 0x0021B370 /end MEASUREMENT
/begin MEASUREMENT Crouch_Implementation_Sept8_2021_B.sf_floatsbytes.b "" UBYTE Crouch_Implementation_Sept8_2021_CM_uint8 0 0 0 255 LAYOUT COLUMN_DIR MATRIX_DIM 8 ECU_ADDRESS 0x0021B46F /end MEASUREMENT
/begin MEASUREMENT Crouch_Implementation_Sept8_2021_B.sf_floatsbytes_o.b "" UBYTE Crouch_Implementation_Sept8_2021_CM_uint8 0 0 0 255 LAYOUT COLUMN_DIR MATRIX_DIM 8 ECU_ADDRESS 0x0021B467 /end MEASUREMENT
/begin MEASUREMENT Crouch_Implementation_Sept8_2021_B.stop "" FLOAT64_IEEE Crouch_Implementation_Sept8_2021_CM_double 0 0 -1.7E+308 1.7E+308 ECU_ADDRESS 0x0021B3C8 /end MEASUREMENT
/begin MEASUREMENT Crouch_Implementation_Sept8_2021_B.theta1 "" FLOAT64_IEEE Crouch_Implementation_Sept8_2021_CM_double 0 0 -1.7E+308 1.7E+308 ECU_ADDRESS 0x0021B3D0 /end MEASUREMENT
/begin MEASUREMENT Crouch_Implementation_Sept8_2021_B.theta2 "" FLOAT64_IEEE Crouch_Implementation_Sept8_2021_CM_double 0 0 -1.7E+308 1.7E+308 ECU_ADDRESS 0x0021B3D8 /end MEASUREMENT
/begin MEASUREMENT Crouch_Implementation_Sept8_2021_B.velocity "" FLOAT64_IEEE Crouch_Implementation_Sept8_2021_CM_double 0 0 -1.7E+308 1.7E+308 ECU_ADDRESS 0x0021B340 /end MEASUREMENT
/begin MEASUREMENT Crouch_Implementation_Sept8_2021_B.velocity_h "" FLOAT64_IEEE Crouch_Implementation_Sept8_2021_CM_double 0 0 -1.7E+308 1.7E+308 ECU_ADDRESS 0x0021B378 /end MEASUREMENT
/begin MEASUREMENT Crouch_Implementation_Sept8_2021_DW.CANUnpack_ModeSignalID "" SLONG Crouch_Implementation_Sept8_2021_CM_int_T 0 0 -2147483648 2147483647 ECU_ADDRESS 0x0021B25C /end MEASUREMENT
/begin MEASUREMENT Crouch_Implementation_Sept8_2021_DW.CANUnpack_ModeSignalID_d "" SLONG Crouch_Implementation_Sept8_2021_CM_int_T 0 0 -2147483648 2147483647 ECU_ADDRESS 0x0021B264 /end MEASUREMENT
/begin MEASUREMENT Crouch_Implementation_Sept8_2021_DW.CANUnpack_StatusPortID "" SLONG Crouch_Implementation_Sept8_2021_CM_int_T 0 0 -2147483648 2147483647 ECU_ADDRESS 0x0021B260 /end MEASUREMENT
/begin MEASUREMENT Crouch_Implementation_Sept8_2021_DW.CANUnpack_StatusPortID_f "" SLONG Crouch_Implementation_Sept8_2021_CM_int_T 0 0 -2147483648 2147483647 ECU_ADDRESS 0x0021B268 /end MEASUREMENT
/begin MEASUREMENT Crouch_Implementation_Sept8_2021_DW.Delay1_DSTATE "" FLOAT64_IEEE Crouch_Implementation_Sept8_2021_CM_double 0 0 -1.7E+308 1.7E+308 ECU_ADDRESS 0x0021AFA8 /end MEASUREMENT
/begin MEASUREMENT Crouch_Implementation_Sept8_2021_DW.Delay_DSTATE "" FLOAT64_IEEE Crouch_Implementation_Sept8_2021_CM_double 0 0 -1.7E+308 1.7E+308 ECU_ADDRESS 0x0021AFA0 /end MEASUREMENT
/begin MEASUREMENT Crouch_Implementation_Sept8_2021_DW.FStart "" FLOAT64_IEEE Crouch_Implementation_Sept8_2021_CM_double 0 0 -1.7E+308 1.7E+308 ECU_ADDRESS 0x0021B048 /end MEASUREMENT
/begin MEASUREMENT Crouch_Implementation_Sept8_2021_DW.Idle "" FLOAT64_IEEE Crouch_Implementation_Sept8_2021_CM_double 0 0 -1.7E+308 1.7E+308 ECU_ADDRESS 0x0021B030 /end MEASUREMENT
/begin MEASUREMENT Crouch_Implementation_Sept8_2021_DW.LastUAtTimeA "" FLOAT64_IEEE Crouch_Implementation_Sept8_2021_CM_double 0 0 -1.7E+308 1.7E+308 ECU_ADDRESS 0x0021AFB8 /end MEASUREMENT
/begin MEASUREMENT Crouch_Implementation_Sept8_2021_DW.LastUAtTimeA_d "" FLOAT64_IEEE Crouch_Implementation_Sept8_2021_CM_double 0 0 -1.7E+308 1.7E+308 ECU_ADDRESS 0x0021AFD8 /end MEASUREMENT
/begin MEASUREMENT Crouch_Implementation_Sept8_2021_DW.LastUAtTimeB "" FLOAT64_IEEE Crouch_Implementation_Sept8_2021_CM_double 0 0 -1.7E+308 1.7E+308 ECU_ADDRESS 0x0021AFC8 /end MEASUREMENT
/begin MEASUREMENT Crouch_Implementation_Sept8_2021_DW.LastUAtTimeB_p "" FLOAT64_IEEE Crouch_Implementation_Sept8_2021_CM_double 0 0 -1.7E+308 1.7E+308 ECU_ADDRESS 0x0021AFE8 /end MEASUREMENT
/begin MEASUREMENT Crouch_Implementation_Sept8_2021_DW.Th2Th1 "" FLOAT64_IEEE Crouch_Implementation_Sept8_2021_CM_double 0 0 -1.7E+308 1.7E+308 ECU_ADDRESS 0x0021B050 /end MEASUREMENT
/begin MEASUREMENT Crouch_Implementation_Sept8_2021_DW.TimeStampA "" FLOAT64_IEEE Crouch_Implementation_Sept8_2021_CM_double 0 0 -1.7E+308 1.7E+308 ECU_ADDRESS 0x0021AFB0 /end MEASUREMENT
/begin MEASUREMENT Crouch_Implementation_Sept8_2021_DW.TimeStampA_o "" FLOAT64_IEEE Crouch_Implementation_Sept8_2021_CM_double 0 0 -1.7E+308 1.7E+308 ECU_ADDRESS 0x0021AFD0 /end MEASUREMENT
/begin MEASUREMENT Crouch_Implementation_Sept8_2021_DW.TimeStampB "" FLOAT64_IEEE Crouch_Implementation_Sept8_2021_CM_double 0 0 -1.7E+308 1.7E+308 ECU_ADDRESS 0x0021AFC0 /end MEASUREMENT
/begin MEASUREMENT Crouch_Implementation_Sept8_2021_DW.TimeStampB_m "" FLOAT64_IEEE Crouch_Implementation_Sept8_2021_CM_double 0 0 -1.7E+308 1.7E+308 ECU_ADDRESS 0x0021AFE0 /end MEASUREMENT
/begin MEASUREMENT Crouch_Implementation_Sept8_2021_DW.done "" FLOAT64_IEEE Crouch_Implementation_Sept8_2021_CM_double 0 0 -1.7E+308 1.7E+308 ECU_ADDRESS 0x0021AFF0 /end MEASUREMENT
/begin MEASUREMENT Crouch_Implementation_Sept8_2021_DW.hop "" FLOAT64_IEEE Crouch_Implementation_Sept8_2021_CM_double 0 0 -1.7E+308 1.7E+308 ECU_ADDRESS 0x0021B038 /end MEASUREMENT
/begin MEASUREMENT Crouch_Implementation_Sept8_2021_DW.is_Command "" ULONG Crouch_Implementation_Sept8_2021_CM_uint32 0 0 0 2147483646 ECU_ADDRESS 0x0021B1C8 /end MEASUREMENT
/begin MEASUREMENT Crouch_Implementation_Sept8_2021_DW.is_Flight "" ULONG Crouch_Implementation_Sept8_2021_CM_uint32 0 0 0 2147483646 ECU_ADDRESS 0x0021B1CC /end MEASUREMENT
/begin MEASUREMENT Crouch_Implementation_Sept8_2021_DW.is_Stance "" ULONG Crouch_Implementation_Sept8_2021_CM_uint32 0 0 0 2147483646 ECU_ADDRESS 0x0021B1D0 /end MEASUREMENT
/begin MEASUREMENT Crouch_Implementation_Sept8_2021_DW.is_active_c8_Crouch_Implementat "" UBYTE Crouch_Implementation_Sept8_2021_CM_uint8 0 0 0 255 ECU_ADDRESS 0x0021B27E /end MEASUREMENT
/begin MEASUREMENT Crouch_Implementation_Sept8_2021_DW.is_c8_Crouch_Implementation_Sep "" ULONG Crouch_Implementation_Sept8_2021_CM_uint32 0 0 0 2147483646 ECU_ADDRESS 0x0021B1C4 /end MEASUREMENT
/begin MEASUREMENT Crouch_Implementation_Sept8_2021_DW.jumped "" FLOAT64_IEEE Crouch_Implementation_Sept8_2021_CM_double 0 0 -1.7E+308 1.7E+308 ECU_ADDRESS 0x0021B058 /end MEASUREMENT
/begin MEASUREMENT Crouch_Implementation_Sept8_2021_DW.pf "" FLOAT64_IEEE Crouch_Implementation_Sept8_2021_CM_double 0 0 -1.7E+308 1.7E+308 ECU_ADDRESS 0x0021AFF8 /end MEASUREMENT
/begin MEASUREMENT Crouch_Implementation_Sept8_2021_DW.po1 "" FLOAT64_IEEE Crouch_Implementation_Sept8_2021_CM_double 0 0 -1.7E+308 1.7E+308 ECU_ADDRESS 0x0021B010 /end MEASUREMENT
/begin MEASUREMENT Crouch_Implementation_Sept8_2021_DW.po2 "" FLOAT64_IEEE Crouch_Implementation_Sept8_2021_CM_double 0 0 -1.7E+308 1.7E+308 ECU_ADDRESS 0x0021B018 /end MEASUREMENT
/begin MEASUREMENT Crouch_Implementation_Sept8_2021_DW.sfEvent "" SLONG Crouch_Implementation_Sept8_2021_CM_int32 0 0 -2147483648 2147483647 ECU_ADDRESS 0x0021B1C0 /end MEASUREMENT
/begin MEASUREMENT Crouch_Implementation_Sept8_2021_DW.slope1 "" FLOAT64_IEEE Crouch_Implementation_Sept8_2021_CM_double 0 0 -1.7E+308 1.7E+308 ECU_ADDRESS 0x0021B020 /end MEASUREMENT
/begin MEASUREMENT Crouch_Implementation_Sept8_2021_DW.slope2 "" FLOAT64_IEEE Crouch_Implementation_Sept8_2021_CM_double 0 0 -1.7E+308 1.7E+308 ECU_ADDRESS 0x0021B028 /end MEASUREMENT
/begin MEASUREMENT Crouch_Implementation_Sept8_2021_DW.temporalCounter_i1 "" UBYTE Crouch_Implementation_Sept8_2021_CM_uint8 0 0 0 255 ECU_ADDRESS 0x0021B27F /end MEASUREMENT
/begin MEASUREMENT Crouch_Implementation_Sept8_2021_DW.temporalCounter_i2 "" UWORD Crouch_Implementation_Sept8_2021_CM_uint16 0 0 0 65535 ECU_ADDRESS 0x0021B27C /end MEASUREMENT
/begin MEASUREMENT Crouch_Implementation_Sept8_2021_DW.time "" FLOAT64_IEEE Crouch_Implementation_Sept8_2021_CM_double 0 0 -1.7E+308 1.7E+308 ECU_ADDRESS 0x0021B040 /end MEASUREMENT
/begin MEASUREMENT Crouch_Implementation_Sept8_2021_DW.to "" FLOAT64_IEEE Crouch_Implementation_Sept8_2021_CM_double 0 0 -1.7E+308 1.7E+308 ECU_ADDRESS 0x0021B008 /end MEASUREMENT
/begin MEASUREMENT Crouch_Implementation_Sept8_2021_DW.tstep "" FLOAT64_IEEE Crouch_Implementation_Sept8_2021_CM_double 0 0 -1.7E+308 1.7E+308 ECU_ADDRESS 0x0021B000 /end MEASUREMENT
/begin COMPU_METHOD Crouch_Implementation_Sept8_2021_CM_double "" IDENTICAL "%15.10" "" /end COMPU_METHOD
/begin COMPU_METHOD Crouch_Implementation_Sept8_2021_CM_int32 "" IDENTICAL "%10.0" "" /end COMPU_METHOD
/begin COMPU_METHOD Crouch_Implementation_Sept8_2021_CM_int_T "" IDENTICAL "customformat" "" /end COMPU_METHOD
/begin COMPU_METHOD Crouch_Implementation_Sept8_2021_CM_logical "" IDENTICAL "%1.0" "" /end COMPU_METHOD
/begin COMPU_METHOD Crouch_Implementation_Sept8_2021_CM_uint16 "" IDENTICAL "%5.0" "" /end COMPU_METHOD
/begin COMPU_METHOD Crouch_Implementation_Sept8_2021_CM_uint32 "" IDENTICAL "%10.0" "" /end COMPU_METHOD
/begin COMPU_METHOD Crouch_Implementation_Sept8_2021_CM_uint8 "" IDENTICAL "%3.0" "" /end COMPU_METHOD
/begin RECORD_LAYOUT Scalar_BOOLEAN FNC_VALUES 1 UBYTE COLUMN_DIR DIRECT /end RECORD_LAYOUT
/begin RECORD_LAYOUT Scalar_FLOAT64_IEEE FNC_VALUES 1 FLOAT64_IEEE COLUMN_DIR DIRECT /end RECORD_LAYOUT
/begin RECORD_LAYOUT Scalar_SLONG FNC_VALUES 1 SLONG COLUMN_DIR DIRECT /end RECORD_LAYOUT
/begin RECORD_LAYOUT Scalar_UBYTE FNC_VALUES 1 UBYTE COLUMN_DIR DIRECT /end RECORD_LAYOUT
/begin RECORD_LAYOUT Scalar_ULONG FNC_VALUES 1 ULONG COLUMN_DIR DIRECT /end RECORD_LAYOUT
/begin RECORD_LAYOUT Scalar_UWORD FNC_VALUES 1 UWORD COLUMN_DIR DIRECT /end RECORD_LAYOUT
/begin GROUP Crouch_Implementation_Sept8_2021 "Crouch_Implementation_Sept8_2021" ROOT /end GROUP
/end MODULE
/end PROJECT
