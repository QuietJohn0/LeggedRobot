/******************************************************************************
* ASAP2 file: Main_Sept1_2021.a2l
* Academic License - for use in teaching, academic research, and meeting
* course requirements at degree granting institutions only. Not for
* government, commercial, or other organizational use.
* Code generation for model "Main_Sept1_2021".
* Model version : 1.51
* Simulink Coder version : 10.3 R2021a
* C source code generated on : Thu May 19 16:57:05 2022
* Target selection: slrealtime.tlc
* Embedded hardware selection: Intel->x86-64 (Linux 64)
* Code generation objectives: Unspecified
* Validation result: Not run
* (add additional file header information here)
******************************************************************************/ ASAP2_VERSION 1 71
/begin PROJECT ProjectName "Project Comment Goes Here"
/begin HEADER "Header Comments go here" /end HEADER
/begin MODULE ModuleName "Module Comment Goes Here"
/begin IF_DATA XCP
 /begin PROTOCOL_LAYER 0x0100 0x03E8 0x00C8 0x0000 0x0000 0x0000 0x0000 0x0000 0xFC 0x0578 BYTE_ORDER_MSB_LAST ADDRESS_GRANULARITY_BYTE OPTIONAL_CMD ALLOC_ODT_ENTRY OPTIONAL_CMD ALLOC_ODT OPTIONAL_CMD ALLOC_DAQ OPTIONAL_CMD FREE_DAQ OPTIONAL_CMD GET_DAQ_RESOLUTION_INFO OPTIONAL_CMD GET_DAQ_PROCESSOR_INFO OPTIONAL_CMD START_STOP_SYNCH OPTIONAL_CMD START_STOP_DAQ_LIST OPTIONAL_CMD SET_DAQ_LIST_MODE OPTIONAL_CMD WRITE_DAQ OPTIONAL_CMD SET_DAQ_PTR OPTIONAL_CMD GET_CAL_PAGE OPTIONAL_CMD SET_CAL_PAGE OPTIONAL_CMD COPY_CAL_PAGE OPTIONAL_CMD SHORT_DOWNLOAD OPTIONAL_CMD DOWNLOAD_MAX OPTIONAL_CMD DOWNLOAD OPTIONAL_CMD SHORT_UPLOAD OPTIONAL_CMD UPLOAD OPTIONAL_CMD SET_MTA /end PROTOCOL_LAYER
 /begin DAQ DYNAMIC 0x0000 0x0080 0x00 OPTIMISATION_TYPE_DEFAULT ADDRESS_EXTENSION_FREE IDENTIFICATION_FIELD_TYPE_RELATIVE_WORD_ALIGNED GRANULARITY_ODT_ENTRY_SIZE_DAQ_BYTE 0xFF OVERLOAD_INDICATION_PID PRESCALER_SUPPORTED /begin STIM GRANULARITY_ODT_ENTRY_SIZE_STIM_BYTE 0xFF /end STIM /begin TIMESTAMP_SUPPORTED 0x0001 SIZE_DWORD UNIT_1US TIMESTAMP_FIXED /end TIMESTAMP_SUPPORTED /begin EVENT "1 ms" "1 ms" 0x0000 DAQ 0xFF 0x01 0x06 0x00 /end EVENT /end DAQ
 /begin XCP_ON_UDP_IP 0x0100 0x15B3 ADDRESS "192.168.7.5" /end XCP_ON_UDP_IP
/end IF_DATA
/begin MOD_PAR "MOD PAR Comment Goes Here"
 /begin MEMORY_SEGMENT Main_Sept1_2021_cal_impl "Main_Sept1_2021_cal_impl" DATA FLASH INTERN 0x00218020 0x618 -1 -1 -1 -1 -1
  /begin IF_DATA XCP
   /begin SEGMENT 0x00 0x02 0x00 0x00 0x00
    /begin PAGE 0x00 ECU_ACCESS_DONT_CARE XCP_READ_ACCESS_DONT_CARE XCP_WRITE_ACCESS_NOT_ALLOWED /end PAGE
    /begin PAGE 0x01 ECU_ACCESS_DONT_CARE XCP_READ_ACCESS_DONT_CARE XCP_WRITE_ACCESS_DONT_CARE /end PAGE
   /end SEGMENT
  /end IF_DATA
 /end MEMORY_SEGMENT
/end MOD_PAR
/begin MOD_COMMON "Mod Common Comment Here" BYTE_ORDER MSB_LAST ALIGNMENT_BYTE 1 ALIGNMENT_WORD 2 ALIGNMENT_LONG 8 ALIGNMENT_FLOAT32_IEEE 4 ALIGNMENT_FLOAT64_IEEE 8 ALIGNMENT_INT64 4 /end MOD_COMMON
/begin CHARACTERISTIC Main_Sept1_2021_cal_impl.CANRead_P1 "" VAL_BLK 0x002180F0 Scalar_FLOAT64_IEEE 0 Main_Sept1_2021_CM_double -1.7E+308 1.7E+308 MATRIX_DIM 6 1 /end CHARACTERISTIC
/begin CHARACTERISTIC Main_Sept1_2021_cal_impl.CANSetup_P1 "" VAL_BLK 0x00218138 Scalar_FLOAT64_IEEE 0 Main_Sept1_2021_CM_double -1.7E+308 1.7E+308 MATRIX_DIM 40 1 /end CHARACTERISTIC
/begin CHARACTERISTIC Main_Sept1_2021_cal_impl.CANSetup_P2 "" VALUE 0x00218288 Scalar_FLOAT64_IEEE 0 Main_Sept1_2021_CM_double -1.7E+308 1.7E+308 /end CHARACTERISTIC
/begin CHARACTERISTIC Main_Sept1_2021_cal_impl.CANSetup_P3 "" VALUE 0x002182A0 Scalar_FLOAT64_IEEE 0 Main_Sept1_2021_CM_double -1.7E+308 1.7E+308 /end CHARACTERISTIC
/begin CHARACTERISTIC Main_Sept1_2021_cal_impl.CANStatus_P1 "" VALUE 0x002182E8 Scalar_FLOAT64_IEEE 0 Main_Sept1_2021_CM_double -1.7E+308 1.7E+308 /end CHARACTERISTIC
/begin CHARACTERISTIC Main_Sept1_2021_cal_impl.CANStatus_P10 "" VALUE 0x002183C0 Scalar_FLOAT64_IEEE 0 Main_Sept1_2021_CM_double -1.7E+308 1.7E+308 /end CHARACTERISTIC
/begin CHARACTERISTIC Main_Sept1_2021_cal_impl.CANStatus_P11 "" VALUE 0x002183D8 Scalar_FLOAT64_IEEE 0 Main_Sept1_2021_CM_double -1.7E+308 1.7E+308 /end CHARACTERISTIC
/begin CHARACTERISTIC Main_Sept1_2021_cal_impl.CANStatus_P12 "" VALUE 0x002183F0 Scalar_FLOAT64_IEEE 0 Main_Sept1_2021_CM_double -1.7E+308 1.7E+308 /end CHARACTERISTIC
/begin CHARACTERISTIC Main_Sept1_2021_cal_impl.CANStatus_P13 "" VALUE 0x00218408 Scalar_FLOAT64_IEEE 0 Main_Sept1_2021_CM_double -1.7E+308 1.7E+308 /end CHARACTERISTIC
/begin CHARACTERISTIC Main_Sept1_2021_cal_impl.CANStatus_P14 "" VALUE 0x00218420 Scalar_FLOAT64_IEEE 0 Main_Sept1_2021_CM_double -1.7E+308 1.7E+308 /end CHARACTERISTIC
/begin CHARACTERISTIC Main_Sept1_2021_cal_impl.CANStatus_P15 "" VALUE 0x00218438 Scalar_FLOAT64_IEEE 0 Main_Sept1_2021_CM_double -1.7E+308 1.7E+308 /end CHARACTERISTIC
/begin CHARACTERISTIC Main_Sept1_2021_cal_impl.CANStatus_P16 "" VALUE 0x00218450 Scalar_FLOAT64_IEEE 0 Main_Sept1_2021_CM_double -1.7E+308 1.7E+308 /end CHARACTERISTIC
/begin CHARACTERISTIC Main_Sept1_2021_cal_impl.CANStatus_P17 "" VALUE 0x00218468 Scalar_FLOAT64_IEEE 0 Main_Sept1_2021_CM_double -1.7E+308 1.7E+308 /end CHARACTERISTIC
/begin CHARACTERISTIC Main_Sept1_2021_cal_impl.CANStatus_P18 "" VALUE 0x00218480 Scalar_FLOAT64_IEEE 0 Main_Sept1_2021_CM_double -1.7E+308 1.7E+308 /end CHARACTERISTIC
/begin CHARACTERISTIC Main_Sept1_2021_cal_impl.CANStatus_P19 "" VALUE 0x00218498 Scalar_FLOAT64_IEEE 0 Main_Sept1_2021_CM_double -1.7E+308 1.7E+308 /end CHARACTERISTIC
/begin CHARACTERISTIC Main_Sept1_2021_cal_impl.CANStatus_P2 "" VALUE 0x00218300 Scalar_FLOAT64_IEEE 0 Main_Sept1_2021_CM_double -1.7E+308 1.7E+308 /end CHARACTERISTIC
/begin CHARACTERISTIC Main_Sept1_2021_cal_impl.CANStatus_P20 "" VALUE 0x002184B0 Scalar_FLOAT64_IEEE 0 Main_Sept1_2021_CM_double -1.7E+308 1.7E+308 /end CHARACTERISTIC
/begin CHARACTERISTIC Main_Sept1_2021_cal_impl.CANStatus_P21 "" VALUE 0x002184C8 Scalar_FLOAT64_IEEE 0 Main_Sept1_2021_CM_double -1.7E+308 1.7E+308 /end CHARACTERISTIC
/begin CHARACTERISTIC Main_Sept1_2021_cal_impl.CANStatus_P22 "" VALUE 0x002184E0 Scalar_FLOAT64_IEEE 0 Main_Sept1_2021_CM_double -1.7E+308 1.7E+308 /end CHARACTERISTIC
/begin CHARACTERISTIC Main_Sept1_2021_cal_impl.CANStatus_P23 "" VALUE 0x002184F8 Scalar_FLOAT64_IEEE 0 Main_Sept1_2021_CM_double -1.7E+308 1.7E+308 /end CHARACTERISTIC
/begin CHARACTERISTIC Main_Sept1_2021_cal_impl.CANStatus_P24 "" VALUE 0x00218510 Scalar_FLOAT64_IEEE 0 Main_Sept1_2021_CM_double -1.7E+308 1.7E+308 /end CHARACTERISTIC
/begin CHARACTERISTIC Main_Sept1_2021_cal_impl.CANStatus_P25 "" VALUE 0x00218528 Scalar_FLOAT64_IEEE 0 Main_Sept1_2021_CM_double -1.7E+308 1.7E+308 /end CHARACTERISTIC
/begin CHARACTERISTIC Main_Sept1_2021_cal_impl.CANStatus_P26 "" VALUE 0x00218540 Scalar_FLOAT64_IEEE 0 Main_Sept1_2021_CM_double -1.7E+308 1.7E+308 /end CHARACTERISTIC
/begin CHARACTERISTIC Main_Sept1_2021_cal_impl.CANStatus_P27 "" VALUE 0x00218558 Scalar_FLOAT64_IEEE 0 Main_Sept1_2021_CM_double -1.7E+308 1.7E+308 /end CHARACTERISTIC
/begin CHARACTERISTIC Main_Sept1_2021_cal_impl.CANStatus_P28 "" VALUE 0x00218570 Scalar_FLOAT64_IEEE 0 Main_Sept1_2021_CM_double -1.7E+308 1.7E+308 /end CHARACTERISTIC
/begin CHARACTERISTIC Main_Sept1_2021_cal_impl.CANStatus_P29 "" VALUE 0x00218588 Scalar_FLOAT64_IEEE 0 Main_Sept1_2021_CM_double -1.7E+308 1.7E+308 /end CHARACTERISTIC
/begin CHARACTERISTIC Main_Sept1_2021_cal_impl.CANStatus_P3 "" VALUE 0x00218318 Scalar_FLOAT64_IEEE 0 Main_Sept1_2021_CM_double -1.7E+308 1.7E+308 /end CHARACTERISTIC
/begin CHARACTERISTIC Main_Sept1_2021_cal_impl.CANStatus_P30 "" VALUE 0x002185A0 Scalar_FLOAT64_IEEE 0 Main_Sept1_2021_CM_double -1.7E+308 1.7E+308 /end CHARACTERISTIC
/begin CHARACTERISTIC Main_Sept1_2021_cal_impl.CANStatus_P31 "" VALUE 0x002185B8 Scalar_FLOAT64_IEEE 0 Main_Sept1_2021_CM_double -1.7E+308 1.7E+308 /end CHARACTERISTIC
/begin CHARACTERISTIC Main_Sept1_2021_cal_impl.CANStatus_P32 "" VALUE 0x002185D0 Scalar_FLOAT64_IEEE 0 Main_Sept1_2021_CM_double -1.7E+308 1.7E+308 /end CHARACTERISTIC
/begin CHARACTERISTIC Main_Sept1_2021_cal_impl.CANStatus_P33 "" VALUE 0x002185E8 Scalar_FLOAT64_IEEE 0 Main_Sept1_2021_CM_double -1.7E+308 1.7E+308 /end CHARACTERISTIC
/begin CHARACTERISTIC Main_Sept1_2021_cal_impl.CANStatus_P34 "" VALUE 0x00218600 Scalar_FLOAT64_IEEE 0 Main_Sept1_2021_CM_double -1.7E+308 1.7E+308 /end CHARACTERISTIC
/begin CHARACTERISTIC Main_Sept1_2021_cal_impl.CANStatus_P4 "" VALUE 0x00218330 Scalar_FLOAT64_IEEE 0 Main_Sept1_2021_CM_double -1.7E+308 1.7E+308 /end CHARACTERISTIC
/begin CHARACTERISTIC Main_Sept1_2021_cal_impl.CANStatus_P5 "" VALUE 0x00218348 Scalar_FLOAT64_IEEE 0 Main_Sept1_2021_CM_double -1.7E+308 1.7E+308 /end CHARACTERISTIC
/begin CHARACTERISTIC Main_Sept1_2021_cal_impl.CANStatus_P6 "" VALUE 0x00218360 Scalar_FLOAT64_IEEE 0 Main_Sept1_2021_CM_double -1.7E+308 1.7E+308 /end CHARACTERISTIC
/begin CHARACTERISTIC Main_Sept1_2021_cal_impl.CANStatus_P7 "" VALUE 0x00218378 Scalar_FLOAT64_IEEE 0 Main_Sept1_2021_CM_double -1.7E+308 1.7E+308 /end CHARACTERISTIC
/begin CHARACTERISTIC Main_Sept1_2021_cal_impl.CANStatus_P8 "" VALUE 0x00218390 Scalar_FLOAT64_IEEE 0 Main_Sept1_2021_CM_double -1.7E+308 1.7E+308 /end CHARACTERISTIC
/begin CHARACTERISTIC Main_Sept1_2021_cal_impl.CANStatus_P9 "" VALUE 0x002183A8 Scalar_FLOAT64_IEEE 0 Main_Sept1_2021_CM_double -1.7E+308 1.7E+308 /end CHARACTERISTIC
/begin CHARACTERISTIC Main_Sept1_2021_cal_impl.Constant1_Value "" VAL_BLK 0x00218610 Scalar_UBYTE 0 Main_Sept1_2021_CM_uint8 0 255 MATRIX_DIM 8 1 /end CHARACTERISTIC
/begin CHARACTERISTIC Main_Sept1_2021_cal_impl.Constant2_Value "" VALUE 0x002182C0 Scalar_FLOAT64_IEEE 0 Main_Sept1_2021_CM_double -1.7E+308 1.7E+308 /end CHARACTERISTIC
/begin CHARACTERISTIC Main_Sept1_2021_cal_impl.Constant2_Value_k "" VAL_BLK 0x00218618 Scalar_UBYTE 0 Main_Sept1_2021_CM_uint8 0 255 MATRIX_DIM 8 1 /end CHARACTERISTIC
/begin CHARACTERISTIC Main_Sept1_2021_cal_impl.Constant3_Value "" VAL_BLK 0x00218620 Scalar_UBYTE 0 Main_Sept1_2021_CM_uint8 0 255 MATRIX_DIM 8 1 /end CHARACTERISTIC
/begin CHARACTERISTIC Main_Sept1_2021_cal_impl.Constant4_Value "" VAL_BLK 0x00218628 Scalar_UBYTE 0 Main_Sept1_2021_CM_uint8 0 255 MATRIX_DIM 8 1 /end CHARACTERISTIC
/begin CHARACTERISTIC Main_Sept1_2021_cal_impl.Constant5_Value "" VAL_BLK 0x00218630 Scalar_UBYTE 0 Main_Sept1_2021_CM_uint8 0 255 MATRIX_DIM 8 1 /end CHARACTERISTIC
/begin CHARACTERISTIC Main_Sept1_2021_cal_impl.Constant8_Value "" VALUE 0x002182D0 Scalar_FLOAT64_IEEE 0 Main_Sept1_2021_CM_double -1.7E+308 1.7E+308 /end CHARACTERISTIC
/begin CHARACTERISTIC Main_Sept1_2021_cal_impl.Constant_Value "" VALUE 0x002182B8 Scalar_FLOAT64_IEEE 0 Main_Sept1_2021_CM_double -1.7E+308 1.7E+308 /end CHARACTERISTIC
/begin CHARACTERISTIC Main_Sept1_2021_cal_impl.Constant_Value_i "" VAL_BLK 0x00218608 Scalar_UBYTE 0 Main_Sept1_2021_CM_uint8 0 255 MATRIX_DIM 8 1 /end CHARACTERISTIC
/begin CHARACTERISTIC Main_Sept1_2021_cal_impl.Curr1_Y0 "" VALUE 0x002180D0 Scalar_FLOAT64_IEEE 0 Main_Sept1_2021_CM_double -1.7E+308 1.7E+308 /end CHARACTERISTIC
/begin CHARACTERISTIC Main_Sept1_2021_cal_impl.Curr2_Y0 "" VALUE 0x002180D8 Scalar_FLOAT64_IEEE 0 Main_Sept1_2021_CM_double -1.7E+308 1.7E+308 /end CHARACTERISTIC
/begin CHARACTERISTIC Main_Sept1_2021_cal_impl.Delay1_InitialCondition "" VALUE 0x002182B0 Scalar_FLOAT64_IEEE 0 Main_Sept1_2021_CM_double -1.7E+308 1.7E+308 /end CHARACTERISTIC
/begin CHARACTERISTIC Main_Sept1_2021_cal_impl.Delay_InitialCondition "" VALUE 0x002182A8 Scalar_FLOAT64_IEEE 0 Main_Sept1_2021_CM_double -1.7E+308 1.7E+308 /end CHARACTERISTIC
/begin CHARACTERISTIC Main_Sept1_2021_cal_impl.Gain_Gain "" VALUE 0x002182C8 Scalar_FLOAT64_IEEE 0 Main_Sept1_2021_CM_double -1.7E+308 1.7E+308 /end CHARACTERISTIC
/begin CHARACTERISTIC Main_Sept1_2021_cal_impl.GearRatio_Gain "" VALUE 0x00218120 Scalar_FLOAT64_IEEE 0 Main_Sept1_2021_CM_double -1.7E+308 1.7E+308 /end CHARACTERISTIC
/begin CHARACTERISTIC Main_Sept1_2021_cal_impl.Motor1_P1 "" VAL_BLK 0x00218030 Scalar_FLOAT64_IEEE 0 Main_Sept1_2021_CM_double -1.7E+308 1.7E+308 MATRIX_DIM 7 1 /end CHARACTERISTIC
/begin CHARACTERISTIC Main_Sept1_2021_cal_impl.Motor2_P1 "" VAL_BLK 0x00218078 Scalar_FLOAT64_IEEE 0 Main_Sept1_2021_CM_double -1.7E+308 1.7E+308 MATRIX_DIM 7 1 /end CHARACTERISTIC
/begin CHARACTERISTIC Main_Sept1_2021_cal_impl.P1_Y0 "" VALUE 0x002180B0 Scalar_FLOAT64_IEEE 0 Main_Sept1_2021_CM_double -1.7E+308 1.7E+308 /end CHARACTERISTIC
/begin CHARACTERISTIC Main_Sept1_2021_cal_impl.P2_Y0 "" VALUE 0x002180B8 Scalar_FLOAT64_IEEE 0 Main_Sept1_2021_CM_double -1.7E+308 1.7E+308 /end CHARACTERISTIC
/begin CHARACTERISTIC Main_Sept1_2021_cal_impl.V1_Y0 "" VALUE 0x002180C0 Scalar_FLOAT64_IEEE 0 Main_Sept1_2021_CM_double -1.7E+308 1.7E+308 /end CHARACTERISTIC
/begin CHARACTERISTIC Main_Sept1_2021_cal_impl.V2_Y0 "" VALUE 0x002180C8 Scalar_FLOAT64_IEEE 0 Main_Sept1_2021_CM_double -1.7E+308 1.7E+308 /end CHARACTERISTIC
/begin MEASUREMENT Main_Sept1_2021_B.CANMsgbytes_o1 "" FLOAT64_IEEE Main_Sept1_2021_CM_double 0 0 -1.7E+308 1.7E+308 ECU_ADDRESS 0x0021B2C0 /end MEASUREMENT
/begin MEASUREMENT Main_Sept1_2021_B.CANMsgbytes_o2 "" FLOAT64_IEEE Main_Sept1_2021_CM_double 0 0 -1.7E+308 1.7E+308 ECU_ADDRESS 0x0021B2C8 /end MEASUREMENT
/begin MEASUREMENT Main_Sept1_2021_B.CANMsgbytes_o3 "" FLOAT64_IEEE Main_Sept1_2021_CM_double 0 0 -1.7E+308 1.7E+308 ECU_ADDRESS 0x0021B2D0 /end MEASUREMENT
/begin MEASUREMENT Main_Sept1_2021_B.CANMsgbytes_o4 "" FLOAT64_IEEE Main_Sept1_2021_CM_double 0 0 -1.7E+308 1.7E+308 ECU_ADDRESS 0x0021B2D8 /end MEASUREMENT
/begin MEASUREMENT Main_Sept1_2021_B.CANMsgbytes_o5 "" UBYTE Main_Sept1_2021_CM_uint8 0 0 0 255 ECU_ADDRESS 0x0021B38D /end MEASUREMENT
/begin MEASUREMENT Main_Sept1_2021_B.CANRead_o1 "" UBYTE Main_Sept1_2021_CM_logical 0 0 0 1 ECU_ADDRESS 0x0021B3BE /end MEASUREMENT
/begin MEASUREMENT Main_Sept1_2021_B.CANUnpack_o1 "" FLOAT64_IEEE Main_Sept1_2021_CM_double 0 0 -1.7E+308 1.7E+308 ECU_ADDRESS 0x0021B288 /end MEASUREMENT
/begin MEASUREMENT Main_Sept1_2021_B.CANUnpack_o2 "" FLOAT64_IEEE Main_Sept1_2021_CM_double 0 0 -1.7E+308 1.7E+308 ECU_ADDRESS 0x0021B290 /end MEASUREMENT
/begin MEASUREMENT Main_Sept1_2021_B.CANUnpack_o3 "" FLOAT64_IEEE Main_Sept1_2021_CM_double 0 0 -1.7E+308 1.7E+308 ECU_ADDRESS 0x0021B298 /end MEASUREMENT
/begin MEASUREMENT Main_Sept1_2021_B.CANUnpack_o4 "" FLOAT64_IEEE Main_Sept1_2021_CM_double 0 0 -1.7E+308 1.7E+308 ECU_ADDRESS 0x0021B2A0 /end MEASUREMENT
/begin MEASUREMENT Main_Sept1_2021_B.CANUnpack_o5 "" UBYTE Main_Sept1_2021_CM_uint8 0 0 0 255 ECU_ADDRESS 0x0021B38C /end MEASUREMENT
/begin MEASUREMENT Main_Sept1_2021_B.Clock "" FLOAT64_IEEE Main_Sept1_2021_CM_double 0 0 -1.7E+308 1.7E+308 ECU_ADDRESS 0x0021B278 /end MEASUREMENT
/begin MEASUREMENT Main_Sept1_2021_B.CommandSwitch "" UBYTE Main_Sept1_2021_CM_uint8 0 0 0 255 LAYOUT COLUMN_DIR MATRIX_DIM 8 ECU_ADDRESS 0x0021B38E /end MEASUREMENT
/begin MEASUREMENT Main_Sept1_2021_B.CommandSwitch_h "" UBYTE Main_Sept1_2021_CM_uint8 0 0 0 255 LAYOUT COLUMN_DIR MATRIX_DIM 8 ECU_ADDRESS 0x0021B3A6 /end MEASUREMENT
/begin MEASUREMENT Main_Sept1_2021_B.Constant "" FLOAT64_IEEE Main_Sept1_2021_CM_double 0 0 -1.7E+308 1.7E+308 ECU_ADDRESS 0x0021B258 /end MEASUREMENT
/begin MEASUREMENT Main_Sept1_2021_B.Constant2 "" FLOAT64_IEEE Main_Sept1_2021_CM_double 0 0 -1.7E+308 1.7E+308 ECU_ADDRESS 0x0021B260 /end MEASUREMENT
/begin MEASUREMENT Main_Sept1_2021_B.GRF "" FLOAT64_IEEE Main_Sept1_2021_CM_double 0 0 -1.7E+308 1.7E+308 ECU_ADDRESS 0x0021B378 /end MEASUREMENT
/begin MEASUREMENT Main_Sept1_2021_B.GearRatio "" FLOAT64_IEEE Main_Sept1_2021_CM_double 0 0 -1.7E+308 1.7E+308 ECU_ADDRESS 0x0021B280 /end MEASUREMENT
/begin MEASUREMENT Main_Sept1_2021_B.I_ff "" FLOAT64_IEEE Main_Sept1_2021_CM_double 0 0 -1.7E+308 1.7E+308 ECU_ADDRESS 0x0021B2B8 /end MEASUREMENT
/begin MEASUREMENT Main_Sept1_2021_B.I_ff_o "" FLOAT64_IEEE Main_Sept1_2021_CM_double 0 0 -1.7E+308 1.7E+308 ECU_ADDRESS 0x0021B2F0 /end MEASUREMENT
/begin MEASUREMENT Main_Sept1_2021_B.Kd1 "" FLOAT64_IEEE Main_Sept1_2021_CM_double 0 0 -1.7E+308 1.7E+308 ECU_ADDRESS 0x0021B350 /end MEASUREMENT
/begin MEASUREMENT Main_Sept1_2021_B.Kd2 "" FLOAT64_IEEE Main_Sept1_2021_CM_double 0 0 -1.7E+308 1.7E+308 ECU_ADDRESS 0x0021B358 /end MEASUREMENT
/begin MEASUREMENT Main_Sept1_2021_B.Kp1 "" FLOAT64_IEEE Main_Sept1_2021_CM_double 0 0 -1.7E+308 1.7E+308 ECU_ADDRESS 0x0021B340 /end MEASUREMENT
/begin MEASUREMENT Main_Sept1_2021_B.Kp2 "" FLOAT64_IEEE Main_Sept1_2021_CM_double 0 0 -1.7E+308 1.7E+308 ECU_ADDRESS 0x0021B348 /end MEASUREMENT
/begin MEASUREMENT Main_Sept1_2021_B.P1 "" FLOAT64_IEEE Main_Sept1_2021_CM_double 0 0 -1.7E+308 1.7E+308 ECU_ADDRESS 0x0021B248 /end MEASUREMENT
/begin MEASUREMENT Main_Sept1_2021_B.P2 "" FLOAT64_IEEE Main_Sept1_2021_CM_double 0 0 -1.7E+308 1.7E+308 ECU_ADDRESS 0x0021B250 /end MEASUREMENT
/begin MEASUREMENT Main_Sept1_2021_B.T1 "" FLOAT64_IEEE Main_Sept1_2021_CM_double 0 0 -1.7E+308 1.7E+308 ECU_ADDRESS 0x0021B330 /end MEASUREMENT
/begin MEASUREMENT Main_Sept1_2021_B.T2 "" FLOAT64_IEEE Main_Sept1_2021_CM_double 0 0 -1.7E+308 1.7E+308 ECU_ADDRESS 0x0021B338 /end MEASUREMENT
/begin MEASUREMENT Main_Sept1_2021_B.Tcalc1 "" FLOAT64_IEEE Main_Sept1_2021_CM_double 0 0 -1.7E+308 1.7E+308 ECU_ADDRESS 0x0021B360 /end MEASUREMENT
/begin MEASUREMENT Main_Sept1_2021_B.Tcalc2 "" FLOAT64_IEEE Main_Sept1_2021_CM_double 0 0 -1.7E+308 1.7E+308 ECU_ADDRESS 0x0021B368 /end MEASUREMENT
/begin MEASUREMENT Main_Sept1_2021_B.Th2 "" FLOAT64_IEEE Main_Sept1_2021_CM_double 0 0 -1.7E+308 1.7E+308 ECU_ADDRESS 0x0021B268 /end MEASUREMENT
/begin MEASUREMENT Main_Sept1_2021_B.Thdot2 "" FLOAT64_IEEE Main_Sept1_2021_CM_double 0 0 -1.7E+308 1.7E+308 ECU_ADDRESS 0x0021B270 /end MEASUREMENT
/begin MEASUREMENT Main_Sept1_2021_B.TmpSignalConversionAtSFunctionI "" FLOAT64_IEEE Main_Sept1_2021_CM_double 0 0 -1.7E+308 1.7E+308 LAYOUT COLUMN_DIR MATRIX_DIM 2 ECU_ADDRESS 0x0021B2F8 /end MEASUREMENT
/begin MEASUREMENT Main_Sept1_2021_B.WhileIterator "" SLONG Main_Sept1_2021_CM_int32 0 0 -2147483648 2147483647 ECU_ADDRESS 0x0021B388 /end MEASUREMENT
/begin MEASUREMENT Main_Sept1_2021_B.b "" UBYTE Main_Sept1_2021_CM_uint8 0 0 0 255 LAYOUT COLUMN_DIR MATRIX_DIM 8 ECU_ADDRESS 0x0021B39E /end MEASUREMENT
/begin MEASUREMENT Main_Sept1_2021_B.b_i "" UBYTE Main_Sept1_2021_CM_uint8 0 0 0 255 LAYOUT COLUMN_DIR MATRIX_DIM 8 ECU_ADDRESS 0x0021B3B6 /end MEASUREMENT
/begin MEASUREMENT Main_Sept1_2021_B.bytesbytevectors "" UBYTE Main_Sept1_2021_CM_uint8 0 0 0 255 LAYOUT COLUMN_DIR MATRIX_DIM 8 ECU_ADDRESS 0x0021B396 /end MEASUREMENT
/begin MEASUREMENT Main_Sept1_2021_B.bytesbytevectors_l "" UBYTE Main_Sept1_2021_CM_uint8 0 0 0 255 LAYOUT COLUMN_DIR MATRIX_DIM 8 ECU_ADDRESS 0x0021B3AE /end MEASUREMENT
/begin MEASUREMENT Main_Sept1_2021_B.c "" FLOAT64_IEEE Main_Sept1_2021_CM_double 0 0 -1.7E+308 1.7E+308 ECU_ADDRESS 0x0021B328 /end MEASUREMENT
/begin MEASUREMENT Main_Sept1_2021_B.calcForceX "" FLOAT64_IEEE Main_Sept1_2021_CM_double 0 0 -1.7E+308 1.7E+308 ECU_ADDRESS 0x0021B370 /end MEASUREMENT
/begin MEASUREMENT Main_Sept1_2021_B.danger "" FLOAT64_IEEE Main_Sept1_2021_CM_double 0 0 -1.7E+308 1.7E+308 ECU_ADDRESS 0x0021B308 /end MEASUREMENT
/begin MEASUREMENT Main_Sept1_2021_B.hop "" FLOAT64_IEEE Main_Sept1_2021_CM_double 0 0 -1.7E+308 1.7E+308 ECU_ADDRESS 0x0021B380 /end MEASUREMENT
/begin MEASUREMENT Main_Sept1_2021_B.position "" FLOAT64_IEEE Main_Sept1_2021_CM_double 0 0 -1.7E+308 1.7E+308 ECU_ADDRESS 0x0021B2A8 /end MEASUREMENT
/begin MEASUREMENT Main_Sept1_2021_B.position_j "" FLOAT64_IEEE Main_Sept1_2021_CM_double 0 0 -1.7E+308 1.7E+308 ECU_ADDRESS 0x0021B2E0 /end MEASUREMENT
/begin MEASUREMENT Main_Sept1_2021_B.stop "" FLOAT64_IEEE Main_Sept1_2021_CM_double 0 0 -1.7E+308 1.7E+308 ECU_ADDRESS 0x0021B310 /end MEASUREMENT
/begin MEASUREMENT Main_Sept1_2021_B.theta1 "" FLOAT64_IEEE Main_Sept1_2021_CM_double 0 0 -1.7E+308 1.7E+308 ECU_ADDRESS 0x0021B318 /end MEASUREMENT
/begin MEASUREMENT Main_Sept1_2021_B.theta2 "" FLOAT64_IEEE Main_Sept1_2021_CM_double 0 0 -1.7E+308 1.7E+308 ECU_ADDRESS 0x0021B320 /end MEASUREMENT
/begin MEASUREMENT Main_Sept1_2021_B.velocity "" FLOAT64_IEEE Main_Sept1_2021_CM_double 0 0 -1.7E+308 1.7E+308 ECU_ADDRESS 0x0021B2B0 /end MEASUREMENT
/begin MEASUREMENT Main_Sept1_2021_B.velocity_h "" FLOAT64_IEEE Main_Sept1_2021_CM_double 0 0 -1.7E+308 1.7E+308 ECU_ADDRESS 0x0021B2E8 /end MEASUREMENT
/begin MEASUREMENT Main_Sept1_2021_DW.CANMsgbytes_ModeSignalID "" SLONG Main_Sept1_2021_CM_int_T 0 0 -2147483648 2147483647 ECU_ADDRESS 0x0021B1C8 /end MEASUREMENT
/begin MEASUREMENT Main_Sept1_2021_DW.CANMsgbytes_StatusPortID "" SLONG Main_Sept1_2021_CM_int_T 0 0 -2147483648 2147483647 ECU_ADDRESS 0x0021B1CC /end MEASUREMENT
/begin MEASUREMENT Main_Sept1_2021_DW.CANUnpack_ModeSignalID "" SLONG Main_Sept1_2021_CM_int_T 0 0 -2147483648 2147483647 ECU_ADDRESS 0x0021B1C0 /end MEASUREMENT
/begin MEASUREMENT Main_Sept1_2021_DW.CANUnpack_StatusPortID "" SLONG Main_Sept1_2021_CM_int_T 0 0 -2147483648 2147483647 ECU_ADDRESS 0x0021B1C4 /end MEASUREMENT
/begin MEASUREMENT Main_Sept1_2021_DW.Delay1_DSTATE "" FLOAT64_IEEE Main_Sept1_2021_CM_double 0 0 -1.7E+308 1.7E+308 ECU_ADDRESS 0x0021AF88 /end MEASUREMENT
/begin MEASUREMENT Main_Sept1_2021_DW.Delay_DSTATE "" FLOAT64_IEEE Main_Sept1_2021_CM_double 0 0 -1.7E+308 1.7E+308 ECU_ADDRESS 0x0021AF80 /end MEASUREMENT
/begin MEASUREMENT Main_Sept1_2021_DW.FStart "" FLOAT64_IEEE Main_Sept1_2021_CM_double 0 0 -1.7E+308 1.7E+308 ECU_ADDRESS 0x0021AFE0 /end MEASUREMENT
/begin MEASUREMENT Main_Sept1_2021_DW.GRFy "" FLOAT64_IEEE Main_Sept1_2021_CM_double 0 0 -1.7E+308 1.7E+308 ECU_ADDRESS 0x0021AFF0 /end MEASUREMENT
/begin MEASUREMENT Main_Sept1_2021_DW.Idle "" FLOAT64_IEEE Main_Sept1_2021_CM_double 0 0 -1.7E+308 1.7E+308 ECU_ADDRESS 0x0021AFD0 /end MEASUREMENT
/begin MEASUREMENT Main_Sept1_2021_DW.Th2Th1 "" FLOAT64_IEEE Main_Sept1_2021_CM_double 0 0 -1.7E+308 1.7E+308 ECU_ADDRESS 0x0021AFE8 /end MEASUREMENT
/begin MEASUREMENT Main_Sept1_2021_DW.done "" FLOAT64_IEEE Main_Sept1_2021_CM_double 0 0 -1.7E+308 1.7E+308 ECU_ADDRESS 0x0021AF90 /end MEASUREMENT
/begin MEASUREMENT Main_Sept1_2021_DW.exitY "" FLOAT64_IEEE Main_Sept1_2021_CM_double 0 0 -1.7E+308 1.7E+308 ECU_ADDRESS 0x0021AFF8 /end MEASUREMENT
/begin MEASUREMENT Main_Sept1_2021_DW.is_Command "" ULONG Main_Sept1_2021_CM_uint32 0 0 0 2147483646 ECU_ADDRESS 0x0021B130 /end MEASUREMENT
/begin MEASUREMENT Main_Sept1_2021_DW.is_Flight "" ULONG Main_Sept1_2021_CM_uint32 0 0 0 2147483646 ECU_ADDRESS 0x0021B134 /end MEASUREMENT
/begin MEASUREMENT Main_Sept1_2021_DW.is_active_c8_Main_Sept1_2021 "" UBYTE Main_Sept1_2021_CM_uint8 0 0 0 255 ECU_ADDRESS 0x0021B1E2 /end MEASUREMENT
/begin MEASUREMENT Main_Sept1_2021_DW.is_c8_Main_Sept1_2021 "" ULONG Main_Sept1_2021_CM_uint32 0 0 0 2147483646 ECU_ADDRESS 0x0021B12C /end MEASUREMENT
/begin MEASUREMENT Main_Sept1_2021_DW.pf "" FLOAT64_IEEE Main_Sept1_2021_CM_double 0 0 -1.7E+308 1.7E+308 ECU_ADDRESS 0x0021AF98 /end MEASUREMENT
/begin MEASUREMENT Main_Sept1_2021_DW.po1 "" FLOAT64_IEEE Main_Sept1_2021_CM_double 0 0 -1.7E+308 1.7E+308 ECU_ADDRESS 0x0021AFB0 /end MEASUREMENT
/begin MEASUREMENT Main_Sept1_2021_DW.po2 "" FLOAT64_IEEE Main_Sept1_2021_CM_double 0 0 -1.7E+308 1.7E+308 ECU_ADDRESS 0x0021AFB8 /end MEASUREMENT
/begin MEASUREMENT Main_Sept1_2021_DW.sfEvent "" SLONG Main_Sept1_2021_CM_int32 0 0 -2147483648 2147483647 ECU_ADDRESS 0x0021B128 /end MEASUREMENT
/begin MEASUREMENT Main_Sept1_2021_DW.slope1 "" FLOAT64_IEEE Main_Sept1_2021_CM_double 0 0 -1.7E+308 1.7E+308 ECU_ADDRESS 0x0021AFC0 /end MEASUREMENT
/begin MEASUREMENT Main_Sept1_2021_DW.slope2 "" FLOAT64_IEEE Main_Sept1_2021_CM_double 0 0 -1.7E+308 1.7E+308 ECU_ADDRESS 0x0021AFC8 /end MEASUREMENT
/begin MEASUREMENT Main_Sept1_2021_DW.temporalCounter_i1 "" UBYTE Main_Sept1_2021_CM_uint8 0 0 0 255 ECU_ADDRESS 0x0021B1E3 /end MEASUREMENT
/begin MEASUREMENT Main_Sept1_2021_DW.temporalCounter_i2 "" UWORD Main_Sept1_2021_CM_uint16 0 0 0 65535 ECU_ADDRESS 0x0021B1E0 /end MEASUREMENT
/begin MEASUREMENT Main_Sept1_2021_DW.time "" FLOAT64_IEEE Main_Sept1_2021_CM_double 0 0 -1.7E+308 1.7E+308 ECU_ADDRESS 0x0021AFD8 /end MEASUREMENT
/begin MEASUREMENT Main_Sept1_2021_DW.to "" FLOAT64_IEEE Main_Sept1_2021_CM_double 0 0 -1.7E+308 1.7E+308 ECU_ADDRESS 0x0021AFA8 /end MEASUREMENT
/begin MEASUREMENT Main_Sept1_2021_DW.tstep "" FLOAT64_IEEE Main_Sept1_2021_CM_double 0 0 -1.7E+308 1.7E+308 ECU_ADDRESS 0x0021AFA0 /end MEASUREMENT
/begin COMPU_METHOD Main_Sept1_2021_CM_double "" IDENTICAL "%15.10" "" /end COMPU_METHOD
/begin COMPU_METHOD Main_Sept1_2021_CM_int32 "" IDENTICAL "%10.0" "" /end COMPU_METHOD
/begin COMPU_METHOD Main_Sept1_2021_CM_int_T "" IDENTICAL "customformat" "" /end COMPU_METHOD
/begin COMPU_METHOD Main_Sept1_2021_CM_logical "" IDENTICAL "%1.0" "" /end COMPU_METHOD
/begin COMPU_METHOD Main_Sept1_2021_CM_uint16 "" IDENTICAL "%5.0" "" /end COMPU_METHOD
/begin COMPU_METHOD Main_Sept1_2021_CM_uint32 "" IDENTICAL "%10.0" "" /end COMPU_METHOD
/begin COMPU_METHOD Main_Sept1_2021_CM_uint8 "" IDENTICAL "%3.0" "" /end COMPU_METHOD
/begin RECORD_LAYOUT Scalar_BOOLEAN FNC_VALUES 1 UBYTE COLUMN_DIR DIRECT /end RECORD_LAYOUT
/begin RECORD_LAYOUT Scalar_FLOAT64_IEEE FNC_VALUES 1 FLOAT64_IEEE COLUMN_DIR DIRECT /end RECORD_LAYOUT
/begin RECORD_LAYOUT Scalar_SLONG FNC_VALUES 1 SLONG COLUMN_DIR DIRECT /end RECORD_LAYOUT
/begin RECORD_LAYOUT Scalar_UBYTE FNC_VALUES 1 UBYTE COLUMN_DIR DIRECT /end RECORD_LAYOUT
/begin RECORD_LAYOUT Scalar_ULONG FNC_VALUES 1 ULONG COLUMN_DIR DIRECT /end RECORD_LAYOUT
/begin RECORD_LAYOUT Scalar_UWORD FNC_VALUES 1 UWORD COLUMN_DIR DIRECT /end RECORD_LAYOUT
/begin GROUP Main_Sept1_2021 "Main_Sept1_2021" ROOT /end GROUP
/end MODULE
/end PROJECT
