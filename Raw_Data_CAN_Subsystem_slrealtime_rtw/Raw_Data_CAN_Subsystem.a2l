/******************************************************************************
* ASAP2 file: Raw_Data_CAN_Subsystem.a2l
* Academic License - for use in teaching, academic research, and meeting
* course requirements at degree granting institutions only. Not for
* government, commercial, or other organizational use.
* Code generation for model "Raw_Data_CAN_Subsystem".
* Model version : 1.20
* Simulink Coder version : 10.3 R2021a
* C source code generated on : Thu Sep 02 12:26:07 2021
* Target selection: slrealtime.tlc
* Embedded hardware selection: Intel->x86-64 (Linux 64)
* Code generation objectives: Unspecified
* Validation result: Not run
* (add additional file header information here)
******************************************************************************/ ASAP2_VERSION 1 71
/begin PROJECT ProjectName "Project Comment Goes Here"
/begin HEADER "Header Comments go here" /end HEADER
/begin MODULE ModuleName "Module Comment Goes Here"
/begin IF_DATA XCP
 /begin PROTOCOL_LAYER 0x0100 0x03E8 0x00C8 0x0000 0x0000 0x0000 0x0000 0x0000 0xFC 0x0578 BYTE_ORDER_MSB_LAST ADDRESS_GRANULARITY_BYTE OPTIONAL_CMD ALLOC_ODT_ENTRY OPTIONAL_CMD ALLOC_ODT OPTIONAL_CMD ALLOC_DAQ OPTIONAL_CMD FREE_DAQ OPTIONAL_CMD GET_DAQ_RESOLUTION_INFO OPTIONAL_CMD GET_DAQ_PROCESSOR_INFO OPTIONAL_CMD START_STOP_SYNCH OPTIONAL_CMD START_STOP_DAQ_LIST OPTIONAL_CMD SET_DAQ_LIST_MODE OPTIONAL_CMD WRITE_DAQ OPTIONAL_CMD SET_DAQ_PTR OPTIONAL_CMD GET_CAL_PAGE OPTIONAL_CMD SET_CAL_PAGE OPTIONAL_CMD COPY_CAL_PAGE OPTIONAL_CMD SHORT_DOWNLOAD OPTIONAL_CMD DOWNLOAD_MAX OPTIONAL_CMD DOWNLOAD OPTIONAL_CMD SHORT_UPLOAD OPTIONAL_CMD UPLOAD OPTIONAL_CMD SET_MTA /end PROTOCOL_LAYER
 /begin DAQ DYNAMIC 0x0000 0x0080 0x00 OPTIMISATION_TYPE_DEFAULT ADDRESS_EXTENSION_FREE IDENTIFICATION_FIELD_TYPE_RELATIVE_WORD_ALIGNED GRANULARITY_ODT_ENTRY_SIZE_DAQ_BYTE 0xFF OVERLOAD_INDICATION_PID PRESCALER_SUPPORTED /begin STIM GRANULARITY_ODT_ENTRY_SIZE_STIM_BYTE 0xFF /end STIM /begin TIMESTAMP_SUPPORTED 0x0001 SIZE_DWORD UNIT_1US TIMESTAMP_FIXED /end TIMESTAMP_SUPPORTED /begin EVENT "100 ms" "100 ms" 0x0000 DAQ 0xFF 0x01 0x08 0x00 /end EVENT /end DAQ
 /begin XCP_ON_UDP_IP 0x0100 0x15B3 ADDRESS "192.168.7.5" /end XCP_ON_UDP_IP
/end IF_DATA
/begin MOD_PAR "MOD PAR Comment Goes Here"
 /begin MEMORY_SEGMENT Raw_Data_CAN_Subsystem_cal_impl "Raw_Data_CAN_Subsystem_cal_impl" DATA FLASH INTERN 0x00216020 0x628 -1 -1 -1 -1 -1
  /begin IF_DATA XCP
   /begin SEGMENT 0x00 0x02 0x00 0x00 0x00
    /begin PAGE 0x00 ECU_ACCESS_DONT_CARE XCP_READ_ACCESS_DONT_CARE XCP_WRITE_ACCESS_NOT_ALLOWED /end PAGE
    /begin PAGE 0x01 ECU_ACCESS_DONT_CARE XCP_READ_ACCESS_DONT_CARE XCP_WRITE_ACCESS_DONT_CARE /end PAGE
   /end SEGMENT
  /end IF_DATA
 /end MEMORY_SEGMENT
/end MOD_PAR
/begin MOD_COMMON "Mod Common Comment Here" BYTE_ORDER MSB_LAST ALIGNMENT_BYTE 1 ALIGNMENT_WORD 2 ALIGNMENT_LONG 8 ALIGNMENT_FLOAT32_IEEE 4 ALIGNMENT_FLOAT64_IEEE 8 ALIGNMENT_INT64 4 /end MOD_COMMON
/begin CHARACTERISTIC Raw_Data_CAN_Subsystem_P.c "" VALUE 0x00218BA8 Scalar_FLOAT64_IEEE 0 Raw_Data_CAN_Subsystem_CM_double -1.7E+308 1.7E+308 /end CHARACTERISTIC
/begin CHARACTERISTIC Raw_Data_CAN_Subsystem_cal_impl.CANRead_P1 "" VAL_BLK 0x002161D0 Scalar_FLOAT64_IEEE 0 Raw_Data_CAN_Subsystem_CM_double -1.7E+308 1.7E+308 MATRIX_DIM 6 1 /end CHARACTERISTIC
/begin CHARACTERISTIC Raw_Data_CAN_Subsystem_cal_impl.CANSetup_P1 "" VAL_BLK 0x00216050 Scalar_FLOAT64_IEEE 0 Raw_Data_CAN_Subsystem_CM_double -1.7E+308 1.7E+308 MATRIX_DIM 40 1 /end CHARACTERISTIC
/begin CHARACTERISTIC Raw_Data_CAN_Subsystem_cal_impl.CANSetup_P2 "" VALUE 0x002161A0 Scalar_FLOAT64_IEEE 0 Raw_Data_CAN_Subsystem_CM_double -1.7E+308 1.7E+308 /end CHARACTERISTIC
/begin CHARACTERISTIC Raw_Data_CAN_Subsystem_cal_impl.CANSetup_P3 "" VALUE 0x002161B8 Scalar_FLOAT64_IEEE 0 Raw_Data_CAN_Subsystem_CM_double -1.7E+308 1.7E+308 /end CHARACTERISTIC
/begin CHARACTERISTIC Raw_Data_CAN_Subsystem_cal_impl.CANStatus_P1 "" VALUE 0x00216298 Scalar_FLOAT64_IEEE 0 Raw_Data_CAN_Subsystem_CM_double -1.7E+308 1.7E+308 /end CHARACTERISTIC
/begin CHARACTERISTIC Raw_Data_CAN_Subsystem_cal_impl.CANStatus_P10 "" VALUE 0x00216370 Scalar_FLOAT64_IEEE 0 Raw_Data_CAN_Subsystem_CM_double -1.7E+308 1.7E+308 /end CHARACTERISTIC
/begin CHARACTERISTIC Raw_Data_CAN_Subsystem_cal_impl.CANStatus_P11 "" VALUE 0x00216388 Scalar_FLOAT64_IEEE 0 Raw_Data_CAN_Subsystem_CM_double -1.7E+308 1.7E+308 /end CHARACTERISTIC
/begin CHARACTERISTIC Raw_Data_CAN_Subsystem_cal_impl.CANStatus_P12 "" VALUE 0x002163A0 Scalar_FLOAT64_IEEE 0 Raw_Data_CAN_Subsystem_CM_double -1.7E+308 1.7E+308 /end CHARACTERISTIC
/begin CHARACTERISTIC Raw_Data_CAN_Subsystem_cal_impl.CANStatus_P13 "" VALUE 0x002163B8 Scalar_FLOAT64_IEEE 0 Raw_Data_CAN_Subsystem_CM_double -1.7E+308 1.7E+308 /end CHARACTERISTIC
/begin CHARACTERISTIC Raw_Data_CAN_Subsystem_cal_impl.CANStatus_P14 "" VALUE 0x002163D0 Scalar_FLOAT64_IEEE 0 Raw_Data_CAN_Subsystem_CM_double -1.7E+308 1.7E+308 /end CHARACTERISTIC
/begin CHARACTERISTIC Raw_Data_CAN_Subsystem_cal_impl.CANStatus_P15 "" VALUE 0x002163E8 Scalar_FLOAT64_IEEE 0 Raw_Data_CAN_Subsystem_CM_double -1.7E+308 1.7E+308 /end CHARACTERISTIC
/begin CHARACTERISTIC Raw_Data_CAN_Subsystem_cal_impl.CANStatus_P16 "" VALUE 0x00216400 Scalar_FLOAT64_IEEE 0 Raw_Data_CAN_Subsystem_CM_double -1.7E+308 1.7E+308 /end CHARACTERISTIC
/begin CHARACTERISTIC Raw_Data_CAN_Subsystem_cal_impl.CANStatus_P17 "" VALUE 0x00216418 Scalar_FLOAT64_IEEE 0 Raw_Data_CAN_Subsystem_CM_double -1.7E+308 1.7E+308 /end CHARACTERISTIC
/begin CHARACTERISTIC Raw_Data_CAN_Subsystem_cal_impl.CANStatus_P18 "" VALUE 0x00216430 Scalar_FLOAT64_IEEE 0 Raw_Data_CAN_Subsystem_CM_double -1.7E+308 1.7E+308 /end CHARACTERISTIC
/begin CHARACTERISTIC Raw_Data_CAN_Subsystem_cal_impl.CANStatus_P19 "" VALUE 0x00216448 Scalar_FLOAT64_IEEE 0 Raw_Data_CAN_Subsystem_CM_double -1.7E+308 1.7E+308 /end CHARACTERISTIC
/begin CHARACTERISTIC Raw_Data_CAN_Subsystem_cal_impl.CANStatus_P2 "" VALUE 0x002162B0 Scalar_FLOAT64_IEEE 0 Raw_Data_CAN_Subsystem_CM_double -1.7E+308 1.7E+308 /end CHARACTERISTIC
/begin CHARACTERISTIC Raw_Data_CAN_Subsystem_cal_impl.CANStatus_P20 "" VALUE 0x00216460 Scalar_FLOAT64_IEEE 0 Raw_Data_CAN_Subsystem_CM_double -1.7E+308 1.7E+308 /end CHARACTERISTIC
/begin CHARACTERISTIC Raw_Data_CAN_Subsystem_cal_impl.CANStatus_P21 "" VALUE 0x00216478 Scalar_FLOAT64_IEEE 0 Raw_Data_CAN_Subsystem_CM_double -1.7E+308 1.7E+308 /end CHARACTERISTIC
/begin CHARACTERISTIC Raw_Data_CAN_Subsystem_cal_impl.CANStatus_P22 "" VALUE 0x00216490 Scalar_FLOAT64_IEEE 0 Raw_Data_CAN_Subsystem_CM_double -1.7E+308 1.7E+308 /end CHARACTERISTIC
/begin CHARACTERISTIC Raw_Data_CAN_Subsystem_cal_impl.CANStatus_P23 "" VALUE 0x002164A8 Scalar_FLOAT64_IEEE 0 Raw_Data_CAN_Subsystem_CM_double -1.7E+308 1.7E+308 /end CHARACTERISTIC
/begin CHARACTERISTIC Raw_Data_CAN_Subsystem_cal_impl.CANStatus_P24 "" VALUE 0x002164C0 Scalar_FLOAT64_IEEE 0 Raw_Data_CAN_Subsystem_CM_double -1.7E+308 1.7E+308 /end CHARACTERISTIC
/begin CHARACTERISTIC Raw_Data_CAN_Subsystem_cal_impl.CANStatus_P25 "" VALUE 0x002164D8 Scalar_FLOAT64_IEEE 0 Raw_Data_CAN_Subsystem_CM_double -1.7E+308 1.7E+308 /end CHARACTERISTIC
/begin CHARACTERISTIC Raw_Data_CAN_Subsystem_cal_impl.CANStatus_P26 "" VALUE 0x002164F0 Scalar_FLOAT64_IEEE 0 Raw_Data_CAN_Subsystem_CM_double -1.7E+308 1.7E+308 /end CHARACTERISTIC
/begin CHARACTERISTIC Raw_Data_CAN_Subsystem_cal_impl.CANStatus_P27 "" VALUE 0x00216508 Scalar_FLOAT64_IEEE 0 Raw_Data_CAN_Subsystem_CM_double -1.7E+308 1.7E+308 /end CHARACTERISTIC
/begin CHARACTERISTIC Raw_Data_CAN_Subsystem_cal_impl.CANStatus_P28 "" VALUE 0x00216520 Scalar_FLOAT64_IEEE 0 Raw_Data_CAN_Subsystem_CM_double -1.7E+308 1.7E+308 /end CHARACTERISTIC
/begin CHARACTERISTIC Raw_Data_CAN_Subsystem_cal_impl.CANStatus_P29 "" VALUE 0x00216538 Scalar_FLOAT64_IEEE 0 Raw_Data_CAN_Subsystem_CM_double -1.7E+308 1.7E+308 /end CHARACTERISTIC
/begin CHARACTERISTIC Raw_Data_CAN_Subsystem_cal_impl.CANStatus_P3 "" VALUE 0x002162C8 Scalar_FLOAT64_IEEE 0 Raw_Data_CAN_Subsystem_CM_double -1.7E+308 1.7E+308 /end CHARACTERISTIC
/begin CHARACTERISTIC Raw_Data_CAN_Subsystem_cal_impl.CANStatus_P30 "" VALUE 0x00216550 Scalar_FLOAT64_IEEE 0 Raw_Data_CAN_Subsystem_CM_double -1.7E+308 1.7E+308 /end CHARACTERISTIC
/begin CHARACTERISTIC Raw_Data_CAN_Subsystem_cal_impl.CANStatus_P31 "" VALUE 0x00216568 Scalar_FLOAT64_IEEE 0 Raw_Data_CAN_Subsystem_CM_double -1.7E+308 1.7E+308 /end CHARACTERISTIC
/begin CHARACTERISTIC Raw_Data_CAN_Subsystem_cal_impl.CANStatus_P32 "" VALUE 0x00216580 Scalar_FLOAT64_IEEE 0 Raw_Data_CAN_Subsystem_CM_double -1.7E+308 1.7E+308 /end CHARACTERISTIC
/begin CHARACTERISTIC Raw_Data_CAN_Subsystem_cal_impl.CANStatus_P33 "" VALUE 0x00216598 Scalar_FLOAT64_IEEE 0 Raw_Data_CAN_Subsystem_CM_double -1.7E+308 1.7E+308 /end CHARACTERISTIC
/begin CHARACTERISTIC Raw_Data_CAN_Subsystem_cal_impl.CANStatus_P34 "" VALUE 0x002165B0 Scalar_FLOAT64_IEEE 0 Raw_Data_CAN_Subsystem_CM_double -1.7E+308 1.7E+308 /end CHARACTERISTIC
/begin CHARACTERISTIC Raw_Data_CAN_Subsystem_cal_impl.CANStatus_P4 "" VALUE 0x002162E0 Scalar_FLOAT64_IEEE 0 Raw_Data_CAN_Subsystem_CM_double -1.7E+308 1.7E+308 /end CHARACTERISTIC
/begin CHARACTERISTIC Raw_Data_CAN_Subsystem_cal_impl.CANStatus_P5 "" VALUE 0x002162F8 Scalar_FLOAT64_IEEE 0 Raw_Data_CAN_Subsystem_CM_double -1.7E+308 1.7E+308 /end CHARACTERISTIC
/begin CHARACTERISTIC Raw_Data_CAN_Subsystem_cal_impl.CANStatus_P6 "" VALUE 0x00216310 Scalar_FLOAT64_IEEE 0 Raw_Data_CAN_Subsystem_CM_double -1.7E+308 1.7E+308 /end CHARACTERISTIC
/begin CHARACTERISTIC Raw_Data_CAN_Subsystem_cal_impl.CANStatus_P7 "" VALUE 0x00216328 Scalar_FLOAT64_IEEE 0 Raw_Data_CAN_Subsystem_CM_double -1.7E+308 1.7E+308 /end CHARACTERISTIC
/begin CHARACTERISTIC Raw_Data_CAN_Subsystem_cal_impl.CANStatus_P8 "" VALUE 0x00216340 Scalar_FLOAT64_IEEE 0 Raw_Data_CAN_Subsystem_CM_double -1.7E+308 1.7E+308 /end CHARACTERISTIC
/begin CHARACTERISTIC Raw_Data_CAN_Subsystem_cal_impl.CANStatus_P9 "" VALUE 0x00216358 Scalar_FLOAT64_IEEE 0 Raw_Data_CAN_Subsystem_CM_double -1.7E+308 1.7E+308 /end CHARACTERISTIC
/begin CHARACTERISTIC Raw_Data_CAN_Subsystem_cal_impl.CANWrite1_P1 "" VAL_BLK 0x00216210 Scalar_FLOAT64_IEEE 0 Raw_Data_CAN_Subsystem_CM_double -1.7E+308 1.7E+308 MATRIX_DIM 7 1 /end CHARACTERISTIC
/begin CHARACTERISTIC Raw_Data_CAN_Subsystem_cal_impl.Constant1_Value "" VAL_BLK 0x00216632 Scalar_UBYTE 0 Raw_Data_CAN_Subsystem_CM_uint8 0 255 MATRIX_DIM 8 1 /end CHARACTERISTIC
/begin CHARACTERISTIC Raw_Data_CAN_Subsystem_cal_impl.Constant3_Value "" VAL_BLK 0x0021663A Scalar_UBYTE 0 Raw_Data_CAN_Subsystem_CM_uint8 0 255 MATRIX_DIM 8 1 /end CHARACTERISTIC
/begin CHARACTERISTIC Raw_Data_CAN_Subsystem_cal_impl.Constant4_Value "" VALUE 0x002165C0 Scalar_FLOAT64_IEEE 0 Raw_Data_CAN_Subsystem_CM_double -1.7E+308 1.7E+308 /end CHARACTERISTIC
/begin CHARACTERISTIC Raw_Data_CAN_Subsystem_cal_impl.Constant5_Value "" VALUE 0x002165B8 Scalar_FLOAT64_IEEE 0 Raw_Data_CAN_Subsystem_CM_double -1.7E+308 1.7E+308 /end CHARACTERISTIC
/begin CHARACTERISTIC Raw_Data_CAN_Subsystem_cal_impl.Constant_Value "" VALUE 0x002165C8 Scalar_FLOAT64_IEEE 0 Raw_Data_CAN_Subsystem_CM_double -1.7E+308 1.7E+308 /end CHARACTERISTIC
/begin CHARACTERISTIC Raw_Data_CAN_Subsystem_cal_impl.Constant_Value_e "" VAL_BLK 0x0021662A Scalar_UBYTE 0 Raw_Data_CAN_Subsystem_CM_uint8 0 255 MATRIX_DIM 8 1 /end CHARACTERISTIC
/begin CHARACTERISTIC Raw_Data_CAN_Subsystem_cal_impl.DataStoreMemory1_InitialValue "" VAL_BLK 0x00216600 Scalar_FLOAT64_IEEE 0 Raw_Data_CAN_Subsystem_CM_double -1.7E+308 1.7E+308 MATRIX_DIM 5 1 /end CHARACTERISTIC
/begin CHARACTERISTIC Raw_Data_CAN_Subsystem_cal_impl.DataStoreMemory_InitialValue "" VALUE 0x002165F8 Scalar_FLOAT64_IEEE 0 Raw_Data_CAN_Subsystem_CM_double -1.7E+308 1.7E+308 /end CHARACTERISTIC
/begin CHARACTERISTIC Raw_Data_CAN_Subsystem_cal_impl.Onespin_Value "" VAL_BLK 0x002165D0 Scalar_FLOAT64_IEEE 0 Raw_Data_CAN_Subsystem_CM_double -1.7E+308 1.7E+308 MATRIX_DIM 5 1 /end CHARACTERISTIC
/begin CHARACTERISTIC Raw_Data_CAN_Subsystem_cal_impl.Outport1_Y0 "" VALUE 0x00216028 Scalar_FLOAT64_IEEE 0 Raw_Data_CAN_Subsystem_CM_double -1.7E+308 1.7E+308 /end CHARACTERISTIC
/begin CHARACTERISTIC Raw_Data_CAN_Subsystem_cal_impl.Outport2_Y0 "" VALUE 0x00216030 Scalar_FLOAT64_IEEE 0 Raw_Data_CAN_Subsystem_CM_double -1.7E+308 1.7E+308 /end CHARACTERISTIC
/begin CHARACTERISTIC Raw_Data_CAN_Subsystem_cal_impl.Outport3_Y0 "" VALUE 0x00216038 Scalar_FLOAT64_IEEE 0 Raw_Data_CAN_Subsystem_CM_double -1.7E+308 1.7E+308 /end CHARACTERISTIC
/begin CHARACTERISTIC Raw_Data_CAN_Subsystem_cal_impl.Outport4_Y0 "" VALUE 0x00216629 Scalar_UBYTE 0 Raw_Data_CAN_Subsystem_CM_uint8 0 255 /end CHARACTERISTIC
/begin CHARACTERISTIC Raw_Data_CAN_Subsystem_cal_impl.Outport_Y0 "" VALUE 0x00216020 Scalar_FLOAT64_IEEE 0 Raw_Data_CAN_Subsystem_CM_double -1.7E+308 1.7E+308 /end CHARACTERISTIC
/begin CHARACTERISTIC Raw_Data_CAN_Subsystem_cal_impl.SineWave1_Amp "" VALUE 0x00216268 Scalar_FLOAT64_IEEE 0 Raw_Data_CAN_Subsystem_CM_double -1.7E+308 1.7E+308 /end CHARACTERISTIC
/begin CHARACTERISTIC Raw_Data_CAN_Subsystem_cal_impl.SineWave1_Bias "" VALUE 0x00216270 Scalar_FLOAT64_IEEE 0 Raw_Data_CAN_Subsystem_CM_double -1.7E+308 1.7E+308 /end CHARACTERISTIC
/begin CHARACTERISTIC Raw_Data_CAN_Subsystem_cal_impl.SineWave1_Freq "" VALUE 0x00216278 Scalar_FLOAT64_IEEE 0 Raw_Data_CAN_Subsystem_CM_double -1.7E+308 1.7E+308 /end CHARACTERISTIC
/begin CHARACTERISTIC Raw_Data_CAN_Subsystem_cal_impl.SineWave1_Phase "" VALUE 0x00216280 Scalar_FLOAT64_IEEE 0 Raw_Data_CAN_Subsystem_CM_double -1.7E+308 1.7E+308 /end CHARACTERISTIC
/begin CHARACTERISTIC Raw_Data_CAN_Subsystem_cal_impl.SineWave_Amp "" VALUE 0x00216248 Scalar_FLOAT64_IEEE 0 Raw_Data_CAN_Subsystem_CM_double -1.7E+308 1.7E+308 /end CHARACTERISTIC
/begin CHARACTERISTIC Raw_Data_CAN_Subsystem_cal_impl.SineWave_Bias "" VALUE 0x00216250 Scalar_FLOAT64_IEEE 0 Raw_Data_CAN_Subsystem_CM_double -1.7E+308 1.7E+308 /end CHARACTERISTIC
/begin CHARACTERISTIC Raw_Data_CAN_Subsystem_cal_impl.SineWave_Freq "" VALUE 0x00216258 Scalar_FLOAT64_IEEE 0 Raw_Data_CAN_Subsystem_CM_double -1.7E+308 1.7E+308 /end CHARACTERISTIC
/begin CHARACTERISTIC Raw_Data_CAN_Subsystem_cal_impl.SineWave_Phase "" VALUE 0x00216260 Scalar_FLOAT64_IEEE 0 Raw_Data_CAN_Subsystem_CM_double -1.7E+308 1.7E+308 /end CHARACTERISTIC
/begin CHARACTERISTIC Raw_Data_CAN_Subsystem_cal_impl.Status_Y0 "" VALUE 0x00216628 Scalar_SBYTE 0 Raw_Data_CAN_Subsystem_CM_int8 -128 127 /end CHARACTERISTIC
/begin MEASUREMENT Raw_Data_CAN_Subsystem_B.Add "" FLOAT64_IEEE Raw_Data_CAN_Subsystem_CM_double 0 0 -1.7E+308 1.7E+308 ECU_ADDRESS 0x00218B20 /end MEASUREMENT
/begin MEASUREMENT Raw_Data_CAN_Subsystem_B.Add_e "" FLOAT64_IEEE Raw_Data_CAN_Subsystem_CM_double 0 0 -1.7E+308 1.7E+308 ECU_ADDRESS 0x00218B30 /end MEASUREMENT
/begin MEASUREMENT Raw_Data_CAN_Subsystem_B.BytePacking "" UBYTE Raw_Data_CAN_Subsystem_CM_uint8 0 0 0 255 LAYOUT COLUMN_DIR MATRIX_DIM 8 ECU_ADDRESS 0x00218B95 /end MEASUREMENT
/begin MEASUREMENT Raw_Data_CAN_Subsystem_B.CANRead_o1 "" UBYTE Raw_Data_CAN_Subsystem_CM_logical 0 0 0 1 ECU_ADDRESS 0x00218BA7 /end MEASUREMENT
/begin MEASUREMENT Raw_Data_CAN_Subsystem_B.CANUnpack_o1 "" FLOAT64_IEEE Raw_Data_CAN_Subsystem_CM_double 0 0 -1.7E+308 1.7E+308 ECU_ADDRESS 0x00218B50 /end MEASUREMENT
/begin MEASUREMENT Raw_Data_CAN_Subsystem_B.CANUnpack_o2 "" FLOAT64_IEEE Raw_Data_CAN_Subsystem_CM_double 0 0 -1.7E+308 1.7E+308 ECU_ADDRESS 0x00218B58 /end MEASUREMENT
/begin MEASUREMENT Raw_Data_CAN_Subsystem_B.CANUnpack_o3 "" FLOAT64_IEEE Raw_Data_CAN_Subsystem_CM_double 0 0 -1.7E+308 1.7E+308 ECU_ADDRESS 0x00218B60 /end MEASUREMENT
/begin MEASUREMENT Raw_Data_CAN_Subsystem_B.CANUnpack_o4 "" FLOAT64_IEEE Raw_Data_CAN_Subsystem_CM_double 0 0 -1.7E+308 1.7E+308 ECU_ADDRESS 0x00218B68 /end MEASUREMENT
/begin MEASUREMENT Raw_Data_CAN_Subsystem_B.CANUnpack_o5 "" UBYTE Raw_Data_CAN_Subsystem_CM_uint8 0 0 0 255 ECU_ADDRESS 0x00218BA5 /end MEASUREMENT
/begin MEASUREMENT Raw_Data_CAN_Subsystem_B.CANWrite1 "" SBYTE Raw_Data_CAN_Subsystem_CM_int8 0 0 -128 127 ECU_ADDRESS 0x00218BA6 /end MEASUREMENT
/begin MEASUREMENT Raw_Data_CAN_Subsystem_B.CastToDouble "" FLOAT64_IEEE Raw_Data_CAN_Subsystem_CM_double 0 0 -1.7E+308 1.7E+308 LAYOUT COLUMN_DIR MATRIX_DIM 5 ECU_ADDRESS 0x00218AD0 /end MEASUREMENT
/begin MEASUREMENT Raw_Data_CAN_Subsystem_B.Clock "" FLOAT64_IEEE Raw_Data_CAN_Subsystem_CM_double 0 0 -1.7E+308 1.7E+308 ECU_ADDRESS 0x00218B08 /end MEASUREMENT
/begin MEASUREMENT Raw_Data_CAN_Subsystem_B.Compare "" UBYTE Raw_Data_CAN_Subsystem_CM_uint8 0 0 0 255 LAYOUT COLUMN_DIR MATRIX_DIM 5 ECU_ADDRESS 0x00218B88 /end MEASUREMENT
/begin MEASUREMENT Raw_Data_CAN_Subsystem_B.DataStoreRead "" FLOAT64_IEEE Raw_Data_CAN_Subsystem_CM_double 0 0 -1.7E+308 1.7E+308 LAYOUT COLUMN_DIR MATRIX_DIM 5 ECU_ADDRESS 0x00218A80 /end MEASUREMENT
/begin MEASUREMENT Raw_Data_CAN_Subsystem_B.DataStoreRead1 "" FLOAT64_IEEE Raw_Data_CAN_Subsystem_CM_double 0 0 -1.7E+308 1.7E+308 ECU_ADDRESS 0x00218B00 /end MEASUREMENT
/begin MEASUREMENT Raw_Data_CAN_Subsystem_B.DataStoreRead1_p "" FLOAT64_IEEE Raw_Data_CAN_Subsystem_CM_double 0 0 -1.7E+308 1.7E+308 ECU_ADDRESS 0x00218B18 /end MEASUREMENT
/begin MEASUREMENT Raw_Data_CAN_Subsystem_B.DataStoreRead2 "" FLOAT64_IEEE Raw_Data_CAN_Subsystem_CM_double 0 0 -1.7E+308 1.7E+308 ECU_ADDRESS 0x00218A50 /end MEASUREMENT
/begin MEASUREMENT Raw_Data_CAN_Subsystem_B.DataStoreRead2_c "" FLOAT64_IEEE Raw_Data_CAN_Subsystem_CM_double 0 0 -1.7E+308 1.7E+308 ECU_ADDRESS 0x00218B10 /end MEASUREMENT
/begin MEASUREMENT Raw_Data_CAN_Subsystem_B.DataStoreRead_b "" FLOAT64_IEEE Raw_Data_CAN_Subsystem_CM_double 0 0 -1.7E+308 1.7E+308 ECU_ADDRESS 0x00218B28 /end MEASUREMENT
/begin MEASUREMENT Raw_Data_CAN_Subsystem_B.I_ff "" FLOAT64_IEEE Raw_Data_CAN_Subsystem_CM_double 0 0 -1.7E+308 1.7E+308 ECU_ADDRESS 0x00218B80 /end MEASUREMENT
/begin MEASUREMENT Raw_Data_CAN_Subsystem_B.MultiportSwitch "" UBYTE Raw_Data_CAN_Subsystem_CM_uint8 0 0 0 255 LAYOUT COLUMN_DIR MATRIX_DIM 8 ECU_ADDRESS 0x00218B8D /end MEASUREMENT
/begin MEASUREMENT Raw_Data_CAN_Subsystem_B.Onespin "" FLOAT64_IEEE Raw_Data_CAN_Subsystem_CM_double 0 0 -1.7E+308 1.7E+308 LAYOUT COLUMN_DIR MATRIX_DIM 5 ECU_ADDRESS 0x00218A58 /end MEASUREMENT
/begin MEASUREMENT Raw_Data_CAN_Subsystem_B.SineWave "" FLOAT64_IEEE Raw_Data_CAN_Subsystem_CM_double 0 0 -1.7E+308 1.7E+308 ECU_ADDRESS 0x00218B38 /end MEASUREMENT
/begin MEASUREMENT Raw_Data_CAN_Subsystem_B.SineWave1 "" FLOAT64_IEEE Raw_Data_CAN_Subsystem_CM_double 0 0 -1.7E+308 1.7E+308 ECU_ADDRESS 0x00218B40 /end MEASUREMENT
/begin MEASUREMENT Raw_Data_CAN_Subsystem_B.Sum "" FLOAT64_IEEE Raw_Data_CAN_Subsystem_CM_double 0 0 -1.7E+308 1.7E+308 LAYOUT COLUMN_DIR MATRIX_DIM 5 ECU_ADDRESS 0x00218AA8 /end MEASUREMENT
/begin MEASUREMENT Raw_Data_CAN_Subsystem_B.SumofElements "" FLOAT64_IEEE Raw_Data_CAN_Subsystem_CM_double 0 0 -1.7E+308 1.7E+308 ECU_ADDRESS 0x00218AF8 /end MEASUREMENT
/begin MEASUREMENT Raw_Data_CAN_Subsystem_B.b "" UBYTE Raw_Data_CAN_Subsystem_CM_uint8 0 0 0 255 LAYOUT COLUMN_DIR MATRIX_DIM 8 ECU_ADDRESS 0x00218B9D /end MEASUREMENT
/begin MEASUREMENT Raw_Data_CAN_Subsystem_B.pc "" FLOAT64_IEEE Raw_Data_CAN_Subsystem_CM_double 0 0 -1.7E+308 1.7E+308 ECU_ADDRESS 0x00218B48 /end MEASUREMENT
/begin MEASUREMENT Raw_Data_CAN_Subsystem_B.position "" FLOAT64_IEEE Raw_Data_CAN_Subsystem_CM_double 0 0 -1.7E+308 1.7E+308 ECU_ADDRESS 0x00218B70 /end MEASUREMENT
/begin MEASUREMENT Raw_Data_CAN_Subsystem_B.velocity "" FLOAT64_IEEE Raw_Data_CAN_Subsystem_CM_double 0 0 -1.7E+308 1.7E+308 ECU_ADDRESS 0x00218B78 /end MEASUREMENT
/begin MEASUREMENT Raw_Data_CAN_Subsystem_DW.CANUnpack_ModeSignalID "" SLONG Raw_Data_CAN_Subsystem_CM_int_T 0 0 -2147483648 2147483647 ECU_ADDRESS 0x002189F8 /end MEASUREMENT
/begin MEASUREMENT Raw_Data_CAN_Subsystem_DW.CANUnpack_StatusPortID "" SLONG Raw_Data_CAN_Subsystem_CM_int_T 0 0 -2147483648 2147483647 ECU_ADDRESS 0x002189FC /end MEASUREMENT
/begin MEASUREMENT Raw_Data_CAN_Subsystem_DW.If1_ActiveSubsystem "" SBYTE Raw_Data_CAN_Subsystem_CM_int8 0 0 -128 127 ECU_ADDRESS 0x00218A01 /end MEASUREMENT
/begin MEASUREMENT Raw_Data_CAN_Subsystem_DW.If2_ActiveSubsystem "" SBYTE Raw_Data_CAN_Subsystem_CM_int8 0 0 -128 127 ECU_ADDRESS 0x00218A04 /end MEASUREMENT
/begin MEASUREMENT Raw_Data_CAN_Subsystem_DW.IfActionSubsystem_SubsysRanBC "" SBYTE Raw_Data_CAN_Subsystem_CM_int8 0 0 -128 127 ECU_ADDRESS 0x00218A09 /end MEASUREMENT
/begin MEASUREMENT Raw_Data_CAN_Subsystem_DW.If_ActiveSubsystem "" SBYTE Raw_Data_CAN_Subsystem_CM_int8 0 0 -128 127 ECU_ADDRESS 0x00218A00 /end MEASUREMENT
/begin MEASUREMENT Raw_Data_CAN_Subsystem_DW.If_ActiveSubsystem_f "" SBYTE Raw_Data_CAN_Subsystem_CM_int8 0 0 -128 127 ECU_ADDRESS 0x00218A08 /end MEASUREMENT
/begin MEASUREMENT Raw_Data_CAN_Subsystem_DW.Subsystem1_SubsysRanBC "" SBYTE Raw_Data_CAN_Subsystem_CM_int8 0 0 -128 127 ECU_ADDRESS 0x00218A02 /end MEASUREMENT
/begin MEASUREMENT Raw_Data_CAN_Subsystem_DW.Subsystem1_SubsysRanBC_o "" SBYTE Raw_Data_CAN_Subsystem_CM_int8 0 0 -128 127 ECU_ADDRESS 0x00218A06 /end MEASUREMENT
/begin MEASUREMENT Raw_Data_CAN_Subsystem_DW.Subsystem2_SubsysRanBC "" SBYTE Raw_Data_CAN_Subsystem_CM_int8 0 0 -128 127 ECU_ADDRESS 0x00218A03 /end MEASUREMENT
/begin MEASUREMENT Raw_Data_CAN_Subsystem_DW.Subsystem_SubsysRanBC "" SBYTE Raw_Data_CAN_Subsystem_CM_int8 0 0 -128 127 ECU_ADDRESS 0x00218A05 /end MEASUREMENT
/begin MEASUREMENT Raw_Data_CAN_Subsystem_DW.Subsystem_SubsysRanBC_o "" SBYTE Raw_Data_CAN_Subsystem_CM_int8 0 0 -128 127 ECU_ADDRESS 0x00218A07 /end MEASUREMENT
/begin MEASUREMENT Raw_Data_CAN_Subsystem_DW.c "" FLOAT64_IEEE Raw_Data_CAN_Subsystem_CM_double 0 0 -1.7E+308 1.7E+308 ECU_ADDRESS 0x002188C0 /end MEASUREMENT
/begin MEASUREMENT Raw_Data_CAN_Subsystem_DW.reinput "" FLOAT64_IEEE Raw_Data_CAN_Subsystem_CM_double 0 0 -1.7E+308 1.7E+308 LAYOUT COLUMN_DIR MATRIX_DIM 5 ECU_ADDRESS 0x002188C8 /end MEASUREMENT
/begin COMPU_METHOD Raw_Data_CAN_Subsystem_CM_double "" IDENTICAL "%15.10" "" /end COMPU_METHOD
/begin COMPU_METHOD Raw_Data_CAN_Subsystem_CM_int8 "" IDENTICAL "%3.0" "" /end COMPU_METHOD
/begin COMPU_METHOD Raw_Data_CAN_Subsystem_CM_int_T "" IDENTICAL "customformat" "" /end COMPU_METHOD
/begin COMPU_METHOD Raw_Data_CAN_Subsystem_CM_logical "" IDENTICAL "%1.0" "" /end COMPU_METHOD
/begin COMPU_METHOD Raw_Data_CAN_Subsystem_CM_uint8 "" IDENTICAL "%3.0" "" /end COMPU_METHOD
/begin RECORD_LAYOUT Scalar_BOOLEAN FNC_VALUES 1 UBYTE COLUMN_DIR DIRECT /end RECORD_LAYOUT
/begin RECORD_LAYOUT Scalar_FLOAT64_IEEE FNC_VALUES 1 FLOAT64_IEEE COLUMN_DIR DIRECT /end RECORD_LAYOUT
/begin RECORD_LAYOUT Scalar_SBYTE FNC_VALUES 1 SBYTE COLUMN_DIR DIRECT /end RECORD_LAYOUT
/begin RECORD_LAYOUT Scalar_SLONG FNC_VALUES 1 SLONG COLUMN_DIR DIRECT /end RECORD_LAYOUT
/begin RECORD_LAYOUT Scalar_UBYTE FNC_VALUES 1 UBYTE COLUMN_DIR DIRECT /end RECORD_LAYOUT
/begin GROUP Raw_Data_CAN_Subsystem "Raw_Data_CAN_Subsystem" ROOT /end GROUP
/end MODULE
/end PROJECT
