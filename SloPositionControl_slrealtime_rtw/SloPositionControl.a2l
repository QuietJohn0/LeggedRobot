/******************************************************************************
* ASAP2 file: SloPositionControl.a2l
* Academic License - for use in teaching, academic research, and meeting
* course requirements at degree granting institutions only. Not for
* government, commercial, or other organizational use.
* Code generation for model "SloPositionControl".
* Model version : 1.1
* Simulink Coder version : 10.3 R2021a
* C source code generated on : Fri Aug 20 14:17:38 2021
* Target selection: slrealtime.tlc
* Embedded hardware selection: Intel->x86-64 (Linux 64)
* Code generation objectives: Unspecified
* Validation result: Not run
* (add additional file header information here)
******************************************************************************/ ASAP2_VERSION 1 71
/begin PROJECT ProjectName "Project Comment Goes Here"
/begin HEADER "Header Comments go here" /end HEADER
/begin MODULE ModuleName "Module Comment Goes Here"
/begin IF_DATA XCP
 /begin PROTOCOL_LAYER 0x0100 0x03E8 0x00C8 0x0000 0x0000 0x0000 0x0000 0x0000 0xFC 0x0578 BYTE_ORDER_MSB_LAST ADDRESS_GRANULARITY_BYTE OPTIONAL_CMD ALLOC_ODT_ENTRY OPTIONAL_CMD ALLOC_ODT OPTIONAL_CMD ALLOC_DAQ OPTIONAL_CMD FREE_DAQ OPTIONAL_CMD GET_DAQ_RESOLUTION_INFO OPTIONAL_CMD GET_DAQ_PROCESSOR_INFO OPTIONAL_CMD START_STOP_SYNCH OPTIONAL_CMD START_STOP_DAQ_LIST OPTIONAL_CMD SET_DAQ_LIST_MODE OPTIONAL_CMD WRITE_DAQ OPTIONAL_CMD SET_DAQ_PTR OPTIONAL_CMD GET_CAL_PAGE OPTIONAL_CMD SET_CAL_PAGE OPTIONAL_CMD COPY_CAL_PAGE OPTIONAL_CMD SHORT_DOWNLOAD OPTIONAL_CMD DOWNLOAD_MAX OPTIONAL_CMD DOWNLOAD OPTIONAL_CMD SHORT_UPLOAD OPTIONAL_CMD UPLOAD OPTIONAL_CMD SET_MTA /end PROTOCOL_LAYER
 /begin DAQ DYNAMIC 0x0000 0x0080 0x00 OPTIMISATION_TYPE_DEFAULT ADDRESS_EXTENSION_FREE IDENTIFICATION_FIELD_TYPE_RELATIVE_WORD_ALIGNED GRANULARITY_ODT_ENTRY_SIZE_DAQ_BYTE 0xFF OVERLOAD_INDICATION_PID PRESCALER_SUPPORTED /begin STIM GRANULARITY_ODT_ENTRY_SIZE_STIM_BYTE 0xFF /end STIM /begin TIMESTAMP_SUPPORTED 0x0001 SIZE_DWORD UNIT_1US TIMESTAMP_FIXED /end TIMESTAMP_SUPPORTED /begin EVENT "20 ms" "20 ms" 0x0000 DAQ 0xFF 0x02 0x07 0x00 /end EVENT /begin EVENT "20 ms" "20 ms" 0x0003 DAQ 0xFF 0x02 0x07 0x00 /end EVENT /begin EVENT "20 ms" "20 ms" 0x0004 DAQ 0xFF 0x02 0x07 0x00 /end EVENT /end DAQ
 /begin XCP_ON_UDP_IP 0x0100 0x15B3 ADDRESS "192.168.7.5" /end XCP_ON_UDP_IP
/end IF_DATA
/begin MOD_PAR "MOD PAR Comment Goes Here"
 /begin MEMORY_SEGMENT SloPositionControl_cal_impl "SloPositionControl_cal_impl" DATA FLASH INTERN 0x00216020 0x648 -1 -1 -1 -1 -1
  /begin IF_DATA XCP
   /begin SEGMENT 0x00 0x02 0x00 0x00 0x00
    /begin PAGE 0x00 ECU_ACCESS_DONT_CARE XCP_READ_ACCESS_DONT_CARE XCP_WRITE_ACCESS_NOT_ALLOWED /end PAGE
    /begin PAGE 0x01 ECU_ACCESS_DONT_CARE XCP_READ_ACCESS_DONT_CARE XCP_WRITE_ACCESS_DONT_CARE /end PAGE
   /end SEGMENT
  /end IF_DATA
 /end MEMORY_SEGMENT
/end MOD_PAR
/begin MOD_COMMON "Mod Common Comment Here" BYTE_ORDER MSB_LAST ALIGNMENT_BYTE 1 ALIGNMENT_WORD 2 ALIGNMENT_LONG 8 ALIGNMENT_FLOAT32_IEEE 4 ALIGNMENT_FLOAT64_IEEE 8 ALIGNMENT_INT64 4 /end MOD_COMMON
/begin CHARACTERISTIC SloPositionControl_cal_impl.CANRead_P1 "" VAL_BLK 0x00216080 Scalar_FLOAT64_IEEE 0 SloPositionControl_CM_double -1.7E+308 1.7E+308 MATRIX_DIM 6 1 /end CHARACTERISTIC
/begin CHARACTERISTIC SloPositionControl_cal_impl.CANSetup_P1 "" VAL_BLK 0x00216170 Scalar_FLOAT64_IEEE 0 SloPositionControl_CM_double -1.7E+308 1.7E+308 MATRIX_DIM 40 1 /end CHARACTERISTIC
/begin CHARACTERISTIC SloPositionControl_cal_impl.CANSetup_P2 "" VALUE 0x002162C0 Scalar_FLOAT64_IEEE 0 SloPositionControl_CM_double -1.7E+308 1.7E+308 /end CHARACTERISTIC
/begin CHARACTERISTIC SloPositionControl_cal_impl.CANSetup_P3 "" VALUE 0x002162D8 Scalar_FLOAT64_IEEE 0 SloPositionControl_CM_double -1.7E+308 1.7E+308 /end CHARACTERISTIC
/begin CHARACTERISTIC SloPositionControl_cal_impl.CANStatus_P1 "" VALUE 0x00216328 Scalar_FLOAT64_IEEE 0 SloPositionControl_CM_double -1.7E+308 1.7E+308 /end CHARACTERISTIC
/begin CHARACTERISTIC SloPositionControl_cal_impl.CANStatus_P10 "" VALUE 0x00216400 Scalar_FLOAT64_IEEE 0 SloPositionControl_CM_double -1.7E+308 1.7E+308 /end CHARACTERISTIC
/begin CHARACTERISTIC SloPositionControl_cal_impl.CANStatus_P11 "" VALUE 0x00216418 Scalar_FLOAT64_IEEE 0 SloPositionControl_CM_double -1.7E+308 1.7E+308 /end CHARACTERISTIC
/begin CHARACTERISTIC SloPositionControl_cal_impl.CANStatus_P12 "" VALUE 0x00216430 Scalar_FLOAT64_IEEE 0 SloPositionControl_CM_double -1.7E+308 1.7E+308 /end CHARACTERISTIC
/begin CHARACTERISTIC SloPositionControl_cal_impl.CANStatus_P13 "" VALUE 0x00216448 Scalar_FLOAT64_IEEE 0 SloPositionControl_CM_double -1.7E+308 1.7E+308 /end CHARACTERISTIC
/begin CHARACTERISTIC SloPositionControl_cal_impl.CANStatus_P14 "" VALUE 0x00216460 Scalar_FLOAT64_IEEE 0 SloPositionControl_CM_double -1.7E+308 1.7E+308 /end CHARACTERISTIC
/begin CHARACTERISTIC SloPositionControl_cal_impl.CANStatus_P15 "" VALUE 0x00216478 Scalar_FLOAT64_IEEE 0 SloPositionControl_CM_double -1.7E+308 1.7E+308 /end CHARACTERISTIC
/begin CHARACTERISTIC SloPositionControl_cal_impl.CANStatus_P16 "" VALUE 0x00216490 Scalar_FLOAT64_IEEE 0 SloPositionControl_CM_double -1.7E+308 1.7E+308 /end CHARACTERISTIC
/begin CHARACTERISTIC SloPositionControl_cal_impl.CANStatus_P17 "" VALUE 0x002164A8 Scalar_FLOAT64_IEEE 0 SloPositionControl_CM_double -1.7E+308 1.7E+308 /end CHARACTERISTIC
/begin CHARACTERISTIC SloPositionControl_cal_impl.CANStatus_P18 "" VALUE 0x002164C0 Scalar_FLOAT64_IEEE 0 SloPositionControl_CM_double -1.7E+308 1.7E+308 /end CHARACTERISTIC
/begin CHARACTERISTIC SloPositionControl_cal_impl.CANStatus_P19 "" VALUE 0x002164D8 Scalar_FLOAT64_IEEE 0 SloPositionControl_CM_double -1.7E+308 1.7E+308 /end CHARACTERISTIC
/begin CHARACTERISTIC SloPositionControl_cal_impl.CANStatus_P2 "" VALUE 0x00216340 Scalar_FLOAT64_IEEE 0 SloPositionControl_CM_double -1.7E+308 1.7E+308 /end CHARACTERISTIC
/begin CHARACTERISTIC SloPositionControl_cal_impl.CANStatus_P20 "" VALUE 0x002164F0 Scalar_FLOAT64_IEEE 0 SloPositionControl_CM_double -1.7E+308 1.7E+308 /end CHARACTERISTIC
/begin CHARACTERISTIC SloPositionControl_cal_impl.CANStatus_P21 "" VALUE 0x00216508 Scalar_FLOAT64_IEEE 0 SloPositionControl_CM_double -1.7E+308 1.7E+308 /end CHARACTERISTIC
/begin CHARACTERISTIC SloPositionControl_cal_impl.CANStatus_P22 "" VALUE 0x00216520 Scalar_FLOAT64_IEEE 0 SloPositionControl_CM_double -1.7E+308 1.7E+308 /end CHARACTERISTIC
/begin CHARACTERISTIC SloPositionControl_cal_impl.CANStatus_P23 "" VALUE 0x00216538 Scalar_FLOAT64_IEEE 0 SloPositionControl_CM_double -1.7E+308 1.7E+308 /end CHARACTERISTIC
/begin CHARACTERISTIC SloPositionControl_cal_impl.CANStatus_P24 "" VALUE 0x00216550 Scalar_FLOAT64_IEEE 0 SloPositionControl_CM_double -1.7E+308 1.7E+308 /end CHARACTERISTIC
/begin CHARACTERISTIC SloPositionControl_cal_impl.CANStatus_P25 "" VALUE 0x00216568 Scalar_FLOAT64_IEEE 0 SloPositionControl_CM_double -1.7E+308 1.7E+308 /end CHARACTERISTIC
/begin CHARACTERISTIC SloPositionControl_cal_impl.CANStatus_P26 "" VALUE 0x00216580 Scalar_FLOAT64_IEEE 0 SloPositionControl_CM_double -1.7E+308 1.7E+308 /end CHARACTERISTIC
/begin CHARACTERISTIC SloPositionControl_cal_impl.CANStatus_P27 "" VALUE 0x00216598 Scalar_FLOAT64_IEEE 0 SloPositionControl_CM_double -1.7E+308 1.7E+308 /end CHARACTERISTIC
/begin CHARACTERISTIC SloPositionControl_cal_impl.CANStatus_P28 "" VALUE 0x002165B0 Scalar_FLOAT64_IEEE 0 SloPositionControl_CM_double -1.7E+308 1.7E+308 /end CHARACTERISTIC
/begin CHARACTERISTIC SloPositionControl_cal_impl.CANStatus_P29 "" VALUE 0x002165C8 Scalar_FLOAT64_IEEE 0 SloPositionControl_CM_double -1.7E+308 1.7E+308 /end CHARACTERISTIC
/begin CHARACTERISTIC SloPositionControl_cal_impl.CANStatus_P3 "" VALUE 0x00216358 Scalar_FLOAT64_IEEE 0 SloPositionControl_CM_double -1.7E+308 1.7E+308 /end CHARACTERISTIC
/begin CHARACTERISTIC SloPositionControl_cal_impl.CANStatus_P30 "" VALUE 0x002165E0 Scalar_FLOAT64_IEEE 0 SloPositionControl_CM_double -1.7E+308 1.7E+308 /end CHARACTERISTIC
/begin CHARACTERISTIC SloPositionControl_cal_impl.CANStatus_P31 "" VALUE 0x002165F8 Scalar_FLOAT64_IEEE 0 SloPositionControl_CM_double -1.7E+308 1.7E+308 /end CHARACTERISTIC
/begin CHARACTERISTIC SloPositionControl_cal_impl.CANStatus_P32 "" VALUE 0x00216610 Scalar_FLOAT64_IEEE 0 SloPositionControl_CM_double -1.7E+308 1.7E+308 /end CHARACTERISTIC
/begin CHARACTERISTIC SloPositionControl_cal_impl.CANStatus_P33 "" VALUE 0x00216628 Scalar_FLOAT64_IEEE 0 SloPositionControl_CM_double -1.7E+308 1.7E+308 /end CHARACTERISTIC
/begin CHARACTERISTIC SloPositionControl_cal_impl.CANStatus_P34 "" VALUE 0x00216640 Scalar_FLOAT64_IEEE 0 SloPositionControl_CM_double -1.7E+308 1.7E+308 /end CHARACTERISTIC
/begin CHARACTERISTIC SloPositionControl_cal_impl.CANStatus_P4 "" VALUE 0x00216370 Scalar_FLOAT64_IEEE 0 SloPositionControl_CM_double -1.7E+308 1.7E+308 /end CHARACTERISTIC
/begin CHARACTERISTIC SloPositionControl_cal_impl.CANStatus_P5 "" VALUE 0x00216388 Scalar_FLOAT64_IEEE 0 SloPositionControl_CM_double -1.7E+308 1.7E+308 /end CHARACTERISTIC
/begin CHARACTERISTIC SloPositionControl_cal_impl.CANStatus_P6 "" VALUE 0x002163A0 Scalar_FLOAT64_IEEE 0 SloPositionControl_CM_double -1.7E+308 1.7E+308 /end CHARACTERISTIC
/begin CHARACTERISTIC SloPositionControl_cal_impl.CANStatus_P7 "" VALUE 0x002163B8 Scalar_FLOAT64_IEEE 0 SloPositionControl_CM_double -1.7E+308 1.7E+308 /end CHARACTERISTIC
/begin CHARACTERISTIC SloPositionControl_cal_impl.CANStatus_P8 "" VALUE 0x002163D0 Scalar_FLOAT64_IEEE 0 SloPositionControl_CM_double -1.7E+308 1.7E+308 /end CHARACTERISTIC
/begin CHARACTERISTIC SloPositionControl_cal_impl.CANStatus_P9 "" VALUE 0x002163E8 Scalar_FLOAT64_IEEE 0 SloPositionControl_CM_double -1.7E+308 1.7E+308 /end CHARACTERISTIC
/begin CHARACTERISTIC SloPositionControl_cal_impl.CANWrite1_P1 "" VAL_BLK 0x002160C0 Scalar_FLOAT64_IEEE 0 SloPositionControl_CM_double -1.7E+308 1.7E+308 MATRIX_DIM 7 1 /end CHARACTERISTIC
/begin CHARACTERISTIC SloPositionControl_cal_impl.Constant1_Value "" VAL_BLK 0x00216028 Scalar_FLOAT64_IEEE 0 SloPositionControl_CM_double -1.7E+308 1.7E+308 MATRIX_DIM 5 1 /end CHARACTERISTIC
/begin CHARACTERISTIC SloPositionControl_cal_impl.Constant1_Value_a "" VAL_BLK 0x002162E8 Scalar_FLOAT64_IEEE 0 SloPositionControl_CM_double -1.7E+308 1.7E+308 MATRIX_DIM 5 1 /end CHARACTERISTIC
/begin CHARACTERISTIC SloPositionControl_cal_impl.Constant1_Value_b "" VAL_BLK 0x00216100 Scalar_FLOAT64_IEEE 0 SloPositionControl_CM_double -1.7E+308 1.7E+308 MATRIX_DIM 5 1 /end CHARACTERISTIC
/begin CHARACTERISTIC SloPositionControl_cal_impl.Constant1_Value_f "" VAL_BLK 0x00216130 Scalar_FLOAT64_IEEE 0 SloPositionControl_CM_double -1.7E+308 1.7E+308 MATRIX_DIM 5 1 /end CHARACTERISTIC
/begin CHARACTERISTIC SloPositionControl_cal_impl.Constant1_Value_p "" VAL_BLK 0x00216651 Scalar_UBYTE 0 SloPositionControl_CM_uint8 0 255 MATRIX_DIM 8 1 /end CHARACTERISTIC
/begin CHARACTERISTIC SloPositionControl_cal_impl.Constant2_Value "" VALUE 0x00216310 Scalar_FLOAT64_IEEE 0 SloPositionControl_CM_double -1.7E+308 1.7E+308 /end CHARACTERISTIC
/begin CHARACTERISTIC SloPositionControl_cal_impl.Constant2_Value_c "" VAL_BLK 0x00216659 Scalar_UBYTE 0 SloPositionControl_CM_uint8 0 255 MATRIX_DIM 8 1 /end CHARACTERISTIC
/begin CHARACTERISTIC SloPositionControl_cal_impl.Constant_Value "" VALUE 0x00216020 Scalar_FLOAT64_IEEE 0 SloPositionControl_CM_double -1.7E+308 1.7E+308 /end CHARACTERISTIC
/begin CHARACTERISTIC SloPositionControl_cal_impl.Constant_Value_b "" VAL_BLK 0x00216649 Scalar_UBYTE 0 SloPositionControl_CM_uint8 0 255 MATRIX_DIM 8 1 /end CHARACTERISTIC
/begin CHARACTERISTIC SloPositionControl_cal_impl.Constant_Value_d "" VALUE 0x002162E0 Scalar_FLOAT64_IEEE 0 SloPositionControl_CM_double -1.7E+308 1.7E+308 /end CHARACTERISTIC
/begin CHARACTERISTIC SloPositionControl_cal_impl.Constant_Value_f "" VALUE 0x00216158 Scalar_FLOAT64_IEEE 0 SloPositionControl_CM_double -1.7E+308 1.7E+308 /end CHARACTERISTIC
/begin CHARACTERISTIC SloPositionControl_cal_impl.Constant_Value_m "" VALUE 0x00216128 Scalar_FLOAT64_IEEE 0 SloPositionControl_CM_double -1.7E+308 1.7E+308 /end CHARACTERISTIC
/begin CHARACTERISTIC SloPositionControl_cal_impl.Constant_Value_n "" VALUE 0x002160F8 Scalar_FLOAT64_IEEE 0 SloPositionControl_CM_double -1.7E+308 1.7E+308 /end CHARACTERISTIC
/begin CHARACTERISTIC SloPositionControl_cal_impl.Outport1_Y0 "" VALUE 0x00216058 Scalar_FLOAT64_IEEE 0 SloPositionControl_CM_double -1.7E+308 1.7E+308 /end CHARACTERISTIC
/begin CHARACTERISTIC SloPositionControl_cal_impl.Outport2_Y0 "" VALUE 0x00216060 Scalar_FLOAT64_IEEE 0 SloPositionControl_CM_double -1.7E+308 1.7E+308 /end CHARACTERISTIC
/begin CHARACTERISTIC SloPositionControl_cal_impl.Outport3_Y0 "" VALUE 0x00216068 Scalar_FLOAT64_IEEE 0 SloPositionControl_CM_double -1.7E+308 1.7E+308 /end CHARACTERISTIC
/begin CHARACTERISTIC SloPositionControl_cal_impl.Outport4_Y0 "" VALUE 0x00216648 Scalar_UBYTE 0 SloPositionControl_CM_uint8 0 255 /end CHARACTERISTIC
/begin CHARACTERISTIC SloPositionControl_cal_impl.Outport_Y0 "" VALUE 0x00216050 Scalar_FLOAT64_IEEE 0 SloPositionControl_CM_double -1.7E+308 1.7E+308 /end CHARACTERISTIC
/begin MEASUREMENT SloPositionControl_B.A "" FLOAT64_IEEE SloPositionControl_CM_double 0 0 -1.7E+308 1.7E+308 LAYOUT COLUMN_DIR MATRIX_DIM 5 ECU_ADDRESS 0x00218990 /end MEASUREMENT
/begin MEASUREMENT SloPositionControl_B.A_c "" FLOAT64_IEEE SloPositionControl_CM_double 0 0 -1.7E+308 1.7E+308 LAYOUT COLUMN_DIR MATRIX_DIM 5 ECU_ADDRESS 0x00218A70 /end MEASUREMENT
/begin MEASUREMENT SloPositionControl_B.A_o "" FLOAT64_IEEE SloPositionControl_CM_double 0 0 -1.7E+308 1.7E+308 LAYOUT COLUMN_DIR MATRIX_DIM 5 ECU_ADDRESS 0x00218AF8 /end MEASUREMENT
/begin MEASUREMENT SloPositionControl_B.BytePacking "" UBYTE SloPositionControl_CM_uint8 0 0 0 255 LAYOUT COLUMN_DIR MATRIX_DIM 8 ECU_ADDRESS 0x00218BAB /end MEASUREMENT
/begin MEASUREMENT SloPositionControl_B.C "" FLOAT64_IEEE SloPositionControl_CM_double 0 0 -1.7E+308 1.7E+308 ECU_ADDRESS 0x00218A60 /end MEASUREMENT
/begin MEASUREMENT SloPositionControl_B.CANRead_o1 "" UBYTE SloPositionControl_CM_logical 0 0 0 1 ECU_ADDRESS 0x00218BBD /end MEASUREMENT
/begin MEASUREMENT SloPositionControl_B.CANUnpack_o1 "" FLOAT64_IEEE SloPositionControl_CM_double 0 0 -1.7E+308 1.7E+308 ECU_ADDRESS 0x00218B58 /end MEASUREMENT
/begin MEASUREMENT SloPositionControl_B.CANUnpack_o2 "" FLOAT64_IEEE SloPositionControl_CM_double 0 0 -1.7E+308 1.7E+308 ECU_ADDRESS 0x00218B60 /end MEASUREMENT
/begin MEASUREMENT SloPositionControl_B.CANUnpack_o3 "" FLOAT64_IEEE SloPositionControl_CM_double 0 0 -1.7E+308 1.7E+308 ECU_ADDRESS 0x00218B68 /end MEASUREMENT
/begin MEASUREMENT SloPositionControl_B.CANUnpack_o4 "" FLOAT64_IEEE SloPositionControl_CM_double 0 0 -1.7E+308 1.7E+308 ECU_ADDRESS 0x00218B70 /end MEASUREMENT
/begin MEASUREMENT SloPositionControl_B.CANUnpack_o5 "" UBYTE SloPositionControl_CM_uint8 0 0 0 255 ECU_ADDRESS 0x00218BBC /end MEASUREMENT
/begin MEASUREMENT SloPositionControl_B.C_e "" FLOAT64_IEEE SloPositionControl_CM_double 0 0 -1.7E+308 1.7E+308 ECU_ADDRESS 0x00218AE8 /end MEASUREMENT
/begin MEASUREMENT SloPositionControl_B.FunctionCaller_o1 "" FLOAT64_IEEE SloPositionControl_CM_double 0 0 -1.7E+308 1.7E+308 ECU_ADDRESS 0x00218970 /end MEASUREMENT
/begin MEASUREMENT SloPositionControl_B.FunctionCaller_o1_c "" FLOAT64_IEEE SloPositionControl_CM_double 0 0 -1.7E+308 1.7E+308 ECU_ADDRESS 0x002189F0 /end MEASUREMENT
/begin MEASUREMENT SloPositionControl_B.FunctionCaller_o2 "" FLOAT64_IEEE SloPositionControl_CM_double 0 0 -1.7E+308 1.7E+308 ECU_ADDRESS 0x00218978 /end MEASUREMENT
/begin MEASUREMENT SloPositionControl_B.FunctionCaller_o2_e "" FLOAT64_IEEE SloPositionControl_CM_double 0 0 -1.7E+308 1.7E+308 ECU_ADDRESS 0x002189F8 /end MEASUREMENT
/begin MEASUREMENT SloPositionControl_B.FunctionCaller_o3 "" FLOAT64_IEEE SloPositionControl_CM_double 0 0 -1.7E+308 1.7E+308 ECU_ADDRESS 0x00218980 /end MEASUREMENT
/begin MEASUREMENT SloPositionControl_B.FunctionCaller_o3_e "" FLOAT64_IEEE SloPositionControl_CM_double 0 0 -1.7E+308 1.7E+308 ECU_ADDRESS 0x00218A00 /end MEASUREMENT
/begin MEASUREMENT SloPositionControl_B.FunctionCaller_o4 "" FLOAT64_IEEE SloPositionControl_CM_double 0 0 -1.7E+308 1.7E+308 ECU_ADDRESS 0x00218988 /end MEASUREMENT
/begin MEASUREMENT SloPositionControl_B.FunctionCaller_o4_k "" FLOAT64_IEEE SloPositionControl_CM_double 0 0 -1.7E+308 1.7E+308 ECU_ADDRESS 0x00218A08 /end MEASUREMENT
/begin MEASUREMENT SloPositionControl_B.FunctionCaller_o5 "" UBYTE SloPositionControl_CM_uint8 0 0 0 255 ECU_ADDRESS 0x00218BA0 /end MEASUREMENT
/begin MEASUREMENT SloPositionControl_B.FunctionCaller_o5_b "" UBYTE SloPositionControl_CM_uint8 0 0 0 255 ECU_ADDRESS 0x00218BA1 /end MEASUREMENT
/begin MEASUREMENT SloPositionControl_B.ID "" FLOAT64_IEEE SloPositionControl_CM_double 0 0 -1.7E+308 1.7E+308 ECU_ADDRESS 0x002189E0 /end MEASUREMENT
/begin MEASUREMENT SloPositionControl_B.ID_a "" FLOAT64_IEEE SloPositionControl_CM_double 0 0 -1.7E+308 1.7E+308 ECU_ADDRESS 0x00218A30 /end MEASUREMENT
/begin MEASUREMENT SloPositionControl_B.ID_au "" FLOAT64_IEEE SloPositionControl_CM_double 0 0 -1.7E+308 1.7E+308 ECU_ADDRESS 0x00218B48 /end MEASUREMENT
/begin MEASUREMENT SloPositionControl_B.ID_f "" FLOAT64_IEEE SloPositionControl_CM_double 0 0 -1.7E+308 1.7E+308 ECU_ADDRESS 0x00218A40 /end MEASUREMENT
/begin MEASUREMENT SloPositionControl_B.ID_m "" FLOAT64_IEEE SloPositionControl_CM_double 0 0 -1.7E+308 1.7E+308 ECU_ADDRESS 0x00218B90 /end MEASUREMENT
/begin MEASUREMENT SloPositionControl_B.ID_o "" FLOAT64_IEEE SloPositionControl_CM_double 0 0 -1.7E+308 1.7E+308 ECU_ADDRESS 0x00218A50 /end MEASUREMENT
/begin MEASUREMENT SloPositionControl_B.I_ff "" FLOAT64_IEEE SloPositionControl_CM_double 0 0 -1.7E+308 1.7E+308 ECU_ADDRESS 0x00218B88 /end MEASUREMENT
/begin MEASUREMENT SloPositionControl_B.MultiportSwitch "" UBYTE SloPositionControl_CM_uint8 0 0 0 255 LAYOUT COLUMN_DIR MATRIX_DIM 8 ECU_ADDRESS 0x00218BA3 /end MEASUREMENT
/begin MEASUREMENT SloPositionControl_B.P_out "" FLOAT64_IEEE SloPositionControl_CM_double 0 0 -1.7E+308 1.7E+308 ECU_ADDRESS 0x00218AD8 /end MEASUREMENT
/begin MEASUREMENT SloPositionControl_B.TmpSignalConversionAtAOutpor_oh "" FLOAT64_IEEE SloPositionControl_CM_double 0 0 -1.7E+308 1.7E+308 LAYOUT COLUMN_DIR MATRIX_DIM 5 ECU_ADDRESS 0x00218B20 /end MEASUREMENT
/begin MEASUREMENT SloPositionControl_B.TmpSignalConversionAtAOutport1 "" FLOAT64_IEEE SloPositionControl_CM_double 0 0 -1.7E+308 1.7E+308 LAYOUT COLUMN_DIR MATRIX_DIM 5 ECU_ADDRESS 0x002189B8 /end MEASUREMENT
/begin MEASUREMENT SloPositionControl_B.TmpSignalConversionAtAOutport_o "" FLOAT64_IEEE SloPositionControl_CM_double 0 0 -1.7E+308 1.7E+308 LAYOUT COLUMN_DIR MATRIX_DIM 5 ECU_ADDRESS 0x00218A98 /end MEASUREMENT
/begin MEASUREMENT SloPositionControl_B.TmpSignalConversionAtCOutport1 "" FLOAT64_IEEE SloPositionControl_CM_double 0 0 -1.7E+308 1.7E+308 ECU_ADDRESS 0x00218A68 /end MEASUREMENT
/begin MEASUREMENT SloPositionControl_B.TmpSignalConversionAtCOutport_g "" FLOAT64_IEEE SloPositionControl_CM_double 0 0 -1.7E+308 1.7E+308 ECU_ADDRESS 0x00218AF0 /end MEASUREMENT
/begin MEASUREMENT SloPositionControl_B.TmpSignalConversionAtID1Inpor_a "" FLOAT64_IEEE SloPositionControl_CM_double 0 0 -1.7E+308 1.7E+308 ECU_ADDRESS 0x00218AC8 /end MEASUREMENT
/begin MEASUREMENT SloPositionControl_B.TmpSignalConversionAtID1Inport1 "" FLOAT64_IEEE SloPositionControl_CM_double 0 0 -1.7E+308 1.7E+308 ECU_ADDRESS 0x00218A10 /end MEASUREMENT
/begin MEASUREMENT SloPositionControl_B.TmpSignalConversionAtIDOu_d1nwt "" FLOAT64_IEEE SloPositionControl_CM_double 0 0 -1.7E+308 1.7E+308 ECU_ADDRESS 0x00218B98 /end MEASUREMENT
/begin MEASUREMENT SloPositionControl_B.TmpSignalConversionAtIDOut_d1nw "" FLOAT64_IEEE SloPositionControl_CM_double 0 0 -1.7E+308 1.7E+308 ECU_ADDRESS 0x00218B50 /end MEASUREMENT
/begin MEASUREMENT SloPositionControl_B.TmpSignalConversionAtIDOutp_d1n "" FLOAT64_IEEE SloPositionControl_CM_double 0 0 -1.7E+308 1.7E+308 ECU_ADDRESS 0x00218A58 /end MEASUREMENT
/begin MEASUREMENT SloPositionControl_B.TmpSignalConversionAtIDOutpo_d1 "" FLOAT64_IEEE SloPositionControl_CM_double 0 0 -1.7E+308 1.7E+308 ECU_ADDRESS 0x00218A48 /end MEASUREMENT
/begin MEASUREMENT SloPositionControl_B.TmpSignalConversionAtIDOutpor_d "" FLOAT64_IEEE SloPositionControl_CM_double 0 0 -1.7E+308 1.7E+308 ECU_ADDRESS 0x00218A38 /end MEASUREMENT
/begin MEASUREMENT SloPositionControl_B.TmpSignalConversionAtIDOutport1 "" FLOAT64_IEEE SloPositionControl_CM_double 0 0 -1.7E+308 1.7E+308 ECU_ADDRESS 0x002189E8 /end MEASUREMENT
/begin MEASUREMENT SloPositionControl_B.TmpSignalConversionAtcurrentI_n "" FLOAT64_IEEE SloPositionControl_CM_double 0 0 -1.7E+308 1.7E+308 ECU_ADDRESS 0x00218AD0 /end MEASUREMENT
/begin MEASUREMENT SloPositionControl_B.TmpSignalConversionAtcurrentInp "" FLOAT64_IEEE SloPositionControl_CM_double 0 0 -1.7E+308 1.7E+308 ECU_ADDRESS 0x00218A18 /end MEASUREMENT
/begin MEASUREMENT SloPositionControl_B.TmpSignalConversionAtpositionIn "" FLOAT64_IEEE SloPositionControl_CM_double 0 0 -1.7E+308 1.7E+308 ECU_ADDRESS 0x00218A20 /end MEASUREMENT
/begin MEASUREMENT SloPositionControl_B.TmpSignalConversionAtstatusIn_n "" UBYTE SloPositionControl_CM_uint8 0 0 0 255 ECU_ADDRESS 0x00218BBB /end MEASUREMENT
/begin MEASUREMENT SloPositionControl_B.TmpSignalConversionAtstatusInpo "" UBYTE SloPositionControl_CM_uint8 0 0 0 255 ECU_ADDRESS 0x00218BA2 /end MEASUREMENT
/begin MEASUREMENT SloPositionControl_B.TmpSignalConversionAtvelocityIn "" FLOAT64_IEEE SloPositionControl_CM_double 0 0 -1.7E+308 1.7E+308 ECU_ADDRESS 0x00218A28 /end MEASUREMENT
/begin MEASUREMENT SloPositionControl_B.V_out "" FLOAT64_IEEE SloPositionControl_CM_double 0 0 -1.7E+308 1.7E+308 ECU_ADDRESS 0x00218AE0 /end MEASUREMENT
/begin MEASUREMENT SloPositionControl_B.b "" UBYTE SloPositionControl_CM_uint8 0 0 0 255 LAYOUT COLUMN_DIR MATRIX_DIM 8 ECU_ADDRESS 0x00218BB3 /end MEASUREMENT
/begin MEASUREMENT SloPositionControl_B.position "" FLOAT64_IEEE SloPositionControl_CM_double 0 0 -1.7E+308 1.7E+308 ECU_ADDRESS 0x00218B78 /end MEASUREMENT
/begin MEASUREMENT SloPositionControl_B.sameC "" FLOAT64_IEEE SloPositionControl_CM_double 0 0 -1.7E+308 1.7E+308 ECU_ADDRESS 0x00218AC0 /end MEASUREMENT
/begin MEASUREMENT SloPositionControl_B.velocity "" FLOAT64_IEEE SloPositionControl_CM_double 0 0 -1.7E+308 1.7E+308 ECU_ADDRESS 0x00218B80 /end MEASUREMENT
/begin MEASUREMENT SloPositionControl_DW.CANUnpack_ModeSignalID "" SLONG SloPositionControl_CM_int_T 0 0 -2147483648 2147483647 ECU_ADDRESS 0x00218930 /end MEASUREMENT
/begin MEASUREMENT SloPositionControl_DW.CANUnpack_StatusPortID "" SLONG SloPositionControl_CM_int_T 0 0 -2147483648 2147483647 ECU_ADDRESS 0x00218934 /end MEASUREMENT
/begin MEASUREMENT SloPositionControl_DW.IfActionSubsystem_SubsysRanBC "" SBYTE SloPositionControl_CM_int8 0 0 -128 127 ECU_ADDRESS 0x0021893D /end MEASUREMENT
/begin MEASUREMENT SloPositionControl_DW.SimulinkFunction1_SubsysRanBC "" SBYTE SloPositionControl_CM_int8 0 0 -128 127 ECU_ADDRESS 0x0021893E /end MEASUREMENT
/begin MEASUREMENT SloPositionControl_DW.SimulinkFunction2_SubsysRanBC "" SBYTE SloPositionControl_CM_int8 0 0 -128 127 ECU_ADDRESS 0x0021893C /end MEASUREMENT
/begin MEASUREMENT SloPositionControl_DW.SimulinkFunction3_SubsysRanBC "" SBYTE SloPositionControl_CM_int8 0 0 -128 127 ECU_ADDRESS 0x0021893B /end MEASUREMENT
/begin MEASUREMENT SloPositionControl_DW.SimulinkFunction4_SubsysRanBC "" SBYTE SloPositionControl_CM_int8 0 0 -128 127 ECU_ADDRESS 0x0021893A /end MEASUREMENT
/begin MEASUREMENT SloPositionControl_DW.SimulinkFunction5_SubsysRanBC "" SBYTE SloPositionControl_CM_int8 0 0 -128 127 ECU_ADDRESS 0x00218939 /end MEASUREMENT
/begin MEASUREMENT SloPositionControl_DW.SimulinkFunction6_SubsysRanBC "" SBYTE SloPositionControl_CM_int8 0 0 -128 127 ECU_ADDRESS 0x00218938 /end MEASUREMENT
/begin COMPU_METHOD SloPositionControl_CM_double "" IDENTICAL "%15.10" "" /end COMPU_METHOD
/begin COMPU_METHOD SloPositionControl_CM_int8 "" IDENTICAL "%3.0" "" /end COMPU_METHOD
/begin COMPU_METHOD SloPositionControl_CM_int_T "" IDENTICAL "customformat" "" /end COMPU_METHOD
/begin COMPU_METHOD SloPositionControl_CM_logical "" IDENTICAL "%1.0" "" /end COMPU_METHOD
/begin COMPU_METHOD SloPositionControl_CM_uint8 "" IDENTICAL "%3.0" "" /end COMPU_METHOD
/begin RECORD_LAYOUT Scalar_BOOLEAN FNC_VALUES 1 UBYTE COLUMN_DIR DIRECT /end RECORD_LAYOUT
/begin RECORD_LAYOUT Scalar_FLOAT64_IEEE FNC_VALUES 1 FLOAT64_IEEE COLUMN_DIR DIRECT /end RECORD_LAYOUT
/begin RECORD_LAYOUT Scalar_SBYTE FNC_VALUES 1 SBYTE COLUMN_DIR DIRECT /end RECORD_LAYOUT
/begin RECORD_LAYOUT Scalar_SLONG FNC_VALUES 1 SLONG COLUMN_DIR DIRECT /end RECORD_LAYOUT
/begin RECORD_LAYOUT Scalar_UBYTE FNC_VALUES 1 UBYTE COLUMN_DIR DIRECT /end RECORD_LAYOUT
/begin GROUP SloPositionControl "SloPositionControl" ROOT /end GROUP
/end MODULE
/end PROJECT
