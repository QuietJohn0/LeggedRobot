/******************************************************************************
* ASAP2 file: callback_commands.a2l
* Academic License - for use in teaching, academic research, and meeting
* course requirements at degree granting institutions only. Not for
* government, commercial, or other organizational use.
* Code generation for model "callback_commands".
* Model version : 1.6
* Simulink Coder version : 10.3 R2021a
* C source code generated on : Fri Jul 30 16:33:53 2021
* Target selection: slrealtime.tlc
* Embedded hardware selection: Intel->x86-64 (Linux 64)
* Code generation objectives: Unspecified
* Validation result: Not run
* (add additional file header information here)
******************************************************************************/ ASAP2_VERSION 1 71
/begin PROJECT ProjectName "Project Comment Goes Here"
/begin HEADER "Header Comments go here" /end HEADER
/begin MODULE ModuleName "Module Comment Goes Here"
/begin IF_DATA XCP
 /begin PROTOCOL_LAYER 0x0100 0x03E8 0x00C8 0x0000 0x0000 0x0000 0x0000 0x0000 0xFC 0x0578 BYTE_ORDER_MSB_LAST ADDRESS_GRANULARITY_BYTE OPTIONAL_CMD ALLOC_ODT_ENTRY OPTIONAL_CMD ALLOC_ODT OPTIONAL_CMD ALLOC_DAQ OPTIONAL_CMD FREE_DAQ OPTIONAL_CMD GET_DAQ_RESOLUTION_INFO OPTIONAL_CMD GET_DAQ_PROCESSOR_INFO OPTIONAL_CMD START_STOP_SYNCH OPTIONAL_CMD START_STOP_DAQ_LIST OPTIONAL_CMD SET_DAQ_LIST_MODE OPTIONAL_CMD WRITE_DAQ OPTIONAL_CMD SET_DAQ_PTR OPTIONAL_CMD GET_CAL_PAGE OPTIONAL_CMD SET_CAL_PAGE OPTIONAL_CMD COPY_CAL_PAGE OPTIONAL_CMD SHORT_DOWNLOAD OPTIONAL_CMD DOWNLOAD_MAX OPTIONAL_CMD DOWNLOAD OPTIONAL_CMD SHORT_UPLOAD OPTIONAL_CMD UPLOAD OPTIONAL_CMD SET_MTA /end PROTOCOL_LAYER
 /begin DAQ DYNAMIC 0x0000 0x0080 0x00 OPTIMISATION_TYPE_DEFAULT ADDRESS_EXTENSION_FREE IDENTIFICATION_FIELD_TYPE_RELATIVE_WORD_ALIGNED GRANULARITY_ODT_ENTRY_SIZE_DAQ_BYTE 0xFF OVERLOAD_INDICATION_PID PRESCALER_SUPPORTED /begin STIM GRANULARITY_ODT_ENTRY_SIZE_STIM_BYTE 0xFF /end STIM /begin TIMESTAMP_SUPPORTED 0x0001 SIZE_DWORD UNIT_1US TIMESTAMP_FIXED /end TIMESTAMP_SUPPORTED /begin EVENT "20 ms" "20 ms" 0x0000 DAQ 0xFF 0x02 0x07 0x00 /end EVENT /end DAQ
 /begin XCP_ON_UDP_IP 0x0100 0x15B3 ADDRESS "192.168.7.5" /end XCP_ON_UDP_IP
/end IF_DATA
/begin MOD_PAR "MOD PAR Comment Goes Here"
 /begin MEMORY_SEGMENT callback_commands_cal_impl "callback_commands_cal_impl" DATA FLASH INTERN 0x00215020 0x538 -1 -1 -1 -1 -1
  /begin IF_DATA XCP
   /begin SEGMENT 0x00 0x02 0x00 0x00 0x00
    /begin PAGE 0x00 ECU_ACCESS_DONT_CARE XCP_READ_ACCESS_DONT_CARE XCP_WRITE_ACCESS_NOT_ALLOWED /end PAGE
    /begin PAGE 0x01 ECU_ACCESS_DONT_CARE XCP_READ_ACCESS_DONT_CARE XCP_WRITE_ACCESS_DONT_CARE /end PAGE
   /end SEGMENT
  /end IF_DATA
 /end MEMORY_SEGMENT
/end MOD_PAR
/begin MOD_COMMON "Mod Common Comment Here" BYTE_ORDER MSB_LAST ALIGNMENT_BYTE 1 ALIGNMENT_WORD 2 ALIGNMENT_LONG 8 ALIGNMENT_FLOAT32_IEEE 4 ALIGNMENT_FLOAT64_IEEE 8 ALIGNMENT_INT64 4 /end MOD_COMMON
/begin CHARACTERISTIC callback_commands_P.c "" VALUE 0x00215560 Scalar_FLOAT64_IEEE 0 callback_commands_CM_double -1.7E+308 1.7E+308 /end CHARACTERISTIC
/begin CHARACTERISTIC callback_commands_cal_impl.CANSetup_P1 "" VAL_BLK 0x00215030 Scalar_FLOAT64_IEEE 0 callback_commands_CM_double -1.7E+308 1.7E+308 MATRIX_DIM 40 1 /end CHARACTERISTIC
/begin CHARACTERISTIC callback_commands_cal_impl.CANSetup_P2 "" VALUE 0x00215180 Scalar_FLOAT64_IEEE 0 callback_commands_CM_double -1.7E+308 1.7E+308 /end CHARACTERISTIC
/begin CHARACTERISTIC callback_commands_cal_impl.CANSetup_P3 "" VALUE 0x00215198 Scalar_FLOAT64_IEEE 0 callback_commands_CM_double -1.7E+308 1.7E+308 /end CHARACTERISTIC
/begin CHARACTERISTIC callback_commands_cal_impl.CANStatus_P1 "" VALUE 0x00215220 Scalar_FLOAT64_IEEE 0 callback_commands_CM_double -1.7E+308 1.7E+308 /end CHARACTERISTIC
/begin CHARACTERISTIC callback_commands_cal_impl.CANStatus_P10 "" VALUE 0x002152F8 Scalar_FLOAT64_IEEE 0 callback_commands_CM_double -1.7E+308 1.7E+308 /end CHARACTERISTIC
/begin CHARACTERISTIC callback_commands_cal_impl.CANStatus_P11 "" VALUE 0x00215310 Scalar_FLOAT64_IEEE 0 callback_commands_CM_double -1.7E+308 1.7E+308 /end CHARACTERISTIC
/begin CHARACTERISTIC callback_commands_cal_impl.CANStatus_P12 "" VALUE 0x00215328 Scalar_FLOAT64_IEEE 0 callback_commands_CM_double -1.7E+308 1.7E+308 /end CHARACTERISTIC
/begin CHARACTERISTIC callback_commands_cal_impl.CANStatus_P13 "" VALUE 0x00215340 Scalar_FLOAT64_IEEE 0 callback_commands_CM_double -1.7E+308 1.7E+308 /end CHARACTERISTIC
/begin CHARACTERISTIC callback_commands_cal_impl.CANStatus_P14 "" VALUE 0x00215358 Scalar_FLOAT64_IEEE 0 callback_commands_CM_double -1.7E+308 1.7E+308 /end CHARACTERISTIC
/begin CHARACTERISTIC callback_commands_cal_impl.CANStatus_P15 "" VALUE 0x00215370 Scalar_FLOAT64_IEEE 0 callback_commands_CM_double -1.7E+308 1.7E+308 /end CHARACTERISTIC
/begin CHARACTERISTIC callback_commands_cal_impl.CANStatus_P16 "" VALUE 0x00215388 Scalar_FLOAT64_IEEE 0 callback_commands_CM_double -1.7E+308 1.7E+308 /end CHARACTERISTIC
/begin CHARACTERISTIC callback_commands_cal_impl.CANStatus_P17 "" VALUE 0x002153A0 Scalar_FLOAT64_IEEE 0 callback_commands_CM_double -1.7E+308 1.7E+308 /end CHARACTERISTIC
/begin CHARACTERISTIC callback_commands_cal_impl.CANStatus_P18 "" VALUE 0x002153B8 Scalar_FLOAT64_IEEE 0 callback_commands_CM_double -1.7E+308 1.7E+308 /end CHARACTERISTIC
/begin CHARACTERISTIC callback_commands_cal_impl.CANStatus_P19 "" VALUE 0x002153D0 Scalar_FLOAT64_IEEE 0 callback_commands_CM_double -1.7E+308 1.7E+308 /end CHARACTERISTIC
/begin CHARACTERISTIC callback_commands_cal_impl.CANStatus_P2 "" VALUE 0x00215238 Scalar_FLOAT64_IEEE 0 callback_commands_CM_double -1.7E+308 1.7E+308 /end CHARACTERISTIC
/begin CHARACTERISTIC callback_commands_cal_impl.CANStatus_P20 "" VALUE 0x002153E8 Scalar_FLOAT64_IEEE 0 callback_commands_CM_double -1.7E+308 1.7E+308 /end CHARACTERISTIC
/begin CHARACTERISTIC callback_commands_cal_impl.CANStatus_P21 "" VALUE 0x00215400 Scalar_FLOAT64_IEEE 0 callback_commands_CM_double -1.7E+308 1.7E+308 /end CHARACTERISTIC
/begin CHARACTERISTIC callback_commands_cal_impl.CANStatus_P22 "" VALUE 0x00215418 Scalar_FLOAT64_IEEE 0 callback_commands_CM_double -1.7E+308 1.7E+308 /end CHARACTERISTIC
/begin CHARACTERISTIC callback_commands_cal_impl.CANStatus_P23 "" VALUE 0x00215430 Scalar_FLOAT64_IEEE 0 callback_commands_CM_double -1.7E+308 1.7E+308 /end CHARACTERISTIC
/begin CHARACTERISTIC callback_commands_cal_impl.CANStatus_P24 "" VALUE 0x00215448 Scalar_FLOAT64_IEEE 0 callback_commands_CM_double -1.7E+308 1.7E+308 /end CHARACTERISTIC
/begin CHARACTERISTIC callback_commands_cal_impl.CANStatus_P25 "" VALUE 0x00215460 Scalar_FLOAT64_IEEE 0 callback_commands_CM_double -1.7E+308 1.7E+308 /end CHARACTERISTIC
/begin CHARACTERISTIC callback_commands_cal_impl.CANStatus_P26 "" VALUE 0x00215478 Scalar_FLOAT64_IEEE 0 callback_commands_CM_double -1.7E+308 1.7E+308 /end CHARACTERISTIC
/begin CHARACTERISTIC callback_commands_cal_impl.CANStatus_P27 "" VALUE 0x00215490 Scalar_FLOAT64_IEEE 0 callback_commands_CM_double -1.7E+308 1.7E+308 /end CHARACTERISTIC
/begin CHARACTERISTIC callback_commands_cal_impl.CANStatus_P28 "" VALUE 0x002154A8 Scalar_FLOAT64_IEEE 0 callback_commands_CM_double -1.7E+308 1.7E+308 /end CHARACTERISTIC
/begin CHARACTERISTIC callback_commands_cal_impl.CANStatus_P29 "" VALUE 0x002154C0 Scalar_FLOAT64_IEEE 0 callback_commands_CM_double -1.7E+308 1.7E+308 /end CHARACTERISTIC
/begin CHARACTERISTIC callback_commands_cal_impl.CANStatus_P3 "" VALUE 0x00215250 Scalar_FLOAT64_IEEE 0 callback_commands_CM_double -1.7E+308 1.7E+308 /end CHARACTERISTIC
/begin CHARACTERISTIC callback_commands_cal_impl.CANStatus_P30 "" VALUE 0x002154D8 Scalar_FLOAT64_IEEE 0 callback_commands_CM_double -1.7E+308 1.7E+308 /end CHARACTERISTIC
/begin CHARACTERISTIC callback_commands_cal_impl.CANStatus_P31 "" VALUE 0x002154F0 Scalar_FLOAT64_IEEE 0 callback_commands_CM_double -1.7E+308 1.7E+308 /end CHARACTERISTIC
/begin CHARACTERISTIC callback_commands_cal_impl.CANStatus_P32 "" VALUE 0x00215508 Scalar_FLOAT64_IEEE 0 callback_commands_CM_double -1.7E+308 1.7E+308 /end CHARACTERISTIC
/begin CHARACTERISTIC callback_commands_cal_impl.CANStatus_P33 "" VALUE 0x00215520 Scalar_FLOAT64_IEEE 0 callback_commands_CM_double -1.7E+308 1.7E+308 /end CHARACTERISTIC
/begin CHARACTERISTIC callback_commands_cal_impl.CANStatus_P34 "" VALUE 0x00215538 Scalar_FLOAT64_IEEE 0 callback_commands_CM_double -1.7E+308 1.7E+308 /end CHARACTERISTIC
/begin CHARACTERISTIC callback_commands_cal_impl.CANStatus_P4 "" VALUE 0x00215268 Scalar_FLOAT64_IEEE 0 callback_commands_CM_double -1.7E+308 1.7E+308 /end CHARACTERISTIC
/begin CHARACTERISTIC callback_commands_cal_impl.CANStatus_P5 "" VALUE 0x00215280 Scalar_FLOAT64_IEEE 0 callback_commands_CM_double -1.7E+308 1.7E+308 /end CHARACTERISTIC
/begin CHARACTERISTIC callback_commands_cal_impl.CANStatus_P6 "" VALUE 0x00215298 Scalar_FLOAT64_IEEE 0 callback_commands_CM_double -1.7E+308 1.7E+308 /end CHARACTERISTIC
/begin CHARACTERISTIC callback_commands_cal_impl.CANStatus_P7 "" VALUE 0x002152B0 Scalar_FLOAT64_IEEE 0 callback_commands_CM_double -1.7E+308 1.7E+308 /end CHARACTERISTIC
/begin CHARACTERISTIC callback_commands_cal_impl.CANStatus_P8 "" VALUE 0x002152C8 Scalar_FLOAT64_IEEE 0 callback_commands_CM_double -1.7E+308 1.7E+308 /end CHARACTERISTIC
/begin CHARACTERISTIC callback_commands_cal_impl.CANStatus_P9 "" VALUE 0x002152E0 Scalar_FLOAT64_IEEE 0 callback_commands_CM_double -1.7E+308 1.7E+308 /end CHARACTERISTIC
/begin CHARACTERISTIC callback_commands_cal_impl.CANWrite1_P1 "" VAL_BLK 0x002151D8 Scalar_FLOAT64_IEEE 0 callback_commands_CM_double -1.7E+308 1.7E+308 MATRIX_DIM 7 1 /end CHARACTERISTIC
/begin CHARACTERISTIC callback_commands_cal_impl.Constant1_Value "" VAL_BLK 0x00215548 Scalar_UBYTE 0 callback_commands_CM_uint8 0 255 MATRIX_DIM 8 1 /end CHARACTERISTIC
/begin CHARACTERISTIC callback_commands_cal_impl.Constant2_Value "" VAL_BLK 0x00215550 Scalar_UBYTE 0 callback_commands_CM_uint8 0 255 MATRIX_DIM 8 1 /end CHARACTERISTIC
/begin CHARACTERISTIC callback_commands_cal_impl.Constant4_Value "" VAL_BLK 0x002151A0 Scalar_FLOAT64_IEEE 0 callback_commands_CM_double -1.7E+308 1.7E+308 MATRIX_DIM 5 1 /end CHARACTERISTIC
/begin CHARACTERISTIC callback_commands_cal_impl.Constant_Value "" VAL_BLK 0x00215540 Scalar_UBYTE 0 callback_commands_CM_uint8 0 255 MATRIX_DIM 8 1 /end CHARACTERISTIC
/begin MEASUREMENT callback_commands_B.BytePacking "" UBYTE callback_commands_CM_uint8 0 0 0 255 LAYOUT COLUMN_DIR MATRIX_DIM 8 ECU_ADDRESS 0x002170A8 /end MEASUREMENT
/begin MEASUREMENT callback_commands_B.Constant4 "" FLOAT64_IEEE callback_commands_CM_double 0 0 -1.7E+308 1.7E+308 LAYOUT COLUMN_DIR MATRIX_DIM 5 ECU_ADDRESS 0x00217078 /end MEASUREMENT
/begin MEASUREMENT callback_commands_B.MultiportSwitch "" UBYTE callback_commands_CM_uint8 0 0 0 255 LAYOUT COLUMN_DIR MATRIX_DIM 8 ECU_ADDRESS 0x002170A0 /end MEASUREMENT
/begin MEASUREMENT callback_commands_B.b "" UBYTE callback_commands_CM_uint8 0 0 0 255 LAYOUT COLUMN_DIR MATRIX_DIM 8 ECU_ADDRESS 0x002170B0 /end MEASUREMENT
/begin COMPU_METHOD callback_commands_CM_double "" IDENTICAL "%15.10" "" /end COMPU_METHOD
/begin COMPU_METHOD callback_commands_CM_uint8 "" IDENTICAL "%3.0" "" /end COMPU_METHOD
/begin RECORD_LAYOUT Scalar_FLOAT64_IEEE FNC_VALUES 1 FLOAT64_IEEE COLUMN_DIR DIRECT /end RECORD_LAYOUT
/begin RECORD_LAYOUT Scalar_UBYTE FNC_VALUES 1 UBYTE COLUMN_DIR DIRECT /end RECORD_LAYOUT
/begin GROUP callback_commands "callback_commands" ROOT /end GROUP
/end MODULE
/end PROJECT
