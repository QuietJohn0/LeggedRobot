/******************************************************************************
* ASAP2 file: main_quad_rev2_21_120pm.a2l
* Academic License - for use in teaching, academic research, and meeting
* course requirements at degree granting institutions only. Not for
* government, commercial, or other organizational use.
* Code generation for model "main_quad_rev2_21_120pm".
* Model version : 1.48
* Simulink Coder version : 10.3 R2021a
* C source code generated on : Sat May 21 13:53:56 2022
* Target selection: slrealtime.tlc
* Embedded hardware selection: Intel->x86-64 (Linux 64)
* Code generation objectives: Unspecified
* Validation result: Not run
* (add additional file header information here)
******************************************************************************/ ASAP2_VERSION 1 71
/begin PROJECT ProjectName "Project Comment Goes Here"
/begin HEADER "Header Comments go here" /end HEADER
/begin MODULE ModuleName "Module Comment Goes Here"
/begin IF_DATA XCP
 /begin PROTOCOL_LAYER 0x0100 0x03E8 0x00C8 0x0000 0x0000 0x0000 0x0000 0x0000 0xFC 0x0578 BYTE_ORDER_MSB_LAST ADDRESS_GRANULARITY_BYTE OPTIONAL_CMD ALLOC_ODT_ENTRY OPTIONAL_CMD ALLOC_ODT OPTIONAL_CMD ALLOC_DAQ OPTIONAL_CMD FREE_DAQ OPTIONAL_CMD GET_DAQ_RESOLUTION_INFO OPTIONAL_CMD GET_DAQ_PROCESSOR_INFO OPTIONAL_CMD START_STOP_SYNCH OPTIONAL_CMD START_STOP_DAQ_LIST OPTIONAL_CMD SET_DAQ_LIST_MODE OPTIONAL_CMD WRITE_DAQ OPTIONAL_CMD SET_DAQ_PTR OPTIONAL_CMD GET_CAL_PAGE OPTIONAL_CMD SET_CAL_PAGE OPTIONAL_CMD COPY_CAL_PAGE OPTIONAL_CMD SHORT_DOWNLOAD OPTIONAL_CMD DOWNLOAD_MAX OPTIONAL_CMD DOWNLOAD OPTIONAL_CMD SHORT_UPLOAD OPTIONAL_CMD UPLOAD OPTIONAL_CMD SET_MTA /end PROTOCOL_LAYER
 /begin DAQ DYNAMIC 0x0000 0x0080 0x00 OPTIMISATION_TYPE_DEFAULT ADDRESS_EXTENSION_FREE IDENTIFICATION_FIELD_TYPE_RELATIVE_WORD_ALIGNED GRANULARITY_ODT_ENTRY_SIZE_DAQ_BYTE 0xFF OVERLOAD_INDICATION_PID PRESCALER_SUPPORTED /begin STIM GRANULARITY_ODT_ENTRY_SIZE_STIM_BYTE 0xFF /end STIM /begin TIMESTAMP_SUPPORTED 0x0001 SIZE_DWORD UNIT_1US TIMESTAMP_FIXED /end TIMESTAMP_SUPPORTED /begin EVENT "5 ms" "5 ms" 0x0000 DAQ 0xFF 0x05 0x06 0x00 /end EVENT /end DAQ
 /begin XCP_ON_UDP_IP 0x0100 0x15B3 ADDRESS "192.168.7.5" /end XCP_ON_UDP_IP
/end IF_DATA
/begin MOD_PAR "MOD PAR Comment Goes Here"
 /begin MEMORY_SEGMENT main_quad_rev2_21_120p_cal_impl "main_quad_rev2_21_120p_cal_impl" DATA FLASH INTERN 0x00217020 0x628 -1 -1 -1 -1 -1
  /begin IF_DATA XCP
   /begin SEGMENT 0x00 0x02 0x00 0x00 0x00
    /begin PAGE 0x00 ECU_ACCESS_DONT_CARE XCP_READ_ACCESS_DONT_CARE XCP_WRITE_ACCESS_NOT_ALLOWED /end PAGE
    /begin PAGE 0x01 ECU_ACCESS_DONT_CARE XCP_READ_ACCESS_DONT_CARE XCP_WRITE_ACCESS_DONT_CARE /end PAGE
   /end SEGMENT
  /end IF_DATA
 /end MEMORY_SEGMENT
/end MOD_PAR
/begin MOD_COMMON "Mod Common Comment Here" BYTE_ORDER MSB_LAST ALIGNMENT_BYTE 1 ALIGNMENT_WORD 2 ALIGNMENT_LONG 8 ALIGNMENT_FLOAT32_IEEE 4 ALIGNMENT_FLOAT64_IEEE 8 ALIGNMENT_INT64 4 /end MOD_COMMON
/begin CHARACTERISTIC main_quad_rev2_21_120p_cal_impl.CANRead_P1 "" VAL_BLK 0x00217100 Scalar_FLOAT64_IEEE 0 main_quad_rev2_21_120pm_CM_double -1.7E+308 1.7E+308 MATRIX_DIM 6 1 /end CHARACTERISTIC
/begin CHARACTERISTIC main_quad_rev2_21_120p_cal_impl.CANSetup_P1 "" VAL_BLK 0x00217148 Scalar_FLOAT64_IEEE 0 main_quad_rev2_21_120pm_CM_double -1.7E+308 1.7E+308 MATRIX_DIM 40 1 /end CHARACTERISTIC
/begin CHARACTERISTIC main_quad_rev2_21_120p_cal_impl.CANSetup_P2 "" VALUE 0x00217298 Scalar_FLOAT64_IEEE 0 main_quad_rev2_21_120pm_CM_double -1.7E+308 1.7E+308 /end CHARACTERISTIC
/begin CHARACTERISTIC main_quad_rev2_21_120p_cal_impl.CANSetup_P3 "" VALUE 0x002172B0 Scalar_FLOAT64_IEEE 0 main_quad_rev2_21_120pm_CM_double -1.7E+308 1.7E+308 /end CHARACTERISTIC
/begin CHARACTERISTIC main_quad_rev2_21_120p_cal_impl.CANStatus_P1 "" VALUE 0x002172F8 Scalar_FLOAT64_IEEE 0 main_quad_rev2_21_120pm_CM_double -1.7E+308 1.7E+308 /end CHARACTERISTIC
/begin CHARACTERISTIC main_quad_rev2_21_120p_cal_impl.CANStatus_P10 "" VALUE 0x002173D0 Scalar_FLOAT64_IEEE 0 main_quad_rev2_21_120pm_CM_double -1.7E+308 1.7E+308 /end CHARACTERISTIC
/begin CHARACTERISTIC main_quad_rev2_21_120p_cal_impl.CANStatus_P11 "" VALUE 0x002173E8 Scalar_FLOAT64_IEEE 0 main_quad_rev2_21_120pm_CM_double -1.7E+308 1.7E+308 /end CHARACTERISTIC
/begin CHARACTERISTIC main_quad_rev2_21_120p_cal_impl.CANStatus_P12 "" VALUE 0x00217400 Scalar_FLOAT64_IEEE 0 main_quad_rev2_21_120pm_CM_double -1.7E+308 1.7E+308 /end CHARACTERISTIC
/begin CHARACTERISTIC main_quad_rev2_21_120p_cal_impl.CANStatus_P13 "" VALUE 0x00217418 Scalar_FLOAT64_IEEE 0 main_quad_rev2_21_120pm_CM_double -1.7E+308 1.7E+308 /end CHARACTERISTIC
/begin CHARACTERISTIC main_quad_rev2_21_120p_cal_impl.CANStatus_P14 "" VALUE 0x00217430 Scalar_FLOAT64_IEEE 0 main_quad_rev2_21_120pm_CM_double -1.7E+308 1.7E+308 /end CHARACTERISTIC
/begin CHARACTERISTIC main_quad_rev2_21_120p_cal_impl.CANStatus_P15 "" VALUE 0x00217448 Scalar_FLOAT64_IEEE 0 main_quad_rev2_21_120pm_CM_double -1.7E+308 1.7E+308 /end CHARACTERISTIC
/begin CHARACTERISTIC main_quad_rev2_21_120p_cal_impl.CANStatus_P16 "" VALUE 0x00217460 Scalar_FLOAT64_IEEE 0 main_quad_rev2_21_120pm_CM_double -1.7E+308 1.7E+308 /end CHARACTERISTIC
/begin CHARACTERISTIC main_quad_rev2_21_120p_cal_impl.CANStatus_P17 "" VALUE 0x00217478 Scalar_FLOAT64_IEEE 0 main_quad_rev2_21_120pm_CM_double -1.7E+308 1.7E+308 /end CHARACTERISTIC
/begin CHARACTERISTIC main_quad_rev2_21_120p_cal_impl.CANStatus_P18 "" VALUE 0x00217490 Scalar_FLOAT64_IEEE 0 main_quad_rev2_21_120pm_CM_double -1.7E+308 1.7E+308 /end CHARACTERISTIC
/begin CHARACTERISTIC main_quad_rev2_21_120p_cal_impl.CANStatus_P19 "" VALUE 0x002174A8 Scalar_FLOAT64_IEEE 0 main_quad_rev2_21_120pm_CM_double -1.7E+308 1.7E+308 /end CHARACTERISTIC
/begin CHARACTERISTIC main_quad_rev2_21_120p_cal_impl.CANStatus_P2 "" VALUE 0x00217310 Scalar_FLOAT64_IEEE 0 main_quad_rev2_21_120pm_CM_double -1.7E+308 1.7E+308 /end CHARACTERISTIC
/begin CHARACTERISTIC main_quad_rev2_21_120p_cal_impl.CANStatus_P20 "" VALUE 0x002174C0 Scalar_FLOAT64_IEEE 0 main_quad_rev2_21_120pm_CM_double -1.7E+308 1.7E+308 /end CHARACTERISTIC
/begin CHARACTERISTIC main_quad_rev2_21_120p_cal_impl.CANStatus_P21 "" VALUE 0x002174D8 Scalar_FLOAT64_IEEE 0 main_quad_rev2_21_120pm_CM_double -1.7E+308 1.7E+308 /end CHARACTERISTIC
/begin CHARACTERISTIC main_quad_rev2_21_120p_cal_impl.CANStatus_P22 "" VALUE 0x002174F0 Scalar_FLOAT64_IEEE 0 main_quad_rev2_21_120pm_CM_double -1.7E+308 1.7E+308 /end CHARACTERISTIC
/begin CHARACTERISTIC main_quad_rev2_21_120p_cal_impl.CANStatus_P23 "" VALUE 0x00217508 Scalar_FLOAT64_IEEE 0 main_quad_rev2_21_120pm_CM_double -1.7E+308 1.7E+308 /end CHARACTERISTIC
/begin CHARACTERISTIC main_quad_rev2_21_120p_cal_impl.CANStatus_P24 "" VALUE 0x00217520 Scalar_FLOAT64_IEEE 0 main_quad_rev2_21_120pm_CM_double -1.7E+308 1.7E+308 /end CHARACTERISTIC
/begin CHARACTERISTIC main_quad_rev2_21_120p_cal_impl.CANStatus_P25 "" VALUE 0x00217538 Scalar_FLOAT64_IEEE 0 main_quad_rev2_21_120pm_CM_double -1.7E+308 1.7E+308 /end CHARACTERISTIC
/begin CHARACTERISTIC main_quad_rev2_21_120p_cal_impl.CANStatus_P26 "" VALUE 0x00217550 Scalar_FLOAT64_IEEE 0 main_quad_rev2_21_120pm_CM_double -1.7E+308 1.7E+308 /end CHARACTERISTIC
/begin CHARACTERISTIC main_quad_rev2_21_120p_cal_impl.CANStatus_P27 "" VALUE 0x00217568 Scalar_FLOAT64_IEEE 0 main_quad_rev2_21_120pm_CM_double -1.7E+308 1.7E+308 /end CHARACTERISTIC
/begin CHARACTERISTIC main_quad_rev2_21_120p_cal_impl.CANStatus_P28 "" VALUE 0x00217580 Scalar_FLOAT64_IEEE 0 main_quad_rev2_21_120pm_CM_double -1.7E+308 1.7E+308 /end CHARACTERISTIC
/begin CHARACTERISTIC main_quad_rev2_21_120p_cal_impl.CANStatus_P29 "" VALUE 0x00217598 Scalar_FLOAT64_IEEE 0 main_quad_rev2_21_120pm_CM_double -1.7E+308 1.7E+308 /end CHARACTERISTIC
/begin CHARACTERISTIC main_quad_rev2_21_120p_cal_impl.CANStatus_P3 "" VALUE 0x00217328 Scalar_FLOAT64_IEEE 0 main_quad_rev2_21_120pm_CM_double -1.7E+308 1.7E+308 /end CHARACTERISTIC
/begin CHARACTERISTIC main_quad_rev2_21_120p_cal_impl.CANStatus_P30 "" VALUE 0x002175B0 Scalar_FLOAT64_IEEE 0 main_quad_rev2_21_120pm_CM_double -1.7E+308 1.7E+308 /end CHARACTERISTIC
/begin CHARACTERISTIC main_quad_rev2_21_120p_cal_impl.CANStatus_P31 "" VALUE 0x002175C8 Scalar_FLOAT64_IEEE 0 main_quad_rev2_21_120pm_CM_double -1.7E+308 1.7E+308 /end CHARACTERISTIC
/begin CHARACTERISTIC main_quad_rev2_21_120p_cal_impl.CANStatus_P32 "" VALUE 0x002175E0 Scalar_FLOAT64_IEEE 0 main_quad_rev2_21_120pm_CM_double -1.7E+308 1.7E+308 /end CHARACTERISTIC
/begin CHARACTERISTIC main_quad_rev2_21_120p_cal_impl.CANStatus_P33 "" VALUE 0x002175F8 Scalar_FLOAT64_IEEE 0 main_quad_rev2_21_120pm_CM_double -1.7E+308 1.7E+308 /end CHARACTERISTIC
/begin CHARACTERISTIC main_quad_rev2_21_120p_cal_impl.CANStatus_P34 "" VALUE 0x00217610 Scalar_FLOAT64_IEEE 0 main_quad_rev2_21_120pm_CM_double -1.7E+308 1.7E+308 /end CHARACTERISTIC
/begin CHARACTERISTIC main_quad_rev2_21_120p_cal_impl.CANStatus_P4 "" VALUE 0x00217340 Scalar_FLOAT64_IEEE 0 main_quad_rev2_21_120pm_CM_double -1.7E+308 1.7E+308 /end CHARACTERISTIC
/begin CHARACTERISTIC main_quad_rev2_21_120p_cal_impl.CANStatus_P5 "" VALUE 0x00217358 Scalar_FLOAT64_IEEE 0 main_quad_rev2_21_120pm_CM_double -1.7E+308 1.7E+308 /end CHARACTERISTIC
/begin CHARACTERISTIC main_quad_rev2_21_120p_cal_impl.CANStatus_P6 "" VALUE 0x00217370 Scalar_FLOAT64_IEEE 0 main_quad_rev2_21_120pm_CM_double -1.7E+308 1.7E+308 /end CHARACTERISTIC
/begin CHARACTERISTIC main_quad_rev2_21_120p_cal_impl.CANStatus_P7 "" VALUE 0x00217388 Scalar_FLOAT64_IEEE 0 main_quad_rev2_21_120pm_CM_double -1.7E+308 1.7E+308 /end CHARACTERISTIC
/begin CHARACTERISTIC main_quad_rev2_21_120p_cal_impl.CANStatus_P8 "" VALUE 0x002173A0 Scalar_FLOAT64_IEEE 0 main_quad_rev2_21_120pm_CM_double -1.7E+308 1.7E+308 /end CHARACTERISTIC
/begin CHARACTERISTIC main_quad_rev2_21_120p_cal_impl.CANStatus_P9 "" VALUE 0x002173B8 Scalar_FLOAT64_IEEE 0 main_quad_rev2_21_120pm_CM_double -1.7E+308 1.7E+308 /end CHARACTERISTIC
/begin CHARACTERISTIC main_quad_rev2_21_120p_cal_impl.CANWrite1_P1 "" VAL_BLK 0x00217030 Scalar_FLOAT64_IEEE 0 main_quad_rev2_21_120pm_CM_double -1.7E+308 1.7E+308 MATRIX_DIM 7 1 /end CHARACTERISTIC
/begin CHARACTERISTIC main_quad_rev2_21_120p_cal_impl.CANWrite1_P1_j "" VAL_BLK 0x00217078 Scalar_FLOAT64_IEEE 0 main_quad_rev2_21_120pm_CM_double -1.7E+308 1.7E+308 MATRIX_DIM 7 1 /end CHARACTERISTIC
/begin CHARACTERISTIC main_quad_rev2_21_120p_cal_impl.Constant1_Value "" VAL_BLK 0x00217620 Scalar_UBYTE 0 main_quad_rev2_21_120pm_CM_uint8 0 255 MATRIX_DIM 8 1 /end CHARACTERISTIC
/begin CHARACTERISTIC main_quad_rev2_21_120p_cal_impl.Constant1_Value_e "" VAL_BLK 0x00217638 Scalar_UBYTE 0 main_quad_rev2_21_120pm_CM_uint8 0 255 MATRIX_DIM 8 1 /end CHARACTERISTIC
/begin CHARACTERISTIC main_quad_rev2_21_120p_cal_impl.Constant2_Value "" VALUE 0x002172E0 Scalar_FLOAT64_IEEE 0 main_quad_rev2_21_120pm_CM_double -1.7E+308 1.7E+308 /end CHARACTERISTIC
/begin CHARACTERISTIC main_quad_rev2_21_120p_cal_impl.Constant2_Value_g "" VAL_BLK 0x00217628 Scalar_UBYTE 0 main_quad_rev2_21_120pm_CM_uint8 0 255 MATRIX_DIM 8 1 /end CHARACTERISTIC
/begin CHARACTERISTIC main_quad_rev2_21_120p_cal_impl.Constant2_Value_k "" VAL_BLK 0x00217640 Scalar_UBYTE 0 main_quad_rev2_21_120pm_CM_uint8 0 255 MATRIX_DIM 8 1 /end CHARACTERISTIC
/begin CHARACTERISTIC main_quad_rev2_21_120p_cal_impl.Constant8_Value "" VALUE 0x002172D8 Scalar_FLOAT64_IEEE 0 main_quad_rev2_21_120pm_CM_double -1.7E+308 1.7E+308 /end CHARACTERISTIC
/begin CHARACTERISTIC main_quad_rev2_21_120p_cal_impl.Constant_Value "" VALUE 0x002172C8 Scalar_FLOAT64_IEEE 0 main_quad_rev2_21_120pm_CM_double -1.7E+308 1.7E+308 /end CHARACTERISTIC
/begin CHARACTERISTIC main_quad_rev2_21_120p_cal_impl.Constant_Value_i "" VAL_BLK 0x00217630 Scalar_UBYTE 0 main_quad_rev2_21_120pm_CM_uint8 0 255 MATRIX_DIM 8 1 /end CHARACTERISTIC
/begin CHARACTERISTIC main_quad_rev2_21_120p_cal_impl.Constant_Value_l "" VAL_BLK 0x00217618 Scalar_UBYTE 0 main_quad_rev2_21_120pm_CM_uint8 0 255 MATRIX_DIM 8 1 /end CHARACTERISTIC
/begin CHARACTERISTIC main_quad_rev2_21_120p_cal_impl.Curr1_Y0 "" VALUE 0x002170C0 Scalar_FLOAT64_IEEE 0 main_quad_rev2_21_120pm_CM_double -1.7E+308 1.7E+308 /end CHARACTERISTIC
/begin CHARACTERISTIC main_quad_rev2_21_120p_cal_impl.Curr2_Y0 "" VALUE 0x002170E0 Scalar_FLOAT64_IEEE 0 main_quad_rev2_21_120pm_CM_double -1.7E+308 1.7E+308 /end CHARACTERISTIC
/begin CHARACTERISTIC main_quad_rev2_21_120p_cal_impl.Delay1_InitialCondition "" VALUE 0x002172C0 Scalar_FLOAT64_IEEE 0 main_quad_rev2_21_120pm_CM_double -1.7E+308 1.7E+308 /end CHARACTERISTIC
/begin CHARACTERISTIC main_quad_rev2_21_120p_cal_impl.Delay_InitialCondition "" VALUE 0x002172B8 Scalar_FLOAT64_IEEE 0 main_quad_rev2_21_120pm_CM_double -1.7E+308 1.7E+308 /end CHARACTERISTIC
/begin CHARACTERISTIC main_quad_rev2_21_120p_cal_impl.Gain_Gain "" VALUE 0x00217130 Scalar_FLOAT64_IEEE 0 main_quad_rev2_21_120pm_CM_double -1.7E+308 1.7E+308 /end CHARACTERISTIC
/begin CHARACTERISTIC main_quad_rev2_21_120p_cal_impl.Gain_Gain_j "" VALUE 0x002172D0 Scalar_FLOAT64_IEEE 0 main_quad_rev2_21_120pm_CM_double -1.7E+308 1.7E+308 /end CHARACTERISTIC
/begin CHARACTERISTIC main_quad_rev2_21_120p_cal_impl.ID1_Y0 "" VALUE 0x002170C8 Scalar_FLOAT64_IEEE 0 main_quad_rev2_21_120pm_CM_double -1.7E+308 1.7E+308 /end CHARACTERISTIC
/begin CHARACTERISTIC main_quad_rev2_21_120p_cal_impl.ID2_Y0 "" VALUE 0x002170E8 Scalar_FLOAT64_IEEE 0 main_quad_rev2_21_120pm_CM_double -1.7E+308 1.7E+308 /end CHARACTERISTIC
/begin CHARACTERISTIC main_quad_rev2_21_120p_cal_impl.P1_Y0 "" VALUE 0x002170B0 Scalar_FLOAT64_IEEE 0 main_quad_rev2_21_120pm_CM_double -1.7E+308 1.7E+308 /end CHARACTERISTIC
/begin CHARACTERISTIC main_quad_rev2_21_120p_cal_impl.P2_Y0 "" VALUE 0x002170D0 Scalar_FLOAT64_IEEE 0 main_quad_rev2_21_120pm_CM_double -1.7E+308 1.7E+308 /end CHARACTERISTIC
/begin CHARACTERISTIC main_quad_rev2_21_120p_cal_impl.V1_Y0 "" VALUE 0x002170B8 Scalar_FLOAT64_IEEE 0 main_quad_rev2_21_120pm_CM_double -1.7E+308 1.7E+308 /end CHARACTERISTIC
/begin CHARACTERISTIC main_quad_rev2_21_120p_cal_impl.V2_Y0 "" VALUE 0x002170D8 Scalar_FLOAT64_IEEE 0 main_quad_rev2_21_120pm_CM_double -1.7E+308 1.7E+308 /end CHARACTERISTIC
/begin MEASUREMENT main_quad_rev2_21_120pm_B.BytePacking "" UBYTE main_quad_rev2_21_120pm_CM_uint8 0 0 0 255 LAYOUT COLUMN_DIR MATRIX_DIM 8 ECU_ADDRESS 0x0021A3AE /end MEASUREMENT
/begin MEASUREMENT main_quad_rev2_21_120pm_B.BytePacking_o "" UBYTE main_quad_rev2_21_120pm_CM_uint8 0 0 0 255 LAYOUT COLUMN_DIR MATRIX_DIM 8 ECU_ADDRESS 0x0021A3BE /end MEASUREMENT
/begin MEASUREMENT main_quad_rev2_21_120pm_B.CANRead_o1 "" UBYTE main_quad_rev2_21_120pm_CM_logical 0 0 0 1 ECU_ADDRESS 0x0021A3C6 /end MEASUREMENT
/begin MEASUREMENT main_quad_rev2_21_120pm_B.CANUnpack_o1 "" FLOAT64_IEEE main_quad_rev2_21_120pm_CM_double 0 0 -1.7E+308 1.7E+308 ECU_ADDRESS 0x0021A2A8 /end MEASUREMENT
/begin MEASUREMENT main_quad_rev2_21_120pm_B.CANUnpack_o1_f "" FLOAT64_IEEE main_quad_rev2_21_120pm_CM_double 0 0 -1.7E+308 1.7E+308 ECU_ADDRESS 0x0021A2E0 /end MEASUREMENT
/begin MEASUREMENT main_quad_rev2_21_120pm_B.CANUnpack_o2 "" FLOAT64_IEEE main_quad_rev2_21_120pm_CM_double 0 0 -1.7E+308 1.7E+308 ECU_ADDRESS 0x0021A2B0 /end MEASUREMENT
/begin MEASUREMENT main_quad_rev2_21_120pm_B.CANUnpack_o2_l "" FLOAT64_IEEE main_quad_rev2_21_120pm_CM_double 0 0 -1.7E+308 1.7E+308 ECU_ADDRESS 0x0021A2E8 /end MEASUREMENT
/begin MEASUREMENT main_quad_rev2_21_120pm_B.CANUnpack_o3 "" FLOAT64_IEEE main_quad_rev2_21_120pm_CM_double 0 0 -1.7E+308 1.7E+308 ECU_ADDRESS 0x0021A2B8 /end MEASUREMENT
/begin MEASUREMENT main_quad_rev2_21_120pm_B.CANUnpack_o3_k "" FLOAT64_IEEE main_quad_rev2_21_120pm_CM_double 0 0 -1.7E+308 1.7E+308 ECU_ADDRESS 0x0021A2F0 /end MEASUREMENT
/begin MEASUREMENT main_quad_rev2_21_120pm_B.CANUnpack_o4 "" FLOAT64_IEEE main_quad_rev2_21_120pm_CM_double 0 0 -1.7E+308 1.7E+308 ECU_ADDRESS 0x0021A2C0 /end MEASUREMENT
/begin MEASUREMENT main_quad_rev2_21_120pm_B.CANUnpack_o4_i "" FLOAT64_IEEE main_quad_rev2_21_120pm_CM_double 0 0 -1.7E+308 1.7E+308 ECU_ADDRESS 0x0021A2F8 /end MEASUREMENT
/begin MEASUREMENT main_quad_rev2_21_120pm_B.CANUnpack_o5 "" UBYTE main_quad_rev2_21_120pm_CM_uint8 0 0 0 255 ECU_ADDRESS 0x0021A3A4 /end MEASUREMENT
/begin MEASUREMENT main_quad_rev2_21_120pm_B.CANUnpack_o5_p "" UBYTE main_quad_rev2_21_120pm_CM_uint8 0 0 0 255 ECU_ADDRESS 0x0021A3A5 /end MEASUREMENT
/begin MEASUREMENT main_quad_rev2_21_120pm_B.Clock "" FLOAT64_IEEE main_quad_rev2_21_120pm_CM_double 0 0 -1.7E+308 1.7E+308 ECU_ADDRESS 0x0021A298 /end MEASUREMENT
/begin MEASUREMENT main_quad_rev2_21_120pm_B.Constant "" FLOAT64_IEEE main_quad_rev2_21_120pm_CM_double 0 0 -1.7E+308 1.7E+308 ECU_ADDRESS 0x0021A278 /end MEASUREMENT
/begin MEASUREMENT main_quad_rev2_21_120pm_B.Constant2 "" FLOAT64_IEEE main_quad_rev2_21_120pm_CM_double 0 0 -1.7E+308 1.7E+308 ECU_ADDRESS 0x0021A290 /end MEASUREMENT
/begin MEASUREMENT main_quad_rev2_21_120pm_B.Constant8 "" FLOAT64_IEEE main_quad_rev2_21_120pm_CM_double 0 0 -1.7E+308 1.7E+308 ECU_ADDRESS 0x0021A288 /end MEASUREMENT
/begin MEASUREMENT main_quad_rev2_21_120pm_B.Delay "" FLOAT64_IEEE main_quad_rev2_21_120pm_CM_double 0 0 -1.7E+308 1.7E+308 ECU_ADDRESS 0x0021A268 /end MEASUREMENT
/begin MEASUREMENT main_quad_rev2_21_120pm_B.Delay1 "" FLOAT64_IEEE main_quad_rev2_21_120pm_CM_double 0 0 -1.7E+308 1.7E+308 ECU_ADDRESS 0x0021A270 /end MEASUREMENT
/begin MEASUREMENT main_quad_rev2_21_120pm_B.GRF "" FLOAT64_IEEE main_quad_rev2_21_120pm_CM_double 0 0 -1.7E+308 1.7E+308 ECU_ADDRESS 0x0021A398 /end MEASUREMENT
/begin MEASUREMENT main_quad_rev2_21_120pm_B.Gain "" FLOAT64_IEEE main_quad_rev2_21_120pm_CM_double 0 0 -1.7E+308 1.7E+308 ECU_ADDRESS 0x0021A280 /end MEASUREMENT
/begin MEASUREMENT main_quad_rev2_21_120pm_B.Gain_m "" FLOAT64_IEEE main_quad_rev2_21_120pm_CM_double 0 0 -1.7E+308 1.7E+308 ECU_ADDRESS 0x0021A2A0 /end MEASUREMENT
/begin MEASUREMENT main_quad_rev2_21_120pm_B.I_ff "" FLOAT64_IEEE main_quad_rev2_21_120pm_CM_double 0 0 -1.7E+308 1.7E+308 ECU_ADDRESS 0x0021A2D8 /end MEASUREMENT
/begin MEASUREMENT main_quad_rev2_21_120pm_B.I_ff_o "" FLOAT64_IEEE main_quad_rev2_21_120pm_CM_double 0 0 -1.7E+308 1.7E+308 ECU_ADDRESS 0x0021A310 /end MEASUREMENT
/begin MEASUREMENT main_quad_rev2_21_120pm_B.Kd1 "" FLOAT64_IEEE main_quad_rev2_21_120pm_CM_double 0 0 -1.7E+308 1.7E+308 ECU_ADDRESS 0x0021A370 /end MEASUREMENT
/begin MEASUREMENT main_quad_rev2_21_120pm_B.Kd2 "" FLOAT64_IEEE main_quad_rev2_21_120pm_CM_double 0 0 -1.7E+308 1.7E+308 ECU_ADDRESS 0x0021A378 /end MEASUREMENT
/begin MEASUREMENT main_quad_rev2_21_120pm_B.Kp1 "" FLOAT64_IEEE main_quad_rev2_21_120pm_CM_double 0 0 -1.7E+308 1.7E+308 ECU_ADDRESS 0x0021A360 /end MEASUREMENT
/begin MEASUREMENT main_quad_rev2_21_120pm_B.Kp2 "" FLOAT64_IEEE main_quad_rev2_21_120pm_CM_double 0 0 -1.7E+308 1.7E+308 ECU_ADDRESS 0x0021A368 /end MEASUREMENT
/begin MEASUREMENT main_quad_rev2_21_120pm_B.MultiportSwitch "" UBYTE main_quad_rev2_21_120pm_CM_uint8 0 0 0 255 LAYOUT COLUMN_DIR MATRIX_DIM 8 ECU_ADDRESS 0x0021A3A6 /end MEASUREMENT
/begin MEASUREMENT main_quad_rev2_21_120pm_B.MultiportSwitch_f "" UBYTE main_quad_rev2_21_120pm_CM_uint8 0 0 0 255 LAYOUT COLUMN_DIR MATRIX_DIM 8 ECU_ADDRESS 0x0021A3B6 /end MEASUREMENT
/begin MEASUREMENT main_quad_rev2_21_120pm_B.T1 "" FLOAT64_IEEE main_quad_rev2_21_120pm_CM_double 0 0 -1.7E+308 1.7E+308 ECU_ADDRESS 0x0021A350 /end MEASUREMENT
/begin MEASUREMENT main_quad_rev2_21_120pm_B.T2 "" FLOAT64_IEEE main_quad_rev2_21_120pm_CM_double 0 0 -1.7E+308 1.7E+308 ECU_ADDRESS 0x0021A358 /end MEASUREMENT
/begin MEASUREMENT main_quad_rev2_21_120pm_B.Tcalc1 "" FLOAT64_IEEE main_quad_rev2_21_120pm_CM_double 0 0 -1.7E+308 1.7E+308 ECU_ADDRESS 0x0021A380 /end MEASUREMENT
/begin MEASUREMENT main_quad_rev2_21_120pm_B.Tcalc2 "" FLOAT64_IEEE main_quad_rev2_21_120pm_CM_double 0 0 -1.7E+308 1.7E+308 ECU_ADDRESS 0x0021A388 /end MEASUREMENT
/begin MEASUREMENT main_quad_rev2_21_120pm_B.TmpSignalConversionAtSFunctionI "" FLOAT64_IEEE main_quad_rev2_21_120pm_CM_double 0 0 -1.7E+308 1.7E+308 LAYOUT COLUMN_DIR MATRIX_DIM 2 ECU_ADDRESS 0x0021A318 /end MEASUREMENT
/begin MEASUREMENT main_quad_rev2_21_120pm_B.WhileIterator "" SLONG main_quad_rev2_21_120pm_CM_int32 0 0 -2147483648 2147483647 ECU_ADDRESS 0x0021A3A0 /end MEASUREMENT
/begin MEASUREMENT main_quad_rev2_21_120pm_B.c "" FLOAT64_IEEE main_quad_rev2_21_120pm_CM_double 0 0 -1.7E+308 1.7E+308 ECU_ADDRESS 0x0021A348 /end MEASUREMENT
/begin MEASUREMENT main_quad_rev2_21_120pm_B.calcForceX "" FLOAT64_IEEE main_quad_rev2_21_120pm_CM_double 0 0 -1.7E+308 1.7E+308 ECU_ADDRESS 0x0021A390 /end MEASUREMENT
/begin MEASUREMENT main_quad_rev2_21_120pm_B.danger "" FLOAT64_IEEE main_quad_rev2_21_120pm_CM_double 0 0 -1.7E+308 1.7E+308 ECU_ADDRESS 0x0021A328 /end MEASUREMENT
/begin MEASUREMENT main_quad_rev2_21_120pm_B.position "" FLOAT64_IEEE main_quad_rev2_21_120pm_CM_double 0 0 -1.7E+308 1.7E+308 ECU_ADDRESS 0x0021A2C8 /end MEASUREMENT
/begin MEASUREMENT main_quad_rev2_21_120pm_B.position_j "" FLOAT64_IEEE main_quad_rev2_21_120pm_CM_double 0 0 -1.7E+308 1.7E+308 ECU_ADDRESS 0x0021A300 /end MEASUREMENT
/begin MEASUREMENT main_quad_rev2_21_120pm_B.sf_floatsbytes.b "" UBYTE main_quad_rev2_21_120pm_CM_uint8 0 0 0 255 LAYOUT COLUMN_DIR MATRIX_DIM 8 ECU_ADDRESS 0x0021A3CF /end MEASUREMENT
/begin MEASUREMENT main_quad_rev2_21_120pm_B.sf_floatsbytes_o.b "" UBYTE main_quad_rev2_21_120pm_CM_uint8 0 0 0 255 LAYOUT COLUMN_DIR MATRIX_DIM 8 ECU_ADDRESS 0x0021A3C7 /end MEASUREMENT
/begin MEASUREMENT main_quad_rev2_21_120pm_B.stop "" FLOAT64_IEEE main_quad_rev2_21_120pm_CM_double 0 0 -1.7E+308 1.7E+308 ECU_ADDRESS 0x0021A330 /end MEASUREMENT
/begin MEASUREMENT main_quad_rev2_21_120pm_B.theta1 "" FLOAT64_IEEE main_quad_rev2_21_120pm_CM_double 0 0 -1.7E+308 1.7E+308 ECU_ADDRESS 0x0021A338 /end MEASUREMENT
/begin MEASUREMENT main_quad_rev2_21_120pm_B.theta2 "" FLOAT64_IEEE main_quad_rev2_21_120pm_CM_double 0 0 -1.7E+308 1.7E+308 ECU_ADDRESS 0x0021A340 /end MEASUREMENT
/begin MEASUREMENT main_quad_rev2_21_120pm_B.velocity "" FLOAT64_IEEE main_quad_rev2_21_120pm_CM_double 0 0 -1.7E+308 1.7E+308 ECU_ADDRESS 0x0021A2D0 /end MEASUREMENT
/begin MEASUREMENT main_quad_rev2_21_120pm_B.velocity_h "" FLOAT64_IEEE main_quad_rev2_21_120pm_CM_double 0 0 -1.7E+308 1.7E+308 ECU_ADDRESS 0x0021A308 /end MEASUREMENT
/begin MEASUREMENT main_quad_rev2_21_120pm_DW.CANUnpack_ModeSignalID "" SLONG main_quad_rev2_21_120pm_CM_int_T 0 0 -2147483648 2147483647 ECU_ADDRESS 0x0021A1E4 /end MEASUREMENT
/begin MEASUREMENT main_quad_rev2_21_120pm_DW.CANUnpack_ModeSignalID_d "" SLONG main_quad_rev2_21_120pm_CM_int_T 0 0 -2147483648 2147483647 ECU_ADDRESS 0x0021A1EC /end MEASUREMENT
/begin MEASUREMENT main_quad_rev2_21_120pm_DW.CANUnpack_StatusPortID "" SLONG main_quad_rev2_21_120pm_CM_int_T 0 0 -2147483648 2147483647 ECU_ADDRESS 0x0021A1E8 /end MEASUREMENT
/begin MEASUREMENT main_quad_rev2_21_120pm_DW.CANUnpack_StatusPortID_f "" SLONG main_quad_rev2_21_120pm_CM_int_T 0 0 -2147483648 2147483647 ECU_ADDRESS 0x0021A1F0 /end MEASUREMENT
/begin MEASUREMENT main_quad_rev2_21_120pm_DW.Delay1_DSTATE "" FLOAT64_IEEE main_quad_rev2_21_120pm_CM_double 0 0 -1.7E+308 1.7E+308 ECU_ADDRESS 0x00219FC8 /end MEASUREMENT
/begin MEASUREMENT main_quad_rev2_21_120pm_DW.Delay_DSTATE "" FLOAT64_IEEE main_quad_rev2_21_120pm_CM_double 0 0 -1.7E+308 1.7E+308 ECU_ADDRESS 0x00219FC0 /end MEASUREMENT
/begin MEASUREMENT main_quad_rev2_21_120pm_DW.Th2Th1 "" FLOAT64_IEEE main_quad_rev2_21_120pm_CM_double 0 0 -1.7E+308 1.7E+308 ECU_ADDRESS 0x0021A010 /end MEASUREMENT
/begin MEASUREMENT main_quad_rev2_21_120pm_DW.done "" FLOAT64_IEEE main_quad_rev2_21_120pm_CM_double 0 0 -1.7E+308 1.7E+308 ECU_ADDRESS 0x00219FD0 /end MEASUREMENT
/begin MEASUREMENT main_quad_rev2_21_120pm_DW.is_Command "" ULONG main_quad_rev2_21_120pm_CM_uint32 0 0 0 2147483646 ECU_ADDRESS 0x0021A158 /end MEASUREMENT
/begin MEASUREMENT main_quad_rev2_21_120pm_DW.is_active_c8_main_quad_rev2_21_ "" UBYTE main_quad_rev2_21_120pm_CM_uint8 0 0 0 255 ECU_ADDRESS 0x0021A206 /end MEASUREMENT
/begin MEASUREMENT main_quad_rev2_21_120pm_DW.is_c8_main_quad_rev2_21_120pm "" ULONG main_quad_rev2_21_120pm_CM_uint32 0 0 0 2147483646 ECU_ADDRESS 0x0021A154 /end MEASUREMENT
/begin MEASUREMENT main_quad_rev2_21_120pm_DW.pf "" FLOAT64_IEEE main_quad_rev2_21_120pm_CM_double 0 0 -1.7E+308 1.7E+308 ECU_ADDRESS 0x00219FD8 /end MEASUREMENT
/begin MEASUREMENT main_quad_rev2_21_120pm_DW.po1 "" FLOAT64_IEEE main_quad_rev2_21_120pm_CM_double 0 0 -1.7E+308 1.7E+308 ECU_ADDRESS 0x00219FF0 /end MEASUREMENT
/begin MEASUREMENT main_quad_rev2_21_120pm_DW.po2 "" FLOAT64_IEEE main_quad_rev2_21_120pm_CM_double 0 0 -1.7E+308 1.7E+308 ECU_ADDRESS 0x00219FF8 /end MEASUREMENT
/begin MEASUREMENT main_quad_rev2_21_120pm_DW.sfEvent "" SLONG main_quad_rev2_21_120pm_CM_int32 0 0 -2147483648 2147483647 ECU_ADDRESS 0x0021A150 /end MEASUREMENT
/begin MEASUREMENT main_quad_rev2_21_120pm_DW.slope1 "" FLOAT64_IEEE main_quad_rev2_21_120pm_CM_double 0 0 -1.7E+308 1.7E+308 ECU_ADDRESS 0x0021A000 /end MEASUREMENT
/begin MEASUREMENT main_quad_rev2_21_120pm_DW.slope2 "" FLOAT64_IEEE main_quad_rev2_21_120pm_CM_double 0 0 -1.7E+308 1.7E+308 ECU_ADDRESS 0x0021A008 /end MEASUREMENT
/begin MEASUREMENT main_quad_rev2_21_120pm_DW.temporalCounter_i1 "" UWORD main_quad_rev2_21_120pm_CM_uint16 0 0 0 65535 ECU_ADDRESS 0x0021A204 /end MEASUREMENT
/begin MEASUREMENT main_quad_rev2_21_120pm_DW.to "" FLOAT64_IEEE main_quad_rev2_21_120pm_CM_double 0 0 -1.7E+308 1.7E+308 ECU_ADDRESS 0x00219FE8 /end MEASUREMENT
/begin MEASUREMENT main_quad_rev2_21_120pm_DW.tstep "" FLOAT64_IEEE main_quad_rev2_21_120pm_CM_double 0 0 -1.7E+308 1.7E+308 ECU_ADDRESS 0x00219FE0 /end MEASUREMENT
/begin COMPU_METHOD main_quad_rev2_21_120pm_CM_double "" IDENTICAL "%15.10" "" /end COMPU_METHOD
/begin COMPU_METHOD main_quad_rev2_21_120pm_CM_int32 "" IDENTICAL "%10.0" "" /end COMPU_METHOD
/begin COMPU_METHOD main_quad_rev2_21_120pm_CM_int_T "" IDENTICAL "customformat" "" /end COMPU_METHOD
/begin COMPU_METHOD main_quad_rev2_21_120pm_CM_logical "" IDENTICAL "%1.0" "" /end COMPU_METHOD
/begin COMPU_METHOD main_quad_rev2_21_120pm_CM_uint16 "" IDENTICAL "%5.0" "" /end COMPU_METHOD
/begin COMPU_METHOD main_quad_rev2_21_120pm_CM_uint32 "" IDENTICAL "%10.0" "" /end COMPU_METHOD
/begin COMPU_METHOD main_quad_rev2_21_120pm_CM_uint8 "" IDENTICAL "%3.0" "" /end COMPU_METHOD
/begin RECORD_LAYOUT Scalar_BOOLEAN FNC_VALUES 1 UBYTE COLUMN_DIR DIRECT /end RECORD_LAYOUT
/begin RECORD_LAYOUT Scalar_FLOAT64_IEEE FNC_VALUES 1 FLOAT64_IEEE COLUMN_DIR DIRECT /end RECORD_LAYOUT
/begin RECORD_LAYOUT Scalar_SLONG FNC_VALUES 1 SLONG COLUMN_DIR DIRECT /end RECORD_LAYOUT
/begin RECORD_LAYOUT Scalar_UBYTE FNC_VALUES 1 UBYTE COLUMN_DIR DIRECT /end RECORD_LAYOUT
/begin RECORD_LAYOUT Scalar_ULONG FNC_VALUES 1 ULONG COLUMN_DIR DIRECT /end RECORD_LAYOUT
/begin RECORD_LAYOUT Scalar_UWORD FNC_VALUES 1 UWORD COLUMN_DIR DIRECT /end RECORD_LAYOUT
/begin GROUP main_quad_rev2_21_120pm "main_quad_rev2_21_120pm" ROOT /end GROUP
/end MODULE
/end PROJECT
