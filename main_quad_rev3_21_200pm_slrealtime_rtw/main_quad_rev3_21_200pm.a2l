/******************************************************************************
* ASAP2 file: main_quad_rev3_21_200pm.a2l
* Academic License - for use in teaching, academic research, and meeting
* course requirements at degree granting institutions only. Not for
* government, commercial, or other organizational use.
* Code generation for model "main_quad_rev3_21_200pm".
* Model version : 1.50
* Simulink Coder version : 10.3 R2021a
* C source code generated on : Sat May 21 15:52:14 2022
* Target selection: slrealtime.tlc
* Embedded hardware selection: Intel->x86-64 (Linux 64)
* Code generation objectives: Unspecified
* Validation result: Not run
* (add additional file header information here)
******************************************************************************/ ASAP2_VERSION 1 71
/begin PROJECT ProjectName "Project Comment Goes Here"
/begin HEADER "Header Comments go here" /end HEADER
/begin MODULE ModuleName "Module Comment Goes Here"
/begin IF_DATA XCP
 /begin PROTOCOL_LAYER 0x0100 0x03E8 0x00C8 0x0000 0x0000 0x0000 0x0000 0x0000 0xFC 0x0578 BYTE_ORDER_MSB_LAST ADDRESS_GRANULARITY_BYTE OPTIONAL_CMD ALLOC_ODT_ENTRY OPTIONAL_CMD ALLOC_ODT OPTIONAL_CMD ALLOC_DAQ OPTIONAL_CMD FREE_DAQ OPTIONAL_CMD GET_DAQ_RESOLUTION_INFO OPTIONAL_CMD GET_DAQ_PROCESSOR_INFO OPTIONAL_CMD START_STOP_SYNCH OPTIONAL_CMD START_STOP_DAQ_LIST OPTIONAL_CMD SET_DAQ_LIST_MODE OPTIONAL_CMD WRITE_DAQ OPTIONAL_CMD SET_DAQ_PTR OPTIONAL_CMD GET_CAL_PAGE OPTIONAL_CMD SET_CAL_PAGE OPTIONAL_CMD COPY_CAL_PAGE OPTIONAL_CMD SHORT_DOWNLOAD OPTIONAL_CMD DOWNLOAD_MAX OPTIONAL_CMD DOWNLOAD OPTIONAL_CMD SHORT_UPLOAD OPTIONAL_CMD UPLOAD OPTIONAL_CMD SET_MTA /end PROTOCOL_LAYER
 /begin DAQ DYNAMIC 0x0000 0x0080 0x00 OPTIMISATION_TYPE_DEFAULT ADDRESS_EXTENSION_FREE IDENTIFICATION_FIELD_TYPE_RELATIVE_WORD_ALIGNED GRANULARITY_ODT_ENTRY_SIZE_DAQ_BYTE 0xFF OVERLOAD_INDICATION_PID PRESCALER_SUPPORTED /begin STIM GRANULARITY_ODT_ENTRY_SIZE_STIM_BYTE 0xFF /end STIM /begin TIMESTAMP_SUPPORTED 0x0001 SIZE_DWORD UNIT_1US TIMESTAMP_FIXED /end TIMESTAMP_SUPPORTED /begin EVENT "5 ms" "5 ms" 0x0000 DAQ 0xFF 0x05 0x06 0x00 /end EVENT /end DAQ
 /begin XCP_ON_UDP_IP 0x0100 0x15B3 ADDRESS "192.168.7.5" /end XCP_ON_UDP_IP
/end IF_DATA
/begin MOD_PAR "MOD PAR Comment Goes Here"
 /begin MEMORY_SEGMENT main_quad_rev3_21_200p_cal_impl "main_quad_rev3_21_200p_cal_impl" DATA FLASH INTERN 0x00219020 0x928 -1 -1 -1 -1 -1
  /begin IF_DATA XCP
   /begin SEGMENT 0x00 0x02 0x00 0x00 0x00
    /begin PAGE 0x00 ECU_ACCESS_DONT_CARE XCP_READ_ACCESS_DONT_CARE XCP_WRITE_ACCESS_NOT_ALLOWED /end PAGE
    /begin PAGE 0x01 ECU_ACCESS_DONT_CARE XCP_READ_ACCESS_DONT_CARE XCP_WRITE_ACCESS_DONT_CARE /end PAGE
   /end SEGMENT
  /end IF_DATA
 /end MEMORY_SEGMENT
/end MOD_PAR
/begin MOD_COMMON "Mod Common Comment Here" BYTE_ORDER MSB_LAST ALIGNMENT_BYTE 1 ALIGNMENT_WORD 2 ALIGNMENT_LONG 8 ALIGNMENT_FLOAT32_IEEE 4 ALIGNMENT_FLOAT64_IEEE 8 ALIGNMENT_INT64 4 /end MOD_COMMON
/begin CHARACTERISTIC main_quad_rev3_21_200p_cal_impl.CANRead_P1 "" VAL_BLK 0x002192B0 Scalar_FLOAT64_IEEE 0 main_quad_rev3_21_200pm_CM_double -1.7E+308 1.7E+308 MATRIX_DIM 6 1 /end CHARACTERISTIC
/begin CHARACTERISTIC main_quad_rev3_21_200p_cal_impl.CANSetup_P1 "" VAL_BLK 0x002192F0 Scalar_FLOAT64_IEEE 0 main_quad_rev3_21_200pm_CM_double -1.7E+308 1.7E+308 MATRIX_DIM 40 1 /end CHARACTERISTIC
/begin CHARACTERISTIC main_quad_rev3_21_200p_cal_impl.CANSetup_P2 "" VALUE 0x00219440 Scalar_FLOAT64_IEEE 0 main_quad_rev3_21_200pm_CM_double -1.7E+308 1.7E+308 /end CHARACTERISTIC
/begin CHARACTERISTIC main_quad_rev3_21_200p_cal_impl.CANSetup_P3 "" VALUE 0x00219458 Scalar_FLOAT64_IEEE 0 main_quad_rev3_21_200pm_CM_double -1.7E+308 1.7E+308 /end CHARACTERISTIC
/begin CHARACTERISTIC main_quad_rev3_21_200p_cal_impl.CANStatus_P1 "" VALUE 0x00219568 Scalar_FLOAT64_IEEE 0 main_quad_rev3_21_200pm_CM_double -1.7E+308 1.7E+308 /end CHARACTERISTIC
/begin CHARACTERISTIC main_quad_rev3_21_200p_cal_impl.CANStatus_P10 "" VALUE 0x00219640 Scalar_FLOAT64_IEEE 0 main_quad_rev3_21_200pm_CM_double -1.7E+308 1.7E+308 /end CHARACTERISTIC
/begin CHARACTERISTIC main_quad_rev3_21_200p_cal_impl.CANStatus_P11 "" VALUE 0x00219658 Scalar_FLOAT64_IEEE 0 main_quad_rev3_21_200pm_CM_double -1.7E+308 1.7E+308 /end CHARACTERISTIC
/begin CHARACTERISTIC main_quad_rev3_21_200p_cal_impl.CANStatus_P12 "" VALUE 0x00219670 Scalar_FLOAT64_IEEE 0 main_quad_rev3_21_200pm_CM_double -1.7E+308 1.7E+308 /end CHARACTERISTIC
/begin CHARACTERISTIC main_quad_rev3_21_200p_cal_impl.CANStatus_P13 "" VALUE 0x00219688 Scalar_FLOAT64_IEEE 0 main_quad_rev3_21_200pm_CM_double -1.7E+308 1.7E+308 /end CHARACTERISTIC
/begin CHARACTERISTIC main_quad_rev3_21_200p_cal_impl.CANStatus_P14 "" VALUE 0x002196A0 Scalar_FLOAT64_IEEE 0 main_quad_rev3_21_200pm_CM_double -1.7E+308 1.7E+308 /end CHARACTERISTIC
/begin CHARACTERISTIC main_quad_rev3_21_200p_cal_impl.CANStatus_P15 "" VALUE 0x002196B8 Scalar_FLOAT64_IEEE 0 main_quad_rev3_21_200pm_CM_double -1.7E+308 1.7E+308 /end CHARACTERISTIC
/begin CHARACTERISTIC main_quad_rev3_21_200p_cal_impl.CANStatus_P16 "" VALUE 0x002196D0 Scalar_FLOAT64_IEEE 0 main_quad_rev3_21_200pm_CM_double -1.7E+308 1.7E+308 /end CHARACTERISTIC
/begin CHARACTERISTIC main_quad_rev3_21_200p_cal_impl.CANStatus_P17 "" VALUE 0x002196E8 Scalar_FLOAT64_IEEE 0 main_quad_rev3_21_200pm_CM_double -1.7E+308 1.7E+308 /end CHARACTERISTIC
/begin CHARACTERISTIC main_quad_rev3_21_200p_cal_impl.CANStatus_P18 "" VALUE 0x00219700 Scalar_FLOAT64_IEEE 0 main_quad_rev3_21_200pm_CM_double -1.7E+308 1.7E+308 /end CHARACTERISTIC
/begin CHARACTERISTIC main_quad_rev3_21_200p_cal_impl.CANStatus_P19 "" VALUE 0x00219718 Scalar_FLOAT64_IEEE 0 main_quad_rev3_21_200pm_CM_double -1.7E+308 1.7E+308 /end CHARACTERISTIC
/begin CHARACTERISTIC main_quad_rev3_21_200p_cal_impl.CANStatus_P2 "" VALUE 0x00219580 Scalar_FLOAT64_IEEE 0 main_quad_rev3_21_200pm_CM_double -1.7E+308 1.7E+308 /end CHARACTERISTIC
/begin CHARACTERISTIC main_quad_rev3_21_200p_cal_impl.CANStatus_P20 "" VALUE 0x00219730 Scalar_FLOAT64_IEEE 0 main_quad_rev3_21_200pm_CM_double -1.7E+308 1.7E+308 /end CHARACTERISTIC
/begin CHARACTERISTIC main_quad_rev3_21_200p_cal_impl.CANStatus_P21 "" VALUE 0x00219748 Scalar_FLOAT64_IEEE 0 main_quad_rev3_21_200pm_CM_double -1.7E+308 1.7E+308 /end CHARACTERISTIC
/begin CHARACTERISTIC main_quad_rev3_21_200p_cal_impl.CANStatus_P22 "" VALUE 0x00219760 Scalar_FLOAT64_IEEE 0 main_quad_rev3_21_200pm_CM_double -1.7E+308 1.7E+308 /end CHARACTERISTIC
/begin CHARACTERISTIC main_quad_rev3_21_200p_cal_impl.CANStatus_P23 "" VALUE 0x00219778 Scalar_FLOAT64_IEEE 0 main_quad_rev3_21_200pm_CM_double -1.7E+308 1.7E+308 /end CHARACTERISTIC
/begin CHARACTERISTIC main_quad_rev3_21_200p_cal_impl.CANStatus_P24 "" VALUE 0x00219790 Scalar_FLOAT64_IEEE 0 main_quad_rev3_21_200pm_CM_double -1.7E+308 1.7E+308 /end CHARACTERISTIC
/begin CHARACTERISTIC main_quad_rev3_21_200p_cal_impl.CANStatus_P25 "" VALUE 0x002197A8 Scalar_FLOAT64_IEEE 0 main_quad_rev3_21_200pm_CM_double -1.7E+308 1.7E+308 /end CHARACTERISTIC
/begin CHARACTERISTIC main_quad_rev3_21_200p_cal_impl.CANStatus_P26 "" VALUE 0x002197C0 Scalar_FLOAT64_IEEE 0 main_quad_rev3_21_200pm_CM_double -1.7E+308 1.7E+308 /end CHARACTERISTIC
/begin CHARACTERISTIC main_quad_rev3_21_200p_cal_impl.CANStatus_P27 "" VALUE 0x002197D8 Scalar_FLOAT64_IEEE 0 main_quad_rev3_21_200pm_CM_double -1.7E+308 1.7E+308 /end CHARACTERISTIC
/begin CHARACTERISTIC main_quad_rev3_21_200p_cal_impl.CANStatus_P28 "" VALUE 0x002197F0 Scalar_FLOAT64_IEEE 0 main_quad_rev3_21_200pm_CM_double -1.7E+308 1.7E+308 /end CHARACTERISTIC
/begin CHARACTERISTIC main_quad_rev3_21_200p_cal_impl.CANStatus_P29 "" VALUE 0x00219808 Scalar_FLOAT64_IEEE 0 main_quad_rev3_21_200pm_CM_double -1.7E+308 1.7E+308 /end CHARACTERISTIC
/begin CHARACTERISTIC main_quad_rev3_21_200p_cal_impl.CANStatus_P3 "" VALUE 0x00219598 Scalar_FLOAT64_IEEE 0 main_quad_rev3_21_200pm_CM_double -1.7E+308 1.7E+308 /end CHARACTERISTIC
/begin CHARACTERISTIC main_quad_rev3_21_200p_cal_impl.CANStatus_P30 "" VALUE 0x00219820 Scalar_FLOAT64_IEEE 0 main_quad_rev3_21_200pm_CM_double -1.7E+308 1.7E+308 /end CHARACTERISTIC
/begin CHARACTERISTIC main_quad_rev3_21_200p_cal_impl.CANStatus_P31 "" VALUE 0x00219838 Scalar_FLOAT64_IEEE 0 main_quad_rev3_21_200pm_CM_double -1.7E+308 1.7E+308 /end CHARACTERISTIC
/begin CHARACTERISTIC main_quad_rev3_21_200p_cal_impl.CANStatus_P32 "" VALUE 0x00219850 Scalar_FLOAT64_IEEE 0 main_quad_rev3_21_200pm_CM_double -1.7E+308 1.7E+308 /end CHARACTERISTIC
/begin CHARACTERISTIC main_quad_rev3_21_200p_cal_impl.CANStatus_P33 "" VALUE 0x00219868 Scalar_FLOAT64_IEEE 0 main_quad_rev3_21_200pm_CM_double -1.7E+308 1.7E+308 /end CHARACTERISTIC
/begin CHARACTERISTIC main_quad_rev3_21_200p_cal_impl.CANStatus_P34 "" VALUE 0x00219880 Scalar_FLOAT64_IEEE 0 main_quad_rev3_21_200pm_CM_double -1.7E+308 1.7E+308 /end CHARACTERISTIC
/begin CHARACTERISTIC main_quad_rev3_21_200p_cal_impl.CANStatus_P4 "" VALUE 0x002195B0 Scalar_FLOAT64_IEEE 0 main_quad_rev3_21_200pm_CM_double -1.7E+308 1.7E+308 /end CHARACTERISTIC
/begin CHARACTERISTIC main_quad_rev3_21_200p_cal_impl.CANStatus_P5 "" VALUE 0x002195C8 Scalar_FLOAT64_IEEE 0 main_quad_rev3_21_200pm_CM_double -1.7E+308 1.7E+308 /end CHARACTERISTIC
/begin CHARACTERISTIC main_quad_rev3_21_200p_cal_impl.CANStatus_P6 "" VALUE 0x002195E0 Scalar_FLOAT64_IEEE 0 main_quad_rev3_21_200pm_CM_double -1.7E+308 1.7E+308 /end CHARACTERISTIC
/begin CHARACTERISTIC main_quad_rev3_21_200p_cal_impl.CANStatus_P7 "" VALUE 0x002195F8 Scalar_FLOAT64_IEEE 0 main_quad_rev3_21_200pm_CM_double -1.7E+308 1.7E+308 /end CHARACTERISTIC
/begin CHARACTERISTIC main_quad_rev3_21_200p_cal_impl.CANStatus_P8 "" VALUE 0x00219610 Scalar_FLOAT64_IEEE 0 main_quad_rev3_21_200pm_CM_double -1.7E+308 1.7E+308 /end CHARACTERISTIC
/begin CHARACTERISTIC main_quad_rev3_21_200p_cal_impl.CANStatus_P9 "" VALUE 0x00219628 Scalar_FLOAT64_IEEE 0 main_quad_rev3_21_200pm_CM_double -1.7E+308 1.7E+308 /end CHARACTERISTIC
/begin CHARACTERISTIC main_quad_rev3_21_200p_cal_impl.CANWrite1_P1 "" VAL_BLK 0x00219030 Scalar_FLOAT64_IEEE 0 main_quad_rev3_21_200pm_CM_double -1.7E+308 1.7E+308 MATRIX_DIM 7 1 /end CHARACTERISTIC
/begin CHARACTERISTIC main_quad_rev3_21_200p_cal_impl.CANWrite1_P1_d "" VAL_BLK 0x00219198 Scalar_FLOAT64_IEEE 0 main_quad_rev3_21_200pm_CM_double -1.7E+308 1.7E+308 MATRIX_DIM 7 1 /end CHARACTERISTIC
/begin CHARACTERISTIC main_quad_rev3_21_200p_cal_impl.CANWrite1_P1_j "" VAL_BLK 0x002190C0 Scalar_FLOAT64_IEEE 0 main_quad_rev3_21_200pm_CM_double -1.7E+308 1.7E+308 MATRIX_DIM 7 1 /end CHARACTERISTIC
/begin CHARACTERISTIC main_quad_rev3_21_200p_cal_impl.CANWrite1_P1_je "" VAL_BLK 0x00219108 Scalar_FLOAT64_IEEE 0 main_quad_rev3_21_200pm_CM_double -1.7E+308 1.7E+308 MATRIX_DIM 7 1 /end CHARACTERISTIC
/begin CHARACTERISTIC main_quad_rev3_21_200p_cal_impl.CANWrite1_P1_l "" VAL_BLK 0x00219078 Scalar_FLOAT64_IEEE 0 main_quad_rev3_21_200pm_CM_double -1.7E+308 1.7E+308 MATRIX_DIM 7 1 /end CHARACTERISTIC
/begin CHARACTERISTIC main_quad_rev3_21_200p_cal_impl.CANWrite1_P1_n "" VAL_BLK 0x00219150 Scalar_FLOAT64_IEEE 0 main_quad_rev3_21_200pm_CM_double -1.7E+308 1.7E+308 MATRIX_DIM 7 1 /end CHARACTERISTIC
/begin CHARACTERISTIC main_quad_rev3_21_200p_cal_impl.CANWrite1_P1_nj "" VAL_BLK 0x002191E0 Scalar_FLOAT64_IEEE 0 main_quad_rev3_21_200pm_CM_double -1.7E+308 1.7E+308 MATRIX_DIM 7 1 /end CHARACTERISTIC
/begin CHARACTERISTIC main_quad_rev3_21_200p_cal_impl.CANWrite1_P1_p "" VAL_BLK 0x00219228 Scalar_FLOAT64_IEEE 0 main_quad_rev3_21_200pm_CM_double -1.7E+308 1.7E+308 MATRIX_DIM 7 1 /end CHARACTERISTIC
/begin CHARACTERISTIC main_quad_rev3_21_200p_cal_impl.Constant1_Value "" VAL_BLK 0x00219890 Scalar_UBYTE 0 main_quad_rev3_21_200pm_CM_uint8 0 255 MATRIX_DIM 8 1 /end CHARACTERISTIC
/begin CHARACTERISTIC main_quad_rev3_21_200p_cal_impl.Constant1_Value_a "" VAL_BLK 0x00219938 Scalar_UBYTE 0 main_quad_rev3_21_200pm_CM_uint8 0 255 MATRIX_DIM 8 1 /end CHARACTERISTIC
/begin CHARACTERISTIC main_quad_rev3_21_200p_cal_impl.Constant1_Value_e "" VAL_BLK 0x002198C0 Scalar_UBYTE 0 main_quad_rev3_21_200pm_CM_uint8 0 255 MATRIX_DIM 8 1 /end CHARACTERISTIC
/begin CHARACTERISTIC main_quad_rev3_21_200p_cal_impl.Constant1_Value_f "" VAL_BLK 0x002198D8 Scalar_UBYTE 0 main_quad_rev3_21_200pm_CM_uint8 0 255 MATRIX_DIM 8 1 /end CHARACTERISTIC
/begin CHARACTERISTIC main_quad_rev3_21_200p_cal_impl.Constant1_Value_h "" VAL_BLK 0x002198F0 Scalar_UBYTE 0 main_quad_rev3_21_200pm_CM_uint8 0 255 MATRIX_DIM 8 1 /end CHARACTERISTIC
/begin CHARACTERISTIC main_quad_rev3_21_200p_cal_impl.Constant1_Value_i "" VAL_BLK 0x00219908 Scalar_UBYTE 0 main_quad_rev3_21_200pm_CM_uint8 0 255 MATRIX_DIM 8 1 /end CHARACTERISTIC
/begin CHARACTERISTIC main_quad_rev3_21_200p_cal_impl.Constant1_Value_k "" VAL_BLK 0x002198A8 Scalar_UBYTE 0 main_quad_rev3_21_200pm_CM_uint8 0 255 MATRIX_DIM 8 1 /end CHARACTERISTIC
/begin CHARACTERISTIC main_quad_rev3_21_200p_cal_impl.Constant1_Value_m "" VAL_BLK 0x00219920 Scalar_UBYTE 0 main_quad_rev3_21_200pm_CM_uint8 0 255 MATRIX_DIM 8 1 /end CHARACTERISTIC
/begin CHARACTERISTIC main_quad_rev3_21_200p_cal_impl.Constant2_Value "" VALUE 0x002194B8 Scalar_FLOAT64_IEEE 0 main_quad_rev3_21_200pm_CM_double -1.7E+308 1.7E+308 /end CHARACTERISTIC
/begin CHARACTERISTIC main_quad_rev3_21_200p_cal_impl.Constant2_Value_a "" VAL_BLK 0x00219940 Scalar_UBYTE 0 main_quad_rev3_21_200pm_CM_uint8 0 255 MATRIX_DIM 8 1 /end CHARACTERISTIC
/begin CHARACTERISTIC main_quad_rev3_21_200p_cal_impl.Constant2_Value_d "" VAL_BLK 0x002198B0 Scalar_UBYTE 0 main_quad_rev3_21_200pm_CM_uint8 0 255 MATRIX_DIM 8 1 /end CHARACTERISTIC
/begin CHARACTERISTIC main_quad_rev3_21_200p_cal_impl.Constant2_Value_g "" VAL_BLK 0x00219898 Scalar_UBYTE 0 main_quad_rev3_21_200pm_CM_uint8 0 255 MATRIX_DIM 8 1 /end CHARACTERISTIC
/begin CHARACTERISTIC main_quad_rev3_21_200p_cal_impl.Constant2_Value_i "" VAL_BLK 0x00219928 Scalar_UBYTE 0 main_quad_rev3_21_200pm_CM_uint8 0 255 MATRIX_DIM 8 1 /end CHARACTERISTIC
/begin CHARACTERISTIC main_quad_rev3_21_200p_cal_impl.Constant2_Value_j "" VAL_BLK 0x002198E0 Scalar_UBYTE 0 main_quad_rev3_21_200pm_CM_uint8 0 255 MATRIX_DIM 8 1 /end CHARACTERISTIC
/begin CHARACTERISTIC main_quad_rev3_21_200p_cal_impl.Constant2_Value_k "" VAL_BLK 0x002198C8 Scalar_UBYTE 0 main_quad_rev3_21_200pm_CM_uint8 0 255 MATRIX_DIM 8 1 /end CHARACTERISTIC
/begin CHARACTERISTIC main_quad_rev3_21_200p_cal_impl.Constant2_Value_l "" VAL_BLK 0x00219910 Scalar_UBYTE 0 main_quad_rev3_21_200pm_CM_uint8 0 255 MATRIX_DIM 8 1 /end CHARACTERISTIC
/begin CHARACTERISTIC main_quad_rev3_21_200p_cal_impl.Constant2_Value_n "" VAL_BLK 0x002198F8 Scalar_UBYTE 0 main_quad_rev3_21_200pm_CM_uint8 0 255 MATRIX_DIM 8 1 /end CHARACTERISTIC
/begin CHARACTERISTIC main_quad_rev3_21_200p_cal_impl.Constant8_Value "" VALUE 0x00219480 Scalar_FLOAT64_IEEE 0 main_quad_rev3_21_200pm_CM_double -1.7E+308 1.7E+308 /end CHARACTERISTIC
/begin CHARACTERISTIC main_quad_rev3_21_200p_cal_impl.Constant_Value "" VALUE 0x00219470 Scalar_FLOAT64_IEEE 0 main_quad_rev3_21_200pm_CM_double -1.7E+308 1.7E+308 /end CHARACTERISTIC
/begin CHARACTERISTIC main_quad_rev3_21_200p_cal_impl.Constant_Value_b "" VAL_BLK 0x002198E8 Scalar_UBYTE 0 main_quad_rev3_21_200pm_CM_uint8 0 255 MATRIX_DIM 8 1 /end CHARACTERISTIC
/begin CHARACTERISTIC main_quad_rev3_21_200p_cal_impl.Constant_Value_bb "" VAL_BLK 0x00219900 Scalar_UBYTE 0 main_quad_rev3_21_200pm_CM_uint8 0 255 MATRIX_DIM 8 1 /end CHARACTERISTIC
/begin CHARACTERISTIC main_quad_rev3_21_200p_cal_impl.Constant_Value_i "" VAL_BLK 0x002198B8 Scalar_UBYTE 0 main_quad_rev3_21_200pm_CM_uint8 0 255 MATRIX_DIM 8 1 /end CHARACTERISTIC
/begin CHARACTERISTIC main_quad_rev3_21_200p_cal_impl.Constant_Value_l "" VAL_BLK 0x00219888 Scalar_UBYTE 0 main_quad_rev3_21_200pm_CM_uint8 0 255 MATRIX_DIM 8 1 /end CHARACTERISTIC
/begin CHARACTERISTIC main_quad_rev3_21_200p_cal_impl.Constant_Value_le "" VAL_BLK 0x002198D0 Scalar_UBYTE 0 main_quad_rev3_21_200pm_CM_uint8 0 255 MATRIX_DIM 8 1 /end CHARACTERISTIC
/begin CHARACTERISTIC main_quad_rev3_21_200p_cal_impl.Constant_Value_o "" VAL_BLK 0x00219918 Scalar_UBYTE 0 main_quad_rev3_21_200pm_CM_uint8 0 255 MATRIX_DIM 8 1 /end CHARACTERISTIC
/begin CHARACTERISTIC main_quad_rev3_21_200p_cal_impl.Constant_Value_ob "" VAL_BLK 0x00219930 Scalar_UBYTE 0 main_quad_rev3_21_200pm_CM_uint8 0 255 MATRIX_DIM 8 1 /end CHARACTERISTIC
/begin CHARACTERISTIC main_quad_rev3_21_200p_cal_impl.Constant_Value_p "" VAL_BLK 0x002198A0 Scalar_UBYTE 0 main_quad_rev3_21_200pm_CM_uint8 0 255 MATRIX_DIM 8 1 /end CHARACTERISTIC
/begin CHARACTERISTIC main_quad_rev3_21_200p_cal_impl.Delay1_InitialCondition "" VALUE 0x00219468 Scalar_FLOAT64_IEEE 0 main_quad_rev3_21_200pm_CM_double -1.7E+308 1.7E+308 /end CHARACTERISTIC
/begin CHARACTERISTIC main_quad_rev3_21_200p_cal_impl.Delay_InitialCondition "" VALUE 0x00219460 Scalar_FLOAT64_IEEE 0 main_quad_rev3_21_200pm_CM_double -1.7E+308 1.7E+308 /end CHARACTERISTIC
/begin CHARACTERISTIC main_quad_rev3_21_200p_cal_impl.Gain10_Gain "" VALUE 0x002194D8 Scalar_FLOAT64_IEEE 0 main_quad_rev3_21_200pm_CM_double -1.7E+308 1.7E+308 /end CHARACTERISTIC
/begin CHARACTERISTIC main_quad_rev3_21_200p_cal_impl.Gain11_Gain "" VALUE 0x002194E0 Scalar_FLOAT64_IEEE 0 main_quad_rev3_21_200pm_CM_double -1.7E+308 1.7E+308 /end CHARACTERISTIC
/begin CHARACTERISTIC main_quad_rev3_21_200p_cal_impl.Gain12_Gain "" VALUE 0x002194E8 Scalar_FLOAT64_IEEE 0 main_quad_rev3_21_200pm_CM_double -1.7E+308 1.7E+308 /end CHARACTERISTIC
/begin CHARACTERISTIC main_quad_rev3_21_200p_cal_impl.Gain13_Gain "" VALUE 0x002194F0 Scalar_FLOAT64_IEEE 0 main_quad_rev3_21_200pm_CM_double -1.7E+308 1.7E+308 /end CHARACTERISTIC
/begin CHARACTERISTIC main_quad_rev3_21_200p_cal_impl.Gain14_Gain "" VALUE 0x002194F8 Scalar_FLOAT64_IEEE 0 main_quad_rev3_21_200pm_CM_double -1.7E+308 1.7E+308 /end CHARACTERISTIC
/begin CHARACTERISTIC main_quad_rev3_21_200p_cal_impl.Gain15_Gain "" VALUE 0x00219500 Scalar_FLOAT64_IEEE 0 main_quad_rev3_21_200pm_CM_double -1.7E+308 1.7E+308 /end CHARACTERISTIC
/begin CHARACTERISTIC main_quad_rev3_21_200p_cal_impl.Gain16_Gain "" VALUE 0x00219508 Scalar_FLOAT64_IEEE 0 main_quad_rev3_21_200pm_CM_double -1.7E+308 1.7E+308 /end CHARACTERISTIC
/begin CHARACTERISTIC main_quad_rev3_21_200p_cal_impl.Gain17_Gain "" VALUE 0x00219510 Scalar_FLOAT64_IEEE 0 main_quad_rev3_21_200pm_CM_double -1.7E+308 1.7E+308 /end CHARACTERISTIC
/begin CHARACTERISTIC main_quad_rev3_21_200p_cal_impl.Gain18_Gain "" VALUE 0x00219518 Scalar_FLOAT64_IEEE 0 main_quad_rev3_21_200pm_CM_double -1.7E+308 1.7E+308 /end CHARACTERISTIC
/begin CHARACTERISTIC main_quad_rev3_21_200p_cal_impl.Gain19_Gain "" VALUE 0x00219520 Scalar_FLOAT64_IEEE 0 main_quad_rev3_21_200pm_CM_double -1.7E+308 1.7E+308 /end CHARACTERISTIC
/begin CHARACTERISTIC main_quad_rev3_21_200p_cal_impl.Gain1_Gain "" VALUE 0x00219478 Scalar_FLOAT64_IEEE 0 main_quad_rev3_21_200pm_CM_double -1.7E+308 1.7E+308 /end CHARACTERISTIC
/begin CHARACTERISTIC main_quad_rev3_21_200p_cal_impl.Gain20_Gain "" VALUE 0x00219528 Scalar_FLOAT64_IEEE 0 main_quad_rev3_21_200pm_CM_double -1.7E+308 1.7E+308 /end CHARACTERISTIC
/begin CHARACTERISTIC main_quad_rev3_21_200p_cal_impl.Gain21_Gain "" VALUE 0x00219530 Scalar_FLOAT64_IEEE 0 main_quad_rev3_21_200pm_CM_double -1.7E+308 1.7E+308 /end CHARACTERISTIC
/begin CHARACTERISTIC main_quad_rev3_21_200p_cal_impl.Gain22_Gain "" VALUE 0x00219538 Scalar_FLOAT64_IEEE 0 main_quad_rev3_21_200pm_CM_double -1.7E+308 1.7E+308 /end CHARACTERISTIC
/begin CHARACTERISTIC main_quad_rev3_21_200p_cal_impl.Gain23_Gain "" VALUE 0x00219540 Scalar_FLOAT64_IEEE 0 main_quad_rev3_21_200pm_CM_double -1.7E+308 1.7E+308 /end CHARACTERISTIC
/begin CHARACTERISTIC main_quad_rev3_21_200p_cal_impl.Gain24_Gain "" VALUE 0x00219548 Scalar_FLOAT64_IEEE 0 main_quad_rev3_21_200pm_CM_double -1.7E+308 1.7E+308 /end CHARACTERISTIC
/begin CHARACTERISTIC main_quad_rev3_21_200p_cal_impl.Gain25_Gain "" VALUE 0x00219550 Scalar_FLOAT64_IEEE 0 main_quad_rev3_21_200pm_CM_double -1.7E+308 1.7E+308 /end CHARACTERISTIC
/begin CHARACTERISTIC main_quad_rev3_21_200p_cal_impl.Gain26_Gain "" VALUE 0x002194C8 Scalar_FLOAT64_IEEE 0 main_quad_rev3_21_200pm_CM_double -1.7E+308 1.7E+308 /end CHARACTERISTIC
/begin CHARACTERISTIC main_quad_rev3_21_200p_cal_impl.Gain2_Gain "" VALUE 0x00219488 Scalar_FLOAT64_IEEE 0 main_quad_rev3_21_200pm_CM_double -1.7E+308 1.7E+308 /end CHARACTERISTIC
/begin CHARACTERISTIC main_quad_rev3_21_200p_cal_impl.Gain3_Gain "" VALUE 0x00219490 Scalar_FLOAT64_IEEE 0 main_quad_rev3_21_200pm_CM_double -1.7E+308 1.7E+308 /end CHARACTERISTIC
/begin CHARACTERISTIC main_quad_rev3_21_200p_cal_impl.Gain4_Gain "" VALUE 0x002194B0 Scalar_FLOAT64_IEEE 0 main_quad_rev3_21_200pm_CM_double -1.7E+308 1.7E+308 /end CHARACTERISTIC
/begin CHARACTERISTIC main_quad_rev3_21_200p_cal_impl.Gain5_Gain "" VALUE 0x002194C0 Scalar_FLOAT64_IEEE 0 main_quad_rev3_21_200pm_CM_double -1.7E+308 1.7E+308 /end CHARACTERISTIC
/begin CHARACTERISTIC main_quad_rev3_21_200p_cal_impl.Gain6_Gain "" VALUE 0x00219498 Scalar_FLOAT64_IEEE 0 main_quad_rev3_21_200pm_CM_double -1.7E+308 1.7E+308 /end CHARACTERISTIC
/begin CHARACTERISTIC main_quad_rev3_21_200p_cal_impl.Gain7_Gain "" VALUE 0x002194A0 Scalar_FLOAT64_IEEE 0 main_quad_rev3_21_200pm_CM_double -1.7E+308 1.7E+308 /end CHARACTERISTIC
/begin CHARACTERISTIC main_quad_rev3_21_200p_cal_impl.Gain8_Gain "" VALUE 0x002194A8 Scalar_FLOAT64_IEEE 0 main_quad_rev3_21_200pm_CM_double -1.7E+308 1.7E+308 /end CHARACTERISTIC
/begin CHARACTERISTIC main_quad_rev3_21_200p_cal_impl.Gain9_Gain "" VALUE 0x002194D0 Scalar_FLOAT64_IEEE 0 main_quad_rev3_21_200pm_CM_double -1.7E+308 1.7E+308 /end CHARACTERISTIC
/begin CHARACTERISTIC main_quad_rev3_21_200p_cal_impl.P1_Y0 "" VALUE 0x00219260 Scalar_FLOAT64_IEEE 0 main_quad_rev3_21_200pm_CM_double -1.7E+308 1.7E+308 /end CHARACTERISTIC
/begin CHARACTERISTIC main_quad_rev3_21_200p_cal_impl.P2_Y0 "" VALUE 0x00219268 Scalar_FLOAT64_IEEE 0 main_quad_rev3_21_200pm_CM_double -1.7E+308 1.7E+308 /end CHARACTERISTIC
/begin CHARACTERISTIC main_quad_rev3_21_200p_cal_impl.P3_Y0 "" VALUE 0x00219270 Scalar_FLOAT64_IEEE 0 main_quad_rev3_21_200pm_CM_double -1.7E+308 1.7E+308 /end CHARACTERISTIC
/begin CHARACTERISTIC main_quad_rev3_21_200p_cal_impl.P4_Y0 "" VALUE 0x00219278 Scalar_FLOAT64_IEEE 0 main_quad_rev3_21_200pm_CM_double -1.7E+308 1.7E+308 /end CHARACTERISTIC
/begin CHARACTERISTIC main_quad_rev3_21_200p_cal_impl.P5_Y0 "" VALUE 0x00219280 Scalar_FLOAT64_IEEE 0 main_quad_rev3_21_200pm_CM_double -1.7E+308 1.7E+308 /end CHARACTERISTIC
/begin CHARACTERISTIC main_quad_rev3_21_200p_cal_impl.P6_Y0 "" VALUE 0x00219288 Scalar_FLOAT64_IEEE 0 main_quad_rev3_21_200pm_CM_double -1.7E+308 1.7E+308 /end CHARACTERISTIC
/begin CHARACTERISTIC main_quad_rev3_21_200p_cal_impl.P7_Y0 "" VALUE 0x00219290 Scalar_FLOAT64_IEEE 0 main_quad_rev3_21_200pm_CM_double -1.7E+308 1.7E+308 /end CHARACTERISTIC
/begin CHARACTERISTIC main_quad_rev3_21_200p_cal_impl.P8_Y0 "" VALUE 0x00219298 Scalar_FLOAT64_IEEE 0 main_quad_rev3_21_200pm_CM_double -1.7E+308 1.7E+308 /end CHARACTERISTIC
/begin MEASUREMENT main_quad_rev3_21_200pm_B.Add "" FLOAT64_IEEE main_quad_rev3_21_200pm_CM_double 0 0 -1.7E+308 1.7E+308 ECU_ADDRESS 0x0021F370 /end MEASUREMENT
/begin MEASUREMENT main_quad_rev3_21_200pm_B.Add1 "" FLOAT64_IEEE main_quad_rev3_21_200pm_CM_double 0 0 -1.7E+308 1.7E+308 ECU_ADDRESS 0x0021F378 /end MEASUREMENT
/begin MEASUREMENT main_quad_rev3_21_200pm_B.BytePacking "" UBYTE main_quad_rev3_21_200pm_CM_uint8 0 0 0 255 LAYOUT COLUMN_DIR MATRIX_DIM 8 ECU_ADDRESS 0x0021F544 /end MEASUREMENT
/begin MEASUREMENT main_quad_rev3_21_200pm_B.BytePacking_a "" UBYTE main_quad_rev3_21_200pm_CM_uint8 0 0 0 255 LAYOUT COLUMN_DIR MATRIX_DIM 8 ECU_ADDRESS 0x0021F564 /end MEASUREMENT
/begin MEASUREMENT main_quad_rev3_21_200pm_B.BytePacking_d "" UBYTE main_quad_rev3_21_200pm_CM_uint8 0 0 0 255 LAYOUT COLUMN_DIR MATRIX_DIM 8 ECU_ADDRESS 0x0021F594 /end MEASUREMENT
/begin MEASUREMENT main_quad_rev3_21_200pm_B.BytePacking_f "" UBYTE main_quad_rev3_21_200pm_CM_uint8 0 0 0 255 LAYOUT COLUMN_DIR MATRIX_DIM 8 ECU_ADDRESS 0x0021F574 /end MEASUREMENT
/begin MEASUREMENT main_quad_rev3_21_200pm_B.BytePacking_k "" UBYTE main_quad_rev3_21_200pm_CM_uint8 0 0 0 255 LAYOUT COLUMN_DIR MATRIX_DIM 8 ECU_ADDRESS 0x0021F5A4 /end MEASUREMENT
/begin MEASUREMENT main_quad_rev3_21_200pm_B.BytePacking_o "" UBYTE main_quad_rev3_21_200pm_CM_uint8 0 0 0 255 LAYOUT COLUMN_DIR MATRIX_DIM 8 ECU_ADDRESS 0x0021F554 /end MEASUREMENT
/begin MEASUREMENT main_quad_rev3_21_200pm_B.BytePacking_or "" UBYTE main_quad_rev3_21_200pm_CM_uint8 0 0 0 255 LAYOUT COLUMN_DIR MATRIX_DIM 8 ECU_ADDRESS 0x0021F5B4 /end MEASUREMENT
/begin MEASUREMENT main_quad_rev3_21_200pm_B.BytePacking_p "" UBYTE main_quad_rev3_21_200pm_CM_uint8 0 0 0 255 LAYOUT COLUMN_DIR MATRIX_DIM 8 ECU_ADDRESS 0x0021F584 /end MEASUREMENT
/begin MEASUREMENT main_quad_rev3_21_200pm_B.CANRead_o1 "" UBYTE main_quad_rev3_21_200pm_CM_logical 0 0 0 1 ECU_ADDRESS 0x0021F5BC /end MEASUREMENT
/begin MEASUREMENT main_quad_rev3_21_200pm_B.CANUnpack_o1 "" FLOAT64_IEEE main_quad_rev3_21_200pm_CM_double 0 0 -1.7E+308 1.7E+308 ECU_ADDRESS 0x0021F398 /end MEASUREMENT
/begin MEASUREMENT main_quad_rev3_21_200pm_B.CANUnpack_o1_b "" FLOAT64_IEEE main_quad_rev3_21_200pm_CM_double 0 0 -1.7E+308 1.7E+308 ECU_ADDRESS 0x0021F3D8 /end MEASUREMENT
/begin MEASUREMENT main_quad_rev3_21_200pm_B.CANUnpack_o1_e "" FLOAT64_IEEE main_quad_rev3_21_200pm_CM_double 0 0 -1.7E+308 1.7E+308 ECU_ADDRESS 0x0021F3F8 /end MEASUREMENT
/begin MEASUREMENT main_quad_rev3_21_200pm_B.CANUnpack_o1_f "" FLOAT64_IEEE main_quad_rev3_21_200pm_CM_double 0 0 -1.7E+308 1.7E+308 ECU_ADDRESS 0x0021F478 /end MEASUREMENT
/begin MEASUREMENT main_quad_rev3_21_200pm_B.CANUnpack_o1_k "" FLOAT64_IEEE main_quad_rev3_21_200pm_CM_double 0 0 -1.7E+308 1.7E+308 ECU_ADDRESS 0x0021F418 /end MEASUREMENT
/begin MEASUREMENT main_quad_rev3_21_200pm_B.CANUnpack_o1_n "" FLOAT64_IEEE main_quad_rev3_21_200pm_CM_double 0 0 -1.7E+308 1.7E+308 ECU_ADDRESS 0x0021F3B8 /end MEASUREMENT
/begin MEASUREMENT main_quad_rev3_21_200pm_B.CANUnpack_o1_nr "" FLOAT64_IEEE main_quad_rev3_21_200pm_CM_double 0 0 -1.7E+308 1.7E+308 ECU_ADDRESS 0x0021F438 /end MEASUREMENT
/begin MEASUREMENT main_quad_rev3_21_200pm_B.CANUnpack_o1_p "" FLOAT64_IEEE main_quad_rev3_21_200pm_CM_double 0 0 -1.7E+308 1.7E+308 ECU_ADDRESS 0x0021F458 /end MEASUREMENT
/begin MEASUREMENT main_quad_rev3_21_200pm_B.CANUnpack_o2 "" FLOAT64_IEEE main_quad_rev3_21_200pm_CM_double 0 0 -1.7E+308 1.7E+308 ECU_ADDRESS 0x0021F3A0 /end MEASUREMENT
/begin MEASUREMENT main_quad_rev3_21_200pm_B.CANUnpack_o2_d "" FLOAT64_IEEE main_quad_rev3_21_200pm_CM_double 0 0 -1.7E+308 1.7E+308 ECU_ADDRESS 0x0021F420 /end MEASUREMENT
/begin MEASUREMENT main_quad_rev3_21_200pm_B.CANUnpack_o2_e "" FLOAT64_IEEE main_quad_rev3_21_200pm_CM_double 0 0 -1.7E+308 1.7E+308 ECU_ADDRESS 0x0021F400 /end MEASUREMENT
/begin MEASUREMENT main_quad_rev3_21_200pm_B.CANUnpack_o2_f "" FLOAT64_IEEE main_quad_rev3_21_200pm_CM_double 0 0 -1.7E+308 1.7E+308 ECU_ADDRESS 0x0021F3C0 /end MEASUREMENT
/begin MEASUREMENT main_quad_rev3_21_200pm_B.CANUnpack_o2_g "" FLOAT64_IEEE main_quad_rev3_21_200pm_CM_double 0 0 -1.7E+308 1.7E+308 ECU_ADDRESS 0x0021F3E0 /end MEASUREMENT
/begin MEASUREMENT main_quad_rev3_21_200pm_B.CANUnpack_o2_gg "" FLOAT64_IEEE main_quad_rev3_21_200pm_CM_double 0 0 -1.7E+308 1.7E+308 ECU_ADDRESS 0x0021F460 /end MEASUREMENT
/begin MEASUREMENT main_quad_rev3_21_200pm_B.CANUnpack_o2_l "" FLOAT64_IEEE main_quad_rev3_21_200pm_CM_double 0 0 -1.7E+308 1.7E+308 ECU_ADDRESS 0x0021F480 /end MEASUREMENT
/begin MEASUREMENT main_quad_rev3_21_200pm_B.CANUnpack_o2_n "" FLOAT64_IEEE main_quad_rev3_21_200pm_CM_double 0 0 -1.7E+308 1.7E+308 ECU_ADDRESS 0x0021F440 /end MEASUREMENT
/begin MEASUREMENT main_quad_rev3_21_200pm_B.CANUnpack_o3 "" FLOAT64_IEEE main_quad_rev3_21_200pm_CM_double 0 0 -1.7E+308 1.7E+308 ECU_ADDRESS 0x0021F3A8 /end MEASUREMENT
/begin MEASUREMENT main_quad_rev3_21_200pm_B.CANUnpack_o3_a "" FLOAT64_IEEE main_quad_rev3_21_200pm_CM_double 0 0 -1.7E+308 1.7E+308 ECU_ADDRESS 0x0021F428 /end MEASUREMENT
/begin MEASUREMENT main_quad_rev3_21_200pm_B.CANUnpack_o3_c "" FLOAT64_IEEE main_quad_rev3_21_200pm_CM_double 0 0 -1.7E+308 1.7E+308 ECU_ADDRESS 0x0021F408 /end MEASUREMENT
/begin MEASUREMENT main_quad_rev3_21_200pm_B.CANUnpack_o3_cp "" FLOAT64_IEEE main_quad_rev3_21_200pm_CM_double 0 0 -1.7E+308 1.7E+308 ECU_ADDRESS 0x0021F448 /end MEASUREMENT
/begin MEASUREMENT main_quad_rev3_21_200pm_B.CANUnpack_o3_e "" FLOAT64_IEEE main_quad_rev3_21_200pm_CM_double 0 0 -1.7E+308 1.7E+308 ECU_ADDRESS 0x0021F3E8 /end MEASUREMENT
/begin MEASUREMENT main_quad_rev3_21_200pm_B.CANUnpack_o3_h "" FLOAT64_IEEE main_quad_rev3_21_200pm_CM_double 0 0 -1.7E+308 1.7E+308 ECU_ADDRESS 0x0021F468 /end MEASUREMENT
/begin MEASUREMENT main_quad_rev3_21_200pm_B.CANUnpack_o3_k "" FLOAT64_IEEE main_quad_rev3_21_200pm_CM_double 0 0 -1.7E+308 1.7E+308 ECU_ADDRESS 0x0021F488 /end MEASUREMENT
/begin MEASUREMENT main_quad_rev3_21_200pm_B.CANUnpack_o3_m "" FLOAT64_IEEE main_quad_rev3_21_200pm_CM_double 0 0 -1.7E+308 1.7E+308 ECU_ADDRESS 0x0021F3C8 /end MEASUREMENT
/begin MEASUREMENT main_quad_rev3_21_200pm_B.CANUnpack_o4 "" FLOAT64_IEEE main_quad_rev3_21_200pm_CM_double 0 0 -1.7E+308 1.7E+308 ECU_ADDRESS 0x0021F3B0 /end MEASUREMENT
/begin MEASUREMENT main_quad_rev3_21_200pm_B.CANUnpack_o4_a "" FLOAT64_IEEE main_quad_rev3_21_200pm_CM_double 0 0 -1.7E+308 1.7E+308 ECU_ADDRESS 0x0021F430 /end MEASUREMENT
/begin MEASUREMENT main_quad_rev3_21_200pm_B.CANUnpack_o4_e "" FLOAT64_IEEE main_quad_rev3_21_200pm_CM_double 0 0 -1.7E+308 1.7E+308 ECU_ADDRESS 0x0021F450 /end MEASUREMENT
/begin MEASUREMENT main_quad_rev3_21_200pm_B.CANUnpack_o4_g "" FLOAT64_IEEE main_quad_rev3_21_200pm_CM_double 0 0 -1.7E+308 1.7E+308 ECU_ADDRESS 0x0021F3D0 /end MEASUREMENT
/begin MEASUREMENT main_quad_rev3_21_200pm_B.CANUnpack_o4_h "" FLOAT64_IEEE main_quad_rev3_21_200pm_CM_double 0 0 -1.7E+308 1.7E+308 ECU_ADDRESS 0x0021F3F0 /end MEASUREMENT
/begin MEASUREMENT main_quad_rev3_21_200pm_B.CANUnpack_o4_i "" FLOAT64_IEEE main_quad_rev3_21_200pm_CM_double 0 0 -1.7E+308 1.7E+308 ECU_ADDRESS 0x0021F410 /end MEASUREMENT
/begin MEASUREMENT main_quad_rev3_21_200pm_B.CANUnpack_o4_is "" FLOAT64_IEEE main_quad_rev3_21_200pm_CM_double 0 0 -1.7E+308 1.7E+308 ECU_ADDRESS 0x0021F490 /end MEASUREMENT
/begin MEASUREMENT main_quad_rev3_21_200pm_B.CANUnpack_o4_j "" FLOAT64_IEEE main_quad_rev3_21_200pm_CM_double 0 0 -1.7E+308 1.7E+308 ECU_ADDRESS 0x0021F470 /end MEASUREMENT
/begin MEASUREMENT main_quad_rev3_21_200pm_B.CANUnpack_o5 "" UBYTE main_quad_rev3_21_200pm_CM_uint8 0 0 0 255 ECU_ADDRESS 0x0021F534 /end MEASUREMENT
/begin MEASUREMENT main_quad_rev3_21_200pm_B.CANUnpack_o5_c "" UBYTE main_quad_rev3_21_200pm_CM_uint8 0 0 0 255 ECU_ADDRESS 0x0021F535 /end MEASUREMENT
/begin MEASUREMENT main_quad_rev3_21_200pm_B.CANUnpack_o5_cc "" UBYTE main_quad_rev3_21_200pm_CM_uint8 0 0 0 255 ECU_ADDRESS 0x0021F539 /end MEASUREMENT
/begin MEASUREMENT main_quad_rev3_21_200pm_B.CANUnpack_o5_f "" UBYTE main_quad_rev3_21_200pm_CM_uint8 0 0 0 255 ECU_ADDRESS 0x0021F538 /end MEASUREMENT
/begin MEASUREMENT main_quad_rev3_21_200pm_B.CANUnpack_o5_fk "" UBYTE main_quad_rev3_21_200pm_CM_uint8 0 0 0 255 ECU_ADDRESS 0x0021F53A /end MEASUREMENT
/begin MEASUREMENT main_quad_rev3_21_200pm_B.CANUnpack_o5_i "" UBYTE main_quad_rev3_21_200pm_CM_uint8 0 0 0 255 ECU_ADDRESS 0x0021F536 /end MEASUREMENT
/begin MEASUREMENT main_quad_rev3_21_200pm_B.CANUnpack_o5_l "" UBYTE main_quad_rev3_21_200pm_CM_uint8 0 0 0 255 ECU_ADDRESS 0x0021F537 /end MEASUREMENT
/begin MEASUREMENT main_quad_rev3_21_200pm_B.CANUnpack_o5_p "" UBYTE main_quad_rev3_21_200pm_CM_uint8 0 0 0 255 ECU_ADDRESS 0x0021F53B /end MEASUREMENT
/begin MEASUREMENT main_quad_rev3_21_200pm_B.Clock "" FLOAT64_IEEE main_quad_rev3_21_200pm_CM_double 0 0 -1.7E+308 1.7E+308 ECU_ADDRESS 0x0021F390 /end MEASUREMENT
/begin MEASUREMENT main_quad_rev3_21_200pm_B.Constant "" FLOAT64_IEEE main_quad_rev3_21_200pm_CM_double 0 0 -1.7E+308 1.7E+308 ECU_ADDRESS 0x0021F2A8 /end MEASUREMENT
/begin MEASUREMENT main_quad_rev3_21_200pm_B.Delay "" FLOAT64_IEEE main_quad_rev3_21_200pm_CM_double 0 0 -1.7E+308 1.7E+308 ECU_ADDRESS 0x0021F298 /end MEASUREMENT
/begin MEASUREMENT main_quad_rev3_21_200pm_B.Delay1 "" FLOAT64_IEEE main_quad_rev3_21_200pm_CM_double 0 0 -1.7E+308 1.7E+308 ECU_ADDRESS 0x0021F2A0 /end MEASUREMENT
/begin MEASUREMENT main_quad_rev3_21_200pm_B.Gain1 "" FLOAT64_IEEE main_quad_rev3_21_200pm_CM_double 0 0 -1.7E+308 1.7E+308 ECU_ADDRESS 0x0021F2B0 /end MEASUREMENT
/begin MEASUREMENT main_quad_rev3_21_200pm_B.Gain10 "" FLOAT64_IEEE main_quad_rev3_21_200pm_CM_double 0 0 -1.7E+308 1.7E+308 ECU_ADDRESS 0x0021F300 /end MEASUREMENT
/begin MEASUREMENT main_quad_rev3_21_200pm_B.Gain11 "" FLOAT64_IEEE main_quad_rev3_21_200pm_CM_double 0 0 -1.7E+308 1.7E+308 ECU_ADDRESS 0x0021F308 /end MEASUREMENT
/begin MEASUREMENT main_quad_rev3_21_200pm_B.Gain12 "" FLOAT64_IEEE main_quad_rev3_21_200pm_CM_double 0 0 -1.7E+308 1.7E+308 ECU_ADDRESS 0x0021F310 /end MEASUREMENT
/begin MEASUREMENT main_quad_rev3_21_200pm_B.Gain13 "" FLOAT64_IEEE main_quad_rev3_21_200pm_CM_double 0 0 -1.7E+308 1.7E+308 ECU_ADDRESS 0x0021F318 /end MEASUREMENT
/begin MEASUREMENT main_quad_rev3_21_200pm_B.Gain14 "" FLOAT64_IEEE main_quad_rev3_21_200pm_CM_double 0 0 -1.7E+308 1.7E+308 ECU_ADDRESS 0x0021F320 /end MEASUREMENT
/begin MEASUREMENT main_quad_rev3_21_200pm_B.Gain15 "" FLOAT64_IEEE main_quad_rev3_21_200pm_CM_double 0 0 -1.7E+308 1.7E+308 ECU_ADDRESS 0x0021F328 /end MEASUREMENT
/begin MEASUREMENT main_quad_rev3_21_200pm_B.Gain16 "" FLOAT64_IEEE main_quad_rev3_21_200pm_CM_double 0 0 -1.7E+308 1.7E+308 ECU_ADDRESS 0x0021F330 /end MEASUREMENT
/begin MEASUREMENT main_quad_rev3_21_200pm_B.Gain17 "" FLOAT64_IEEE main_quad_rev3_21_200pm_CM_double 0 0 -1.7E+308 1.7E+308 ECU_ADDRESS 0x0021F338 /end MEASUREMENT
/begin MEASUREMENT main_quad_rev3_21_200pm_B.Gain18 "" FLOAT64_IEEE main_quad_rev3_21_200pm_CM_double 0 0 -1.7E+308 1.7E+308 ECU_ADDRESS 0x0021F340 /end MEASUREMENT
/begin MEASUREMENT main_quad_rev3_21_200pm_B.Gain19 "" FLOAT64_IEEE main_quad_rev3_21_200pm_CM_double 0 0 -1.7E+308 1.7E+308 ECU_ADDRESS 0x0021F348 /end MEASUREMENT
/begin MEASUREMENT main_quad_rev3_21_200pm_B.Gain2 "" FLOAT64_IEEE main_quad_rev3_21_200pm_CM_double 0 0 -1.7E+308 1.7E+308 ECU_ADDRESS 0x0021F2B8 /end MEASUREMENT
/begin MEASUREMENT main_quad_rev3_21_200pm_B.Gain20 "" FLOAT64_IEEE main_quad_rev3_21_200pm_CM_double 0 0 -1.7E+308 1.7E+308 ECU_ADDRESS 0x0021F350 /end MEASUREMENT
/begin MEASUREMENT main_quad_rev3_21_200pm_B.Gain21 "" FLOAT64_IEEE main_quad_rev3_21_200pm_CM_double 0 0 -1.7E+308 1.7E+308 ECU_ADDRESS 0x0021F358 /end MEASUREMENT
/begin MEASUREMENT main_quad_rev3_21_200pm_B.Gain22 "" FLOAT64_IEEE main_quad_rev3_21_200pm_CM_double 0 0 -1.7E+308 1.7E+308 ECU_ADDRESS 0x0021F360 /end MEASUREMENT
/begin MEASUREMENT main_quad_rev3_21_200pm_B.Gain23 "" FLOAT64_IEEE main_quad_rev3_21_200pm_CM_double 0 0 -1.7E+308 1.7E+308 ECU_ADDRESS 0x0021F368 /end MEASUREMENT
/begin MEASUREMENT main_quad_rev3_21_200pm_B.Gain24 "" FLOAT64_IEEE main_quad_rev3_21_200pm_CM_double 0 0 -1.7E+308 1.7E+308 ECU_ADDRESS 0x0021F380 /end MEASUREMENT
/begin MEASUREMENT main_quad_rev3_21_200pm_B.Gain25 "" FLOAT64_IEEE main_quad_rev3_21_200pm_CM_double 0 0 -1.7E+308 1.7E+308 ECU_ADDRESS 0x0021F388 /end MEASUREMENT
/begin MEASUREMENT main_quad_rev3_21_200pm_B.Gain26 "" FLOAT64_IEEE main_quad_rev3_21_200pm_CM_double 0 0 -1.7E+308 1.7E+308 ECU_ADDRESS 0x0021F2F0 /end MEASUREMENT
/begin MEASUREMENT main_quad_rev3_21_200pm_B.Gain3 "" FLOAT64_IEEE main_quad_rev3_21_200pm_CM_double 0 0 -1.7E+308 1.7E+308 ECU_ADDRESS 0x0021F2C0 /end MEASUREMENT
/begin MEASUREMENT main_quad_rev3_21_200pm_B.Gain4 "" FLOAT64_IEEE main_quad_rev3_21_200pm_CM_double 0 0 -1.7E+308 1.7E+308 ECU_ADDRESS 0x0021F2E0 /end MEASUREMENT
/begin MEASUREMENT main_quad_rev3_21_200pm_B.Gain5 "" FLOAT64_IEEE main_quad_rev3_21_200pm_CM_double 0 0 -1.7E+308 1.7E+308 ECU_ADDRESS 0x0021F2E8 /end MEASUREMENT
/begin MEASUREMENT main_quad_rev3_21_200pm_B.Gain6 "" FLOAT64_IEEE main_quad_rev3_21_200pm_CM_double 0 0 -1.7E+308 1.7E+308 ECU_ADDRESS 0x0021F2C8 /end MEASUREMENT
/begin MEASUREMENT main_quad_rev3_21_200pm_B.Gain7 "" FLOAT64_IEEE main_quad_rev3_21_200pm_CM_double 0 0 -1.7E+308 1.7E+308 ECU_ADDRESS 0x0021F2D0 /end MEASUREMENT
/begin MEASUREMENT main_quad_rev3_21_200pm_B.Gain8 "" FLOAT64_IEEE main_quad_rev3_21_200pm_CM_double 0 0 -1.7E+308 1.7E+308 ECU_ADDRESS 0x0021F2D8 /end MEASUREMENT
/begin MEASUREMENT main_quad_rev3_21_200pm_B.Gain9 "" FLOAT64_IEEE main_quad_rev3_21_200pm_CM_double 0 0 -1.7E+308 1.7E+308 ECU_ADDRESS 0x0021F2F8 /end MEASUREMENT
/begin MEASUREMENT main_quad_rev3_21_200pm_B.Kd1 "" FLOAT64_IEEE main_quad_rev3_21_200pm_CM_double 0 0 -1.7E+308 1.7E+308 ECU_ADDRESS 0x0021F520 /end MEASUREMENT
/begin MEASUREMENT main_quad_rev3_21_200pm_B.Kd2 "" FLOAT64_IEEE main_quad_rev3_21_200pm_CM_double 0 0 -1.7E+308 1.7E+308 ECU_ADDRESS 0x0021F528 /end MEASUREMENT
/begin MEASUREMENT main_quad_rev3_21_200pm_B.Kp1 "" FLOAT64_IEEE main_quad_rev3_21_200pm_CM_double 0 0 -1.7E+308 1.7E+308 ECU_ADDRESS 0x0021F510 /end MEASUREMENT
/begin MEASUREMENT main_quad_rev3_21_200pm_B.Kp2 "" FLOAT64_IEEE main_quad_rev3_21_200pm_CM_double 0 0 -1.7E+308 1.7E+308 ECU_ADDRESS 0x0021F518 /end MEASUREMENT
/begin MEASUREMENT main_quad_rev3_21_200pm_B.MultiportSwitch "" UBYTE main_quad_rev3_21_200pm_CM_uint8 0 0 0 255 LAYOUT COLUMN_DIR MATRIX_DIM 8 ECU_ADDRESS 0x0021F53C /end MEASUREMENT
/begin MEASUREMENT main_quad_rev3_21_200pm_B.MultiportSwitch_a "" UBYTE main_quad_rev3_21_200pm_CM_uint8 0 0 0 255 LAYOUT COLUMN_DIR MATRIX_DIM 8 ECU_ADDRESS 0x0021F54C /end MEASUREMENT
/begin MEASUREMENT main_quad_rev3_21_200pm_B.MultiportSwitch_c "" UBYTE main_quad_rev3_21_200pm_CM_uint8 0 0 0 255 LAYOUT COLUMN_DIR MATRIX_DIM 8 ECU_ADDRESS 0x0021F56C /end MEASUREMENT
/begin MEASUREMENT main_quad_rev3_21_200pm_B.MultiportSwitch_ce "" UBYTE main_quad_rev3_21_200pm_CM_uint8 0 0 0 255 LAYOUT COLUMN_DIR MATRIX_DIM 8 ECU_ADDRESS 0x0021F57C /end MEASUREMENT
/begin MEASUREMENT main_quad_rev3_21_200pm_B.MultiportSwitch_f "" UBYTE main_quad_rev3_21_200pm_CM_uint8 0 0 0 255 LAYOUT COLUMN_DIR MATRIX_DIM 8 ECU_ADDRESS 0x0021F5AC /end MEASUREMENT
/begin MEASUREMENT main_quad_rev3_21_200pm_B.MultiportSwitch_i "" UBYTE main_quad_rev3_21_200pm_CM_uint8 0 0 0 255 LAYOUT COLUMN_DIR MATRIX_DIM 8 ECU_ADDRESS 0x0021F58C /end MEASUREMENT
/begin MEASUREMENT main_quad_rev3_21_200pm_B.MultiportSwitch_p "" UBYTE main_quad_rev3_21_200pm_CM_uint8 0 0 0 255 LAYOUT COLUMN_DIR MATRIX_DIM 8 ECU_ADDRESS 0x0021F55C /end MEASUREMENT
/begin MEASUREMENT main_quad_rev3_21_200pm_B.MultiportSwitch_p2 "" UBYTE main_quad_rev3_21_200pm_CM_uint8 0 0 0 255 LAYOUT COLUMN_DIR MATRIX_DIM 8 ECU_ADDRESS 0x0021F59C /end MEASUREMENT
/begin MEASUREMENT main_quad_rev3_21_200pm_B.T1 "" FLOAT64_IEEE main_quad_rev3_21_200pm_CM_double 0 0 -1.7E+308 1.7E+308 ECU_ADDRESS 0x0021F500 /end MEASUREMENT
/begin MEASUREMENT main_quad_rev3_21_200pm_B.T2 "" FLOAT64_IEEE main_quad_rev3_21_200pm_CM_double 0 0 -1.7E+308 1.7E+308 ECU_ADDRESS 0x0021F508 /end MEASUREMENT
/begin MEASUREMENT main_quad_rev3_21_200pm_B.TmpSignalConversionAtSFunctionI "" FLOAT64_IEEE main_quad_rev3_21_200pm_CM_double 0 0 -1.7E+308 1.7E+308 LAYOUT COLUMN_DIR MATRIX_DIM 8 ECU_ADDRESS 0x0021F498 /end MEASUREMENT
/begin MEASUREMENT main_quad_rev3_21_200pm_B.WhileIterator "" SLONG main_quad_rev3_21_200pm_CM_int32 0 0 -2147483648 2147483647 ECU_ADDRESS 0x0021F530 /end MEASUREMENT
/begin MEASUREMENT main_quad_rev3_21_200pm_B.c "" FLOAT64_IEEE main_quad_rev3_21_200pm_CM_double 0 0 -1.7E+308 1.7E+308 ECU_ADDRESS 0x0021F4F8 /end MEASUREMENT
/begin MEASUREMENT main_quad_rev3_21_200pm_B.danger "" FLOAT64_IEEE main_quad_rev3_21_200pm_CM_double 0 0 -1.7E+308 1.7E+308 ECU_ADDRESS 0x0021F4D8 /end MEASUREMENT
/begin MEASUREMENT main_quad_rev3_21_200pm_B.sf_bytesfloats.I_ff "" FLOAT64_IEEE main_quad_rev3_21_200pm_CM_double 0 0 -1.7E+308 1.7E+308 ECU_ADDRESS 0x0021F678 /end MEASUREMENT
/begin MEASUREMENT main_quad_rev3_21_200pm_B.sf_bytesfloats.position "" FLOAT64_IEEE main_quad_rev3_21_200pm_CM_double 0 0 -1.7E+308 1.7E+308 ECU_ADDRESS 0x0021F668 /end MEASUREMENT
/begin MEASUREMENT main_quad_rev3_21_200pm_B.sf_bytesfloats.velocity "" FLOAT64_IEEE main_quad_rev3_21_200pm_CM_double 0 0 -1.7E+308 1.7E+308 ECU_ADDRESS 0x0021F670 /end MEASUREMENT
/begin MEASUREMENT main_quad_rev3_21_200pm_B.sf_bytesfloats_c.I_ff "" FLOAT64_IEEE main_quad_rev3_21_200pm_CM_double 0 0 -1.7E+308 1.7E+308 ECU_ADDRESS 0x0021F648 /end MEASUREMENT
/begin MEASUREMENT main_quad_rev3_21_200pm_B.sf_bytesfloats_c.position "" FLOAT64_IEEE main_quad_rev3_21_200pm_CM_double 0 0 -1.7E+308 1.7E+308 ECU_ADDRESS 0x0021F638 /end MEASUREMENT
/begin MEASUREMENT main_quad_rev3_21_200pm_B.sf_bytesfloats_c.velocity "" FLOAT64_IEEE main_quad_rev3_21_200pm_CM_double 0 0 -1.7E+308 1.7E+308 ECU_ADDRESS 0x0021F640 /end MEASUREMENT
/begin MEASUREMENT main_quad_rev3_21_200pm_B.sf_bytesfloats_e.I_ff "" FLOAT64_IEEE main_quad_rev3_21_200pm_CM_double 0 0 -1.7E+308 1.7E+308 ECU_ADDRESS 0x0021F660 /end MEASUREMENT
/begin MEASUREMENT main_quad_rev3_21_200pm_B.sf_bytesfloats_e.position "" FLOAT64_IEEE main_quad_rev3_21_200pm_CM_double 0 0 -1.7E+308 1.7E+308 ECU_ADDRESS 0x0021F650 /end MEASUREMENT
/begin MEASUREMENT main_quad_rev3_21_200pm_B.sf_bytesfloats_e.velocity "" FLOAT64_IEEE main_quad_rev3_21_200pm_CM_double 0 0 -1.7E+308 1.7E+308 ECU_ADDRESS 0x0021F658 /end MEASUREMENT
/begin MEASUREMENT main_quad_rev3_21_200pm_B.sf_bytesfloats_er.I_ff "" FLOAT64_IEEE main_quad_rev3_21_200pm_CM_double 0 0 -1.7E+308 1.7E+308 ECU_ADDRESS 0x0021F630 /end MEASUREMENT
/begin MEASUREMENT main_quad_rev3_21_200pm_B.sf_bytesfloats_er.position "" FLOAT64_IEEE main_quad_rev3_21_200pm_CM_double 0 0 -1.7E+308 1.7E+308 ECU_ADDRESS 0x0021F620 /end MEASUREMENT
/begin MEASUREMENT main_quad_rev3_21_200pm_B.sf_bytesfloats_er.velocity "" FLOAT64_IEEE main_quad_rev3_21_200pm_CM_double 0 0 -1.7E+308 1.7E+308 ECU_ADDRESS 0x0021F628 /end MEASUREMENT
/begin MEASUREMENT main_quad_rev3_21_200pm_B.sf_bytesfloats_f.I_ff "" FLOAT64_IEEE main_quad_rev3_21_200pm_CM_double 0 0 -1.7E+308 1.7E+308 ECU_ADDRESS 0x0021F5E8 /end MEASUREMENT
/begin MEASUREMENT main_quad_rev3_21_200pm_B.sf_bytesfloats_f.position "" FLOAT64_IEEE main_quad_rev3_21_200pm_CM_double 0 0 -1.7E+308 1.7E+308 ECU_ADDRESS 0x0021F5D8 /end MEASUREMENT
/begin MEASUREMENT main_quad_rev3_21_200pm_B.sf_bytesfloats_f.velocity "" FLOAT64_IEEE main_quad_rev3_21_200pm_CM_double 0 0 -1.7E+308 1.7E+308 ECU_ADDRESS 0x0021F5E0 /end MEASUREMENT
/begin MEASUREMENT main_quad_rev3_21_200pm_B.sf_bytesfloats_g.I_ff "" FLOAT64_IEEE main_quad_rev3_21_200pm_CM_double 0 0 -1.7E+308 1.7E+308 ECU_ADDRESS 0x0021F618 /end MEASUREMENT
/begin MEASUREMENT main_quad_rev3_21_200pm_B.sf_bytesfloats_g.position "" FLOAT64_IEEE main_quad_rev3_21_200pm_CM_double 0 0 -1.7E+308 1.7E+308 ECU_ADDRESS 0x0021F608 /end MEASUREMENT
/begin MEASUREMENT main_quad_rev3_21_200pm_B.sf_bytesfloats_g.velocity "" FLOAT64_IEEE main_quad_rev3_21_200pm_CM_double 0 0 -1.7E+308 1.7E+308 ECU_ADDRESS 0x0021F610 /end MEASUREMENT
/begin MEASUREMENT main_quad_rev3_21_200pm_B.sf_bytesfloats_i.I_ff "" FLOAT64_IEEE main_quad_rev3_21_200pm_CM_double 0 0 -1.7E+308 1.7E+308 ECU_ADDRESS 0x0021F5D0 /end MEASUREMENT
/begin MEASUREMENT main_quad_rev3_21_200pm_B.sf_bytesfloats_i.position "" FLOAT64_IEEE main_quad_rev3_21_200pm_CM_double 0 0 -1.7E+308 1.7E+308 ECU_ADDRESS 0x0021F5C0 /end MEASUREMENT
/begin MEASUREMENT main_quad_rev3_21_200pm_B.sf_bytesfloats_i.velocity "" FLOAT64_IEEE main_quad_rev3_21_200pm_CM_double 0 0 -1.7E+308 1.7E+308 ECU_ADDRESS 0x0021F5C8 /end MEASUREMENT
/begin MEASUREMENT main_quad_rev3_21_200pm_B.sf_bytesfloats_o.I_ff "" FLOAT64_IEEE main_quad_rev3_21_200pm_CM_double 0 0 -1.7E+308 1.7E+308 ECU_ADDRESS 0x0021F600 /end MEASUREMENT
/begin MEASUREMENT main_quad_rev3_21_200pm_B.sf_bytesfloats_o.position "" FLOAT64_IEEE main_quad_rev3_21_200pm_CM_double 0 0 -1.7E+308 1.7E+308 ECU_ADDRESS 0x0021F5F0 /end MEASUREMENT
/begin MEASUREMENT main_quad_rev3_21_200pm_B.sf_bytesfloats_o.velocity "" FLOAT64_IEEE main_quad_rev3_21_200pm_CM_double 0 0 -1.7E+308 1.7E+308 ECU_ADDRESS 0x0021F5F8 /end MEASUREMENT
/begin MEASUREMENT main_quad_rev3_21_200pm_B.sf_floatsbytes.b "" UBYTE main_quad_rev3_21_200pm_CM_uint8 0 0 0 255 LAYOUT COLUMN_DIR MATRIX_DIM 8 ECU_ADDRESS 0x0021F6B8 /end MEASUREMENT
/begin MEASUREMENT main_quad_rev3_21_200pm_B.sf_floatsbytes_b.b "" UBYTE main_quad_rev3_21_200pm_CM_uint8 0 0 0 255 LAYOUT COLUMN_DIR MATRIX_DIM 8 ECU_ADDRESS 0x0021F6B0 /end MEASUREMENT
/begin MEASUREMENT main_quad_rev3_21_200pm_B.sf_floatsbytes_bb.b "" UBYTE main_quad_rev3_21_200pm_CM_uint8 0 0 0 255 LAYOUT COLUMN_DIR MATRIX_DIM 8 ECU_ADDRESS 0x0021F690 /end MEASUREMENT
/begin MEASUREMENT main_quad_rev3_21_200pm_B.sf_floatsbytes_i.b "" UBYTE main_quad_rev3_21_200pm_CM_uint8 0 0 0 255 LAYOUT COLUMN_DIR MATRIX_DIM 8 ECU_ADDRESS 0x0021F6A0 /end MEASUREMENT
/begin MEASUREMENT main_quad_rev3_21_200pm_B.sf_floatsbytes_if.b "" UBYTE main_quad_rev3_21_200pm_CM_uint8 0 0 0 255 LAYOUT COLUMN_DIR MATRIX_DIM 8 ECU_ADDRESS 0x0021F698 /end MEASUREMENT
/begin MEASUREMENT main_quad_rev3_21_200pm_B.sf_floatsbytes_k.b "" UBYTE main_quad_rev3_21_200pm_CM_uint8 0 0 0 255 LAYOUT COLUMN_DIR MATRIX_DIM 8 ECU_ADDRESS 0x0021F688 /end MEASUREMENT
/begin MEASUREMENT main_quad_rev3_21_200pm_B.sf_floatsbytes_kd.b "" UBYTE main_quad_rev3_21_200pm_CM_uint8 0 0 0 255 LAYOUT COLUMN_DIR MATRIX_DIM 8 ECU_ADDRESS 0x0021F680 /end MEASUREMENT
/begin MEASUREMENT main_quad_rev3_21_200pm_B.sf_floatsbytes_o.b "" UBYTE main_quad_rev3_21_200pm_CM_uint8 0 0 0 255 LAYOUT COLUMN_DIR MATRIX_DIM 8 ECU_ADDRESS 0x0021F6A8 /end MEASUREMENT
/begin MEASUREMENT main_quad_rev3_21_200pm_B.stop "" FLOAT64_IEEE main_quad_rev3_21_200pm_CM_double 0 0 -1.7E+308 1.7E+308 ECU_ADDRESS 0x0021F4E0 /end MEASUREMENT
/begin MEASUREMENT main_quad_rev3_21_200pm_B.theta1 "" FLOAT64_IEEE main_quad_rev3_21_200pm_CM_double 0 0 -1.7E+308 1.7E+308 ECU_ADDRESS 0x0021F4E8 /end MEASUREMENT
/begin MEASUREMENT main_quad_rev3_21_200pm_B.theta2 "" FLOAT64_IEEE main_quad_rev3_21_200pm_CM_double 0 0 -1.7E+308 1.7E+308 ECU_ADDRESS 0x0021F4F0 /end MEASUREMENT
/begin MEASUREMENT main_quad_rev3_21_200pm_DW.CANUnpack_ModeSignalID "" SLONG main_quad_rev3_21_200pm_CM_int_T 0 0 -2147483648 2147483647 ECU_ADDRESS 0x0021F134 /end MEASUREMENT
/begin MEASUREMENT main_quad_rev3_21_200pm_DW.CANUnpack_ModeSignalID_d "" SLONG main_quad_rev3_21_200pm_CM_int_T 0 0 -2147483648 2147483647 ECU_ADDRESS 0x0021F13C /end MEASUREMENT
/begin MEASUREMENT main_quad_rev3_21_200pm_DW.CANUnpack_ModeSignalID_du "" SLONG main_quad_rev3_21_200pm_CM_int_T 0 0 -2147483648 2147483647 ECU_ADDRESS 0x0021F16C /end MEASUREMENT
/begin MEASUREMENT main_quad_rev3_21_200pm_DW.CANUnpack_ModeSignalID_dx "" SLONG main_quad_rev3_21_200pm_CM_int_T 0 0 -2147483648 2147483647 ECU_ADDRESS 0x0021F144 /end MEASUREMENT
/begin MEASUREMENT main_quad_rev3_21_200pm_DW.CANUnpack_ModeSignalID_h "" SLONG main_quad_rev3_21_200pm_CM_int_T 0 0 -2147483648 2147483647 ECU_ADDRESS 0x0021F14C /end MEASUREMENT
/begin MEASUREMENT main_quad_rev3_21_200pm_DW.CANUnpack_ModeSignalID_hh "" SLONG main_quad_rev3_21_200pm_CM_int_T 0 0 -2147483648 2147483647 ECU_ADDRESS 0x0021F154 /end MEASUREMENT
/begin MEASUREMENT main_quad_rev3_21_200pm_DW.CANUnpack_ModeSignalID_j "" SLONG main_quad_rev3_21_200pm_CM_int_T 0 0 -2147483648 2147483647 ECU_ADDRESS 0x0021F15C /end MEASUREMENT
/begin MEASUREMENT main_quad_rev3_21_200pm_DW.CANUnpack_ModeSignalID_n "" SLONG main_quad_rev3_21_200pm_CM_int_T 0 0 -2147483648 2147483647 ECU_ADDRESS 0x0021F164 /end MEASUREMENT
/begin MEASUREMENT main_quad_rev3_21_200pm_DW.CANUnpack_StatusPortID "" SLONG main_quad_rev3_21_200pm_CM_int_T 0 0 -2147483648 2147483647 ECU_ADDRESS 0x0021F138 /end MEASUREMENT
/begin MEASUREMENT main_quad_rev3_21_200pm_DW.CANUnpack_StatusPortID_a "" SLONG main_quad_rev3_21_200pm_CM_int_T 0 0 -2147483648 2147483647 ECU_ADDRESS 0x0021F140 /end MEASUREMENT
/begin MEASUREMENT main_quad_rev3_21_200pm_DW.CANUnpack_StatusPortID_c "" SLONG main_quad_rev3_21_200pm_CM_int_T 0 0 -2147483648 2147483647 ECU_ADDRESS 0x0021F158 /end MEASUREMENT
/begin MEASUREMENT main_quad_rev3_21_200pm_DW.CANUnpack_StatusPortID_f "" SLONG main_quad_rev3_21_200pm_CM_int_T 0 0 -2147483648 2147483647 ECU_ADDRESS 0x0021F170 /end MEASUREMENT
/begin MEASUREMENT main_quad_rev3_21_200pm_DW.CANUnpack_StatusPortID_h "" SLONG main_quad_rev3_21_200pm_CM_int_T 0 0 -2147483648 2147483647 ECU_ADDRESS 0x0021F160 /end MEASUREMENT
/begin MEASUREMENT main_quad_rev3_21_200pm_DW.CANUnpack_StatusPortID_j "" SLONG main_quad_rev3_21_200pm_CM_int_T 0 0 -2147483648 2147483647 ECU_ADDRESS 0x0021F150 /end MEASUREMENT
/begin MEASUREMENT main_quad_rev3_21_200pm_DW.CANUnpack_StatusPortID_m "" SLONG main_quad_rev3_21_200pm_CM_int_T 0 0 -2147483648 2147483647 ECU_ADDRESS 0x0021F168 /end MEASUREMENT
/begin MEASUREMENT main_quad_rev3_21_200pm_DW.CANUnpack_StatusPortID_n "" SLONG main_quad_rev3_21_200pm_CM_int_T 0 0 -2147483648 2147483647 ECU_ADDRESS 0x0021F148 /end MEASUREMENT
/begin MEASUREMENT main_quad_rev3_21_200pm_DW.Delay1_DSTATE "" FLOAT64_IEEE main_quad_rev3_21_200pm_CM_double 0 0 -1.7E+308 1.7E+308 ECU_ADDRESS 0x0021EE88 /end MEASUREMENT
/begin MEASUREMENT main_quad_rev3_21_200pm_DW.Delay_DSTATE "" FLOAT64_IEEE main_quad_rev3_21_200pm_CM_double 0 0 -1.7E+308 1.7E+308 ECU_ADDRESS 0x0021EE80 /end MEASUREMENT
/begin MEASUREMENT main_quad_rev3_21_200pm_DW.Th2Th1 "" FLOAT64_IEEE main_quad_rev3_21_200pm_CM_double 0 0 -1.7E+308 1.7E+308 ECU_ADDRESS 0x0021EED0 /end MEASUREMENT
/begin MEASUREMENT main_quad_rev3_21_200pm_DW.done "" FLOAT64_IEEE main_quad_rev3_21_200pm_CM_double 0 0 -1.7E+308 1.7E+308 ECU_ADDRESS 0x0021EE90 /end MEASUREMENT
/begin MEASUREMENT main_quad_rev3_21_200pm_DW.is_Command "" ULONG main_quad_rev3_21_200pm_CM_uint32 0 0 0 2147483646 ECU_ADDRESS 0x0021F0A8 /end MEASUREMENT
/begin MEASUREMENT main_quad_rev3_21_200pm_DW.is_active_c8_main_quad_rev3_21_ "" UBYTE main_quad_rev3_21_200pm_CM_uint8 0 0 0 255 ECU_ADDRESS 0x0021F1B6 /end MEASUREMENT
/begin MEASUREMENT main_quad_rev3_21_200pm_DW.is_c8_main_quad_rev3_21_200pm "" ULONG main_quad_rev3_21_200pm_CM_uint32 0 0 0 2147483646 ECU_ADDRESS 0x0021F0A4 /end MEASUREMENT
/begin MEASUREMENT main_quad_rev3_21_200pm_DW.pf "" FLOAT64_IEEE main_quad_rev3_21_200pm_CM_double 0 0 -1.7E+308 1.7E+308 ECU_ADDRESS 0x0021EE98 /end MEASUREMENT
/begin MEASUREMENT main_quad_rev3_21_200pm_DW.po1 "" FLOAT64_IEEE main_quad_rev3_21_200pm_CM_double 0 0 -1.7E+308 1.7E+308 ECU_ADDRESS 0x0021EEB0 /end MEASUREMENT
/begin MEASUREMENT main_quad_rev3_21_200pm_DW.po2 "" FLOAT64_IEEE main_quad_rev3_21_200pm_CM_double 0 0 -1.7E+308 1.7E+308 ECU_ADDRESS 0x0021EEB8 /end MEASUREMENT
/begin MEASUREMENT main_quad_rev3_21_200pm_DW.sfEvent "" SLONG main_quad_rev3_21_200pm_CM_int32 0 0 -2147483648 2147483647 ECU_ADDRESS 0x0021F0A0 /end MEASUREMENT
/begin MEASUREMENT main_quad_rev3_21_200pm_DW.slope1 "" FLOAT64_IEEE main_quad_rev3_21_200pm_CM_double 0 0 -1.7E+308 1.7E+308 ECU_ADDRESS 0x0021EEC0 /end MEASUREMENT
/begin MEASUREMENT main_quad_rev3_21_200pm_DW.slope2 "" FLOAT64_IEEE main_quad_rev3_21_200pm_CM_double 0 0 -1.7E+308 1.7E+308 ECU_ADDRESS 0x0021EEC8 /end MEASUREMENT
/begin MEASUREMENT main_quad_rev3_21_200pm_DW.temporalCounter_i1 "" UWORD main_quad_rev3_21_200pm_CM_uint16 0 0 0 65535 ECU_ADDRESS 0x0021F1B4 /end MEASUREMENT
/begin MEASUREMENT main_quad_rev3_21_200pm_DW.to "" FLOAT64_IEEE main_quad_rev3_21_200pm_CM_double 0 0 -1.7E+308 1.7E+308 ECU_ADDRESS 0x0021EEA8 /end MEASUREMENT
/begin MEASUREMENT main_quad_rev3_21_200pm_DW.tstep "" FLOAT64_IEEE main_quad_rev3_21_200pm_CM_double 0 0 -1.7E+308 1.7E+308 ECU_ADDRESS 0x0021EEA0 /end MEASUREMENT
/begin COMPU_METHOD main_quad_rev3_21_200pm_CM_double "" IDENTICAL "%15.10" "" /end COMPU_METHOD
/begin COMPU_METHOD main_quad_rev3_21_200pm_CM_int32 "" IDENTICAL "%10.0" "" /end COMPU_METHOD
/begin COMPU_METHOD main_quad_rev3_21_200pm_CM_int_T "" IDENTICAL "customformat" "" /end COMPU_METHOD
/begin COMPU_METHOD main_quad_rev3_21_200pm_CM_logical "" IDENTICAL "%1.0" "" /end COMPU_METHOD
/begin COMPU_METHOD main_quad_rev3_21_200pm_CM_uint16 "" IDENTICAL "%5.0" "" /end COMPU_METHOD
/begin COMPU_METHOD main_quad_rev3_21_200pm_CM_uint32 "" IDENTICAL "%10.0" "" /end COMPU_METHOD
/begin COMPU_METHOD main_quad_rev3_21_200pm_CM_uint8 "" IDENTICAL "%3.0" "" /end COMPU_METHOD
/begin RECORD_LAYOUT Scalar_BOOLEAN FNC_VALUES 1 UBYTE COLUMN_DIR DIRECT /end RECORD_LAYOUT
/begin RECORD_LAYOUT Scalar_FLOAT64_IEEE FNC_VALUES 1 FLOAT64_IEEE COLUMN_DIR DIRECT /end RECORD_LAYOUT
/begin RECORD_LAYOUT Scalar_SLONG FNC_VALUES 1 SLONG COLUMN_DIR DIRECT /end RECORD_LAYOUT
/begin RECORD_LAYOUT Scalar_UBYTE FNC_VALUES 1 UBYTE COLUMN_DIR DIRECT /end RECORD_LAYOUT
/begin RECORD_LAYOUT Scalar_ULONG FNC_VALUES 1 ULONG COLUMN_DIR DIRECT /end RECORD_LAYOUT
/begin RECORD_LAYOUT Scalar_UWORD FNC_VALUES 1 UWORD COLUMN_DIR DIRECT /end RECORD_LAYOUT
/begin GROUP main_quad_rev3_21_200pm "main_quad_rev3_21_200pm" ROOT /end GROUP
/end MODULE
/end PROJECT
