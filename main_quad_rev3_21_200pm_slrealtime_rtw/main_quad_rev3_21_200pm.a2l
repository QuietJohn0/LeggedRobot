/******************************************************************************
* ASAP2 file: main_quad_rev3_21_200pm.a2l
* Academic License - for use in teaching, academic research, and meeting
* course requirements at degree granting institutions only. Not for
* government, commercial, or other organizational use.
* Code generation for model "main_quad_rev3_21_200pm".
* Model version : 1.50
* Simulink Coder version : 10.3 R2021a
* C source code generated on : Sat May 21 16:38:08 2022
* Target selection: slrealtime.tlc
* Embedded hardware selection: Intel->x86-64 (Linux 64)
* Code generation objectives: Unspecified
* Validation result: Not run
* (add additional file header information here)
******************************************************************************/ ASAP2_VERSION 1 71
/begin PROJECT ProjectName "Project Comment Goes Here"
/begin HEADER "Header Comments go here" /end HEADER
/begin MODULE ModuleName "Module Comment Goes Here"
/begin IF_DATA XCP
 /begin PROTOCOL_LAYER 0x0100 0x03E8 0x00C8 0x0000 0x0000 0x0000 0x0000 0x0000 0xFC 0x0578 BYTE_ORDER_MSB_LAST ADDRESS_GRANULARITY_BYTE OPTIONAL_CMD ALLOC_ODT_ENTRY OPTIONAL_CMD ALLOC_ODT OPTIONAL_CMD ALLOC_DAQ OPTIONAL_CMD FREE_DAQ OPTIONAL_CMD GET_DAQ_RESOLUTION_INFO OPTIONAL_CMD GET_DAQ_PROCESSOR_INFO OPTIONAL_CMD START_STOP_SYNCH OPTIONAL_CMD START_STOP_DAQ_LIST OPTIONAL_CMD SET_DAQ_LIST_MODE OPTIONAL_CMD WRITE_DAQ OPTIONAL_CMD SET_DAQ_PTR OPTIONAL_CMD GET_CAL_PAGE OPTIONAL_CMD SET_CAL_PAGE OPTIONAL_CMD COPY_CAL_PAGE OPTIONAL_CMD SHORT_DOWNLOAD OPTIONAL_CMD DOWNLOAD_MAX OPTIONAL_CMD DOWNLOAD OPTIONAL_CMD SHORT_UPLOAD OPTIONAL_CMD UPLOAD OPTIONAL_CMD SET_MTA /end PROTOCOL_LAYER
 /begin DAQ DYNAMIC 0x0000 0x0080 0x00 OPTIMISATION_TYPE_DEFAULT ADDRESS_EXTENSION_FREE IDENTIFICATION_FIELD_TYPE_RELATIVE_WORD_ALIGNED GRANULARITY_ODT_ENTRY_SIZE_DAQ_BYTE 0xFF OVERLOAD_INDICATION_PID PRESCALER_SUPPORTED /begin STIM GRANULARITY_ODT_ENTRY_SIZE_STIM_BYTE 0xFF /end STIM /begin TIMESTAMP_SUPPORTED 0x0001 SIZE_DWORD UNIT_1US TIMESTAMP_FIXED /end TIMESTAMP_SUPPORTED /begin EVENT "5 ms" "5 ms" 0x0000 DAQ 0xFF 0x05 0x06 0x00 /end EVENT /end DAQ
 /begin XCP_ON_UDP_IP 0x0100 0x15B3 ADDRESS "192.168.7.5" /end XCP_ON_UDP_IP
/end IF_DATA
/begin MOD_PAR "MOD PAR Comment Goes Here"
 /begin MEMORY_SEGMENT main_quad_rev3_21_200p_cal_impl "main_quad_rev3_21_200p_cal_impl" DATA FLASH INTERN 0x00219020 0x968 -1 -1 -1 -1 -1
  /begin IF_DATA XCP
   /begin SEGMENT 0x00 0x02 0x00 0x00 0x00
    /begin PAGE 0x00 ECU_ACCESS_DONT_CARE XCP_READ_ACCESS_DONT_CARE XCP_WRITE_ACCESS_NOT_ALLOWED /end PAGE
    /begin PAGE 0x01 ECU_ACCESS_DONT_CARE XCP_READ_ACCESS_DONT_CARE XCP_WRITE_ACCESS_DONT_CARE /end PAGE
   /end SEGMENT
  /end IF_DATA
 /end MEMORY_SEGMENT
/end MOD_PAR
/begin MOD_COMMON "Mod Common Comment Here" BYTE_ORDER MSB_LAST ALIGNMENT_BYTE 1 ALIGNMENT_WORD 2 ALIGNMENT_LONG 8 ALIGNMENT_FLOAT32_IEEE 4 ALIGNMENT_FLOAT64_IEEE 8 ALIGNMENT_INT64 4 /end MOD_COMMON
/begin CHARACTERISTIC main_quad_rev3_21_200p_cal_impl.CANRead_P1 "" VAL_BLK 0x00219290 Scalar_FLOAT64_IEEE 0 main_quad_rev3_21_200pm_CM_double -1.7E+308 1.7E+308 MATRIX_DIM 6 1 /end CHARACTERISTIC
/begin CHARACTERISTIC main_quad_rev3_21_200p_cal_impl.CANRead_P1_j "" VAL_BLK 0x002192F0 Scalar_FLOAT64_IEEE 0 main_quad_rev3_21_200pm_CM_double -1.7E+308 1.7E+308 MATRIX_DIM 6 1 /end CHARACTERISTIC
/begin CHARACTERISTIC main_quad_rev3_21_200p_cal_impl.CANSetup_P1 "" VAL_BLK 0x00219330 Scalar_FLOAT64_IEEE 0 main_quad_rev3_21_200pm_CM_double -1.7E+308 1.7E+308 MATRIX_DIM 40 1 /end CHARACTERISTIC
/begin CHARACTERISTIC main_quad_rev3_21_200p_cal_impl.CANSetup_P2 "" VALUE 0x00219480 Scalar_FLOAT64_IEEE 0 main_quad_rev3_21_200pm_CM_double -1.7E+308 1.7E+308 /end CHARACTERISTIC
/begin CHARACTERISTIC main_quad_rev3_21_200p_cal_impl.CANSetup_P3 "" VALUE 0x00219498 Scalar_FLOAT64_IEEE 0 main_quad_rev3_21_200pm_CM_double -1.7E+308 1.7E+308 /end CHARACTERISTIC
/begin CHARACTERISTIC main_quad_rev3_21_200p_cal_impl.CANStatus_P1 "" VALUE 0x002195A8 Scalar_FLOAT64_IEEE 0 main_quad_rev3_21_200pm_CM_double -1.7E+308 1.7E+308 /end CHARACTERISTIC
/begin CHARACTERISTIC main_quad_rev3_21_200p_cal_impl.CANStatus_P10 "" VALUE 0x00219680 Scalar_FLOAT64_IEEE 0 main_quad_rev3_21_200pm_CM_double -1.7E+308 1.7E+308 /end CHARACTERISTIC
/begin CHARACTERISTIC main_quad_rev3_21_200p_cal_impl.CANStatus_P11 "" VALUE 0x00219698 Scalar_FLOAT64_IEEE 0 main_quad_rev3_21_200pm_CM_double -1.7E+308 1.7E+308 /end CHARACTERISTIC
/begin CHARACTERISTIC main_quad_rev3_21_200p_cal_impl.CANStatus_P12 "" VALUE 0x002196B0 Scalar_FLOAT64_IEEE 0 main_quad_rev3_21_200pm_CM_double -1.7E+308 1.7E+308 /end CHARACTERISTIC
/begin CHARACTERISTIC main_quad_rev3_21_200p_cal_impl.CANStatus_P13 "" VALUE 0x002196C8 Scalar_FLOAT64_IEEE 0 main_quad_rev3_21_200pm_CM_double -1.7E+308 1.7E+308 /end CHARACTERISTIC
/begin CHARACTERISTIC main_quad_rev3_21_200p_cal_impl.CANStatus_P14 "" VALUE 0x002196E0 Scalar_FLOAT64_IEEE 0 main_quad_rev3_21_200pm_CM_double -1.7E+308 1.7E+308 /end CHARACTERISTIC
/begin CHARACTERISTIC main_quad_rev3_21_200p_cal_impl.CANStatus_P15 "" VALUE 0x002196F8 Scalar_FLOAT64_IEEE 0 main_quad_rev3_21_200pm_CM_double -1.7E+308 1.7E+308 /end CHARACTERISTIC
/begin CHARACTERISTIC main_quad_rev3_21_200p_cal_impl.CANStatus_P16 "" VALUE 0x00219710 Scalar_FLOAT64_IEEE 0 main_quad_rev3_21_200pm_CM_double -1.7E+308 1.7E+308 /end CHARACTERISTIC
/begin CHARACTERISTIC main_quad_rev3_21_200p_cal_impl.CANStatus_P17 "" VALUE 0x00219728 Scalar_FLOAT64_IEEE 0 main_quad_rev3_21_200pm_CM_double -1.7E+308 1.7E+308 /end CHARACTERISTIC
/begin CHARACTERISTIC main_quad_rev3_21_200p_cal_impl.CANStatus_P18 "" VALUE 0x00219740 Scalar_FLOAT64_IEEE 0 main_quad_rev3_21_200pm_CM_double -1.7E+308 1.7E+308 /end CHARACTERISTIC
/begin CHARACTERISTIC main_quad_rev3_21_200p_cal_impl.CANStatus_P19 "" VALUE 0x00219758 Scalar_FLOAT64_IEEE 0 main_quad_rev3_21_200pm_CM_double -1.7E+308 1.7E+308 /end CHARACTERISTIC
/begin CHARACTERISTIC main_quad_rev3_21_200p_cal_impl.CANStatus_P2 "" VALUE 0x002195C0 Scalar_FLOAT64_IEEE 0 main_quad_rev3_21_200pm_CM_double -1.7E+308 1.7E+308 /end CHARACTERISTIC
/begin CHARACTERISTIC main_quad_rev3_21_200p_cal_impl.CANStatus_P20 "" VALUE 0x00219770 Scalar_FLOAT64_IEEE 0 main_quad_rev3_21_200pm_CM_double -1.7E+308 1.7E+308 /end CHARACTERISTIC
/begin CHARACTERISTIC main_quad_rev3_21_200p_cal_impl.CANStatus_P21 "" VALUE 0x00219788 Scalar_FLOAT64_IEEE 0 main_quad_rev3_21_200pm_CM_double -1.7E+308 1.7E+308 /end CHARACTERISTIC
/begin CHARACTERISTIC main_quad_rev3_21_200p_cal_impl.CANStatus_P22 "" VALUE 0x002197A0 Scalar_FLOAT64_IEEE 0 main_quad_rev3_21_200pm_CM_double -1.7E+308 1.7E+308 /end CHARACTERISTIC
/begin CHARACTERISTIC main_quad_rev3_21_200p_cal_impl.CANStatus_P23 "" VALUE 0x002197B8 Scalar_FLOAT64_IEEE 0 main_quad_rev3_21_200pm_CM_double -1.7E+308 1.7E+308 /end CHARACTERISTIC
/begin CHARACTERISTIC main_quad_rev3_21_200p_cal_impl.CANStatus_P24 "" VALUE 0x002197D0 Scalar_FLOAT64_IEEE 0 main_quad_rev3_21_200pm_CM_double -1.7E+308 1.7E+308 /end CHARACTERISTIC
/begin CHARACTERISTIC main_quad_rev3_21_200p_cal_impl.CANStatus_P25 "" VALUE 0x002197E8 Scalar_FLOAT64_IEEE 0 main_quad_rev3_21_200pm_CM_double -1.7E+308 1.7E+308 /end CHARACTERISTIC
/begin CHARACTERISTIC main_quad_rev3_21_200p_cal_impl.CANStatus_P26 "" VALUE 0x00219800 Scalar_FLOAT64_IEEE 0 main_quad_rev3_21_200pm_CM_double -1.7E+308 1.7E+308 /end CHARACTERISTIC
/begin CHARACTERISTIC main_quad_rev3_21_200p_cal_impl.CANStatus_P27 "" VALUE 0x00219818 Scalar_FLOAT64_IEEE 0 main_quad_rev3_21_200pm_CM_double -1.7E+308 1.7E+308 /end CHARACTERISTIC
/begin CHARACTERISTIC main_quad_rev3_21_200p_cal_impl.CANStatus_P28 "" VALUE 0x00219830 Scalar_FLOAT64_IEEE 0 main_quad_rev3_21_200pm_CM_double -1.7E+308 1.7E+308 /end CHARACTERISTIC
/begin CHARACTERISTIC main_quad_rev3_21_200p_cal_impl.CANStatus_P29 "" VALUE 0x00219848 Scalar_FLOAT64_IEEE 0 main_quad_rev3_21_200pm_CM_double -1.7E+308 1.7E+308 /end CHARACTERISTIC
/begin CHARACTERISTIC main_quad_rev3_21_200p_cal_impl.CANStatus_P3 "" VALUE 0x002195D8 Scalar_FLOAT64_IEEE 0 main_quad_rev3_21_200pm_CM_double -1.7E+308 1.7E+308 /end CHARACTERISTIC
/begin CHARACTERISTIC main_quad_rev3_21_200p_cal_impl.CANStatus_P30 "" VALUE 0x00219860 Scalar_FLOAT64_IEEE 0 main_quad_rev3_21_200pm_CM_double -1.7E+308 1.7E+308 /end CHARACTERISTIC
/begin CHARACTERISTIC main_quad_rev3_21_200p_cal_impl.CANStatus_P31 "" VALUE 0x00219878 Scalar_FLOAT64_IEEE 0 main_quad_rev3_21_200pm_CM_double -1.7E+308 1.7E+308 /end CHARACTERISTIC
/begin CHARACTERISTIC main_quad_rev3_21_200p_cal_impl.CANStatus_P32 "" VALUE 0x00219890 Scalar_FLOAT64_IEEE 0 main_quad_rev3_21_200pm_CM_double -1.7E+308 1.7E+308 /end CHARACTERISTIC
/begin CHARACTERISTIC main_quad_rev3_21_200p_cal_impl.CANStatus_P33 "" VALUE 0x002198A8 Scalar_FLOAT64_IEEE 0 main_quad_rev3_21_200pm_CM_double -1.7E+308 1.7E+308 /end CHARACTERISTIC
/begin CHARACTERISTIC main_quad_rev3_21_200p_cal_impl.CANStatus_P34 "" VALUE 0x002198C0 Scalar_FLOAT64_IEEE 0 main_quad_rev3_21_200pm_CM_double -1.7E+308 1.7E+308 /end CHARACTERISTIC
/begin CHARACTERISTIC main_quad_rev3_21_200p_cal_impl.CANStatus_P4 "" VALUE 0x002195F0 Scalar_FLOAT64_IEEE 0 main_quad_rev3_21_200pm_CM_double -1.7E+308 1.7E+308 /end CHARACTERISTIC
/begin CHARACTERISTIC main_quad_rev3_21_200p_cal_impl.CANStatus_P5 "" VALUE 0x00219608 Scalar_FLOAT64_IEEE 0 main_quad_rev3_21_200pm_CM_double -1.7E+308 1.7E+308 /end CHARACTERISTIC
/begin CHARACTERISTIC main_quad_rev3_21_200p_cal_impl.CANStatus_P6 "" VALUE 0x00219620 Scalar_FLOAT64_IEEE 0 main_quad_rev3_21_200pm_CM_double -1.7E+308 1.7E+308 /end CHARACTERISTIC
/begin CHARACTERISTIC main_quad_rev3_21_200p_cal_impl.CANStatus_P7 "" VALUE 0x00219638 Scalar_FLOAT64_IEEE 0 main_quad_rev3_21_200pm_CM_double -1.7E+308 1.7E+308 /end CHARACTERISTIC
/begin CHARACTERISTIC main_quad_rev3_21_200p_cal_impl.CANStatus_P8 "" VALUE 0x00219650 Scalar_FLOAT64_IEEE 0 main_quad_rev3_21_200pm_CM_double -1.7E+308 1.7E+308 /end CHARACTERISTIC
/begin CHARACTERISTIC main_quad_rev3_21_200p_cal_impl.CANStatus_P9 "" VALUE 0x00219668 Scalar_FLOAT64_IEEE 0 main_quad_rev3_21_200pm_CM_double -1.7E+308 1.7E+308 /end CHARACTERISTIC
/begin CHARACTERISTIC main_quad_rev3_21_200p_cal_impl.CANWrite1_P1 "" VAL_BLK 0x00219030 Scalar_FLOAT64_IEEE 0 main_quad_rev3_21_200pm_CM_double -1.7E+308 1.7E+308 MATRIX_DIM 7 1 /end CHARACTERISTIC
/begin CHARACTERISTIC main_quad_rev3_21_200p_cal_impl.CANWrite1_P1_d "" VAL_BLK 0x00219198 Scalar_FLOAT64_IEEE 0 main_quad_rev3_21_200pm_CM_double -1.7E+308 1.7E+308 MATRIX_DIM 7 1 /end CHARACTERISTIC
/begin CHARACTERISTIC main_quad_rev3_21_200p_cal_impl.CANWrite1_P1_j "" VAL_BLK 0x002190C0 Scalar_FLOAT64_IEEE 0 main_quad_rev3_21_200pm_CM_double -1.7E+308 1.7E+308 MATRIX_DIM 7 1 /end CHARACTERISTIC
/begin CHARACTERISTIC main_quad_rev3_21_200p_cal_impl.CANWrite1_P1_je "" VAL_BLK 0x00219108 Scalar_FLOAT64_IEEE 0 main_quad_rev3_21_200pm_CM_double -1.7E+308 1.7E+308 MATRIX_DIM 7 1 /end CHARACTERISTIC
/begin CHARACTERISTIC main_quad_rev3_21_200p_cal_impl.CANWrite1_P1_l "" VAL_BLK 0x00219078 Scalar_FLOAT64_IEEE 0 main_quad_rev3_21_200pm_CM_double -1.7E+308 1.7E+308 MATRIX_DIM 7 1 /end CHARACTERISTIC
/begin CHARACTERISTIC main_quad_rev3_21_200p_cal_impl.CANWrite1_P1_n "" VAL_BLK 0x00219150 Scalar_FLOAT64_IEEE 0 main_quad_rev3_21_200pm_CM_double -1.7E+308 1.7E+308 MATRIX_DIM 7 1 /end CHARACTERISTIC
/begin CHARACTERISTIC main_quad_rev3_21_200p_cal_impl.CANWrite1_P1_nj "" VAL_BLK 0x002191E0 Scalar_FLOAT64_IEEE 0 main_quad_rev3_21_200pm_CM_double -1.7E+308 1.7E+308 MATRIX_DIM 7 1 /end CHARACTERISTIC
/begin CHARACTERISTIC main_quad_rev3_21_200p_cal_impl.CANWrite1_P1_p "" VAL_BLK 0x00219228 Scalar_FLOAT64_IEEE 0 main_quad_rev3_21_200pm_CM_double -1.7E+308 1.7E+308 MATRIX_DIM 7 1 /end CHARACTERISTIC
/begin CHARACTERISTIC main_quad_rev3_21_200p_cal_impl.Constant1_Value "" VAL_BLK 0x002198D0 Scalar_UBYTE 0 main_quad_rev3_21_200pm_CM_uint8 0 255 MATRIX_DIM 8 1 /end CHARACTERISTIC
/begin CHARACTERISTIC main_quad_rev3_21_200p_cal_impl.Constant1_Value_a "" VAL_BLK 0x00219978 Scalar_UBYTE 0 main_quad_rev3_21_200pm_CM_uint8 0 255 MATRIX_DIM 8 1 /end CHARACTERISTIC
/begin CHARACTERISTIC main_quad_rev3_21_200p_cal_impl.Constant1_Value_e "" VAL_BLK 0x00219900 Scalar_UBYTE 0 main_quad_rev3_21_200pm_CM_uint8 0 255 MATRIX_DIM 8 1 /end CHARACTERISTIC
/begin CHARACTERISTIC main_quad_rev3_21_200p_cal_impl.Constant1_Value_f "" VAL_BLK 0x00219918 Scalar_UBYTE 0 main_quad_rev3_21_200pm_CM_uint8 0 255 MATRIX_DIM 8 1 /end CHARACTERISTIC
/begin CHARACTERISTIC main_quad_rev3_21_200p_cal_impl.Constant1_Value_h "" VAL_BLK 0x00219930 Scalar_UBYTE 0 main_quad_rev3_21_200pm_CM_uint8 0 255 MATRIX_DIM 8 1 /end CHARACTERISTIC
/begin CHARACTERISTIC main_quad_rev3_21_200p_cal_impl.Constant1_Value_i "" VAL_BLK 0x00219948 Scalar_UBYTE 0 main_quad_rev3_21_200pm_CM_uint8 0 255 MATRIX_DIM 8 1 /end CHARACTERISTIC
/begin CHARACTERISTIC main_quad_rev3_21_200p_cal_impl.Constant1_Value_k "" VAL_BLK 0x002198E8 Scalar_UBYTE 0 main_quad_rev3_21_200pm_CM_uint8 0 255 MATRIX_DIM 8 1 /end CHARACTERISTIC
/begin CHARACTERISTIC main_quad_rev3_21_200p_cal_impl.Constant1_Value_m "" VAL_BLK 0x00219960 Scalar_UBYTE 0 main_quad_rev3_21_200pm_CM_uint8 0 255 MATRIX_DIM 8 1 /end CHARACTERISTIC
/begin CHARACTERISTIC main_quad_rev3_21_200p_cal_impl.Constant2_Value "" VALUE 0x002194F8 Scalar_FLOAT64_IEEE 0 main_quad_rev3_21_200pm_CM_double -1.7E+308 1.7E+308 /end CHARACTERISTIC
/begin CHARACTERISTIC main_quad_rev3_21_200p_cal_impl.Constant2_Value_a "" VAL_BLK 0x00219980 Scalar_UBYTE 0 main_quad_rev3_21_200pm_CM_uint8 0 255 MATRIX_DIM 8 1 /end CHARACTERISTIC
/begin CHARACTERISTIC main_quad_rev3_21_200p_cal_impl.Constant2_Value_d "" VAL_BLK 0x002198F0 Scalar_UBYTE 0 main_quad_rev3_21_200pm_CM_uint8 0 255 MATRIX_DIM 8 1 /end CHARACTERISTIC
/begin CHARACTERISTIC main_quad_rev3_21_200p_cal_impl.Constant2_Value_g "" VAL_BLK 0x002198D8 Scalar_UBYTE 0 main_quad_rev3_21_200pm_CM_uint8 0 255 MATRIX_DIM 8 1 /end CHARACTERISTIC
/begin CHARACTERISTIC main_quad_rev3_21_200p_cal_impl.Constant2_Value_i "" VAL_BLK 0x00219968 Scalar_UBYTE 0 main_quad_rev3_21_200pm_CM_uint8 0 255 MATRIX_DIM 8 1 /end CHARACTERISTIC
/begin CHARACTERISTIC main_quad_rev3_21_200p_cal_impl.Constant2_Value_j "" VAL_BLK 0x00219920 Scalar_UBYTE 0 main_quad_rev3_21_200pm_CM_uint8 0 255 MATRIX_DIM 8 1 /end CHARACTERISTIC
/begin CHARACTERISTIC main_quad_rev3_21_200p_cal_impl.Constant2_Value_k "" VAL_BLK 0x00219908 Scalar_UBYTE 0 main_quad_rev3_21_200pm_CM_uint8 0 255 MATRIX_DIM 8 1 /end CHARACTERISTIC
/begin CHARACTERISTIC main_quad_rev3_21_200p_cal_impl.Constant2_Value_l "" VAL_BLK 0x00219950 Scalar_UBYTE 0 main_quad_rev3_21_200pm_CM_uint8 0 255 MATRIX_DIM 8 1 /end CHARACTERISTIC
/begin CHARACTERISTIC main_quad_rev3_21_200p_cal_impl.Constant2_Value_n "" VAL_BLK 0x00219938 Scalar_UBYTE 0 main_quad_rev3_21_200pm_CM_uint8 0 255 MATRIX_DIM 8 1 /end CHARACTERISTIC
/begin CHARACTERISTIC main_quad_rev3_21_200p_cal_impl.Constant8_Value "" VALUE 0x002194C0 Scalar_FLOAT64_IEEE 0 main_quad_rev3_21_200pm_CM_double -1.7E+308 1.7E+308 /end CHARACTERISTIC
/begin CHARACTERISTIC main_quad_rev3_21_200p_cal_impl.Constant_Value "" VALUE 0x002194B0 Scalar_FLOAT64_IEEE 0 main_quad_rev3_21_200pm_CM_double -1.7E+308 1.7E+308 /end CHARACTERISTIC
/begin CHARACTERISTIC main_quad_rev3_21_200p_cal_impl.Constant_Value_b "" VAL_BLK 0x00219928 Scalar_UBYTE 0 main_quad_rev3_21_200pm_CM_uint8 0 255 MATRIX_DIM 8 1 /end CHARACTERISTIC
/begin CHARACTERISTIC main_quad_rev3_21_200p_cal_impl.Constant_Value_bb "" VAL_BLK 0x00219940 Scalar_UBYTE 0 main_quad_rev3_21_200pm_CM_uint8 0 255 MATRIX_DIM 8 1 /end CHARACTERISTIC
/begin CHARACTERISTIC main_quad_rev3_21_200p_cal_impl.Constant_Value_i "" VAL_BLK 0x002198F8 Scalar_UBYTE 0 main_quad_rev3_21_200pm_CM_uint8 0 255 MATRIX_DIM 8 1 /end CHARACTERISTIC
/begin CHARACTERISTIC main_quad_rev3_21_200p_cal_impl.Constant_Value_l "" VAL_BLK 0x002198C8 Scalar_UBYTE 0 main_quad_rev3_21_200pm_CM_uint8 0 255 MATRIX_DIM 8 1 /end CHARACTERISTIC
/begin CHARACTERISTIC main_quad_rev3_21_200p_cal_impl.Constant_Value_le "" VAL_BLK 0x00219910 Scalar_UBYTE 0 main_quad_rev3_21_200pm_CM_uint8 0 255 MATRIX_DIM 8 1 /end CHARACTERISTIC
/begin CHARACTERISTIC main_quad_rev3_21_200p_cal_impl.Constant_Value_o "" VAL_BLK 0x00219958 Scalar_UBYTE 0 main_quad_rev3_21_200pm_CM_uint8 0 255 MATRIX_DIM 8 1 /end CHARACTERISTIC
/begin CHARACTERISTIC main_quad_rev3_21_200p_cal_impl.Constant_Value_ob "" VAL_BLK 0x00219970 Scalar_UBYTE 0 main_quad_rev3_21_200pm_CM_uint8 0 255 MATRIX_DIM 8 1 /end CHARACTERISTIC
/begin CHARACTERISTIC main_quad_rev3_21_200p_cal_impl.Constant_Value_p "" VAL_BLK 0x002198E0 Scalar_UBYTE 0 main_quad_rev3_21_200pm_CM_uint8 0 255 MATRIX_DIM 8 1 /end CHARACTERISTIC
/begin CHARACTERISTIC main_quad_rev3_21_200p_cal_impl.Delay1_InitialCondition "" VALUE 0x002194A8 Scalar_FLOAT64_IEEE 0 main_quad_rev3_21_200pm_CM_double -1.7E+308 1.7E+308 /end CHARACTERISTIC
/begin CHARACTERISTIC main_quad_rev3_21_200p_cal_impl.Delay_InitialCondition "" VALUE 0x002194A0 Scalar_FLOAT64_IEEE 0 main_quad_rev3_21_200pm_CM_double -1.7E+308 1.7E+308 /end CHARACTERISTIC
/begin CHARACTERISTIC main_quad_rev3_21_200p_cal_impl.Gain10_Gain "" VALUE 0x00219518 Scalar_FLOAT64_IEEE 0 main_quad_rev3_21_200pm_CM_double -1.7E+308 1.7E+308 /end CHARACTERISTIC
/begin CHARACTERISTIC main_quad_rev3_21_200p_cal_impl.Gain11_Gain "" VALUE 0x00219520 Scalar_FLOAT64_IEEE 0 main_quad_rev3_21_200pm_CM_double -1.7E+308 1.7E+308 /end CHARACTERISTIC
/begin CHARACTERISTIC main_quad_rev3_21_200p_cal_impl.Gain12_Gain "" VALUE 0x00219528 Scalar_FLOAT64_IEEE 0 main_quad_rev3_21_200pm_CM_double -1.7E+308 1.7E+308 /end CHARACTERISTIC
/begin CHARACTERISTIC main_quad_rev3_21_200p_cal_impl.Gain13_Gain "" VALUE 0x00219530 Scalar_FLOAT64_IEEE 0 main_quad_rev3_21_200pm_CM_double -1.7E+308 1.7E+308 /end CHARACTERISTIC
/begin CHARACTERISTIC main_quad_rev3_21_200p_cal_impl.Gain14_Gain "" VALUE 0x00219538 Scalar_FLOAT64_IEEE 0 main_quad_rev3_21_200pm_CM_double -1.7E+308 1.7E+308 /end CHARACTERISTIC
/begin CHARACTERISTIC main_quad_rev3_21_200p_cal_impl.Gain15_Gain "" VALUE 0x00219540 Scalar_FLOAT64_IEEE 0 main_quad_rev3_21_200pm_CM_double -1.7E+308 1.7E+308 /end CHARACTERISTIC
/begin CHARACTERISTIC main_quad_rev3_21_200p_cal_impl.Gain16_Gain "" VALUE 0x00219548 Scalar_FLOAT64_IEEE 0 main_quad_rev3_21_200pm_CM_double -1.7E+308 1.7E+308 /end CHARACTERISTIC
/begin CHARACTERISTIC main_quad_rev3_21_200p_cal_impl.Gain17_Gain "" VALUE 0x00219550 Scalar_FLOAT64_IEEE 0 main_quad_rev3_21_200pm_CM_double -1.7E+308 1.7E+308 /end CHARACTERISTIC
/begin CHARACTERISTIC main_quad_rev3_21_200p_cal_impl.Gain18_Gain "" VALUE 0x00219558 Scalar_FLOAT64_IEEE 0 main_quad_rev3_21_200pm_CM_double -1.7E+308 1.7E+308 /end CHARACTERISTIC
/begin CHARACTERISTIC main_quad_rev3_21_200p_cal_impl.Gain19_Gain "" VALUE 0x00219560 Scalar_FLOAT64_IEEE 0 main_quad_rev3_21_200pm_CM_double -1.7E+308 1.7E+308 /end CHARACTERISTIC
/begin CHARACTERISTIC main_quad_rev3_21_200p_cal_impl.Gain1_Gain "" VALUE 0x002194B8 Scalar_FLOAT64_IEEE 0 main_quad_rev3_21_200pm_CM_double -1.7E+308 1.7E+308 /end CHARACTERISTIC
/begin CHARACTERISTIC main_quad_rev3_21_200p_cal_impl.Gain20_Gain "" VALUE 0x00219568 Scalar_FLOAT64_IEEE 0 main_quad_rev3_21_200pm_CM_double -1.7E+308 1.7E+308 /end CHARACTERISTIC
/begin CHARACTERISTIC main_quad_rev3_21_200p_cal_impl.Gain21_Gain "" VALUE 0x00219570 Scalar_FLOAT64_IEEE 0 main_quad_rev3_21_200pm_CM_double -1.7E+308 1.7E+308 /end CHARACTERISTIC
/begin CHARACTERISTIC main_quad_rev3_21_200p_cal_impl.Gain22_Gain "" VALUE 0x00219578 Scalar_FLOAT64_IEEE 0 main_quad_rev3_21_200pm_CM_double -1.7E+308 1.7E+308 /end CHARACTERISTIC
/begin CHARACTERISTIC main_quad_rev3_21_200p_cal_impl.Gain23_Gain "" VALUE 0x00219580 Scalar_FLOAT64_IEEE 0 main_quad_rev3_21_200pm_CM_double -1.7E+308 1.7E+308 /end CHARACTERISTIC
/begin CHARACTERISTIC main_quad_rev3_21_200p_cal_impl.Gain24_Gain "" VALUE 0x00219588 Scalar_FLOAT64_IEEE 0 main_quad_rev3_21_200pm_CM_double -1.7E+308 1.7E+308 /end CHARACTERISTIC
/begin CHARACTERISTIC main_quad_rev3_21_200p_cal_impl.Gain25_Gain "" VALUE 0x00219590 Scalar_FLOAT64_IEEE 0 main_quad_rev3_21_200pm_CM_double -1.7E+308 1.7E+308 /end CHARACTERISTIC
/begin CHARACTERISTIC main_quad_rev3_21_200p_cal_impl.Gain26_Gain "" VALUE 0x00219508 Scalar_FLOAT64_IEEE 0 main_quad_rev3_21_200pm_CM_double -1.7E+308 1.7E+308 /end CHARACTERISTIC
/begin CHARACTERISTIC main_quad_rev3_21_200p_cal_impl.Gain2_Gain "" VALUE 0x002194C8 Scalar_FLOAT64_IEEE 0 main_quad_rev3_21_200pm_CM_double -1.7E+308 1.7E+308 /end CHARACTERISTIC
/begin CHARACTERISTIC main_quad_rev3_21_200p_cal_impl.Gain3_Gain "" VALUE 0x002194D0 Scalar_FLOAT64_IEEE 0 main_quad_rev3_21_200pm_CM_double -1.7E+308 1.7E+308 /end CHARACTERISTIC
/begin CHARACTERISTIC main_quad_rev3_21_200p_cal_impl.Gain4_Gain "" VALUE 0x002194F0 Scalar_FLOAT64_IEEE 0 main_quad_rev3_21_200pm_CM_double -1.7E+308 1.7E+308 /end CHARACTERISTIC
/begin CHARACTERISTIC main_quad_rev3_21_200p_cal_impl.Gain5_Gain "" VALUE 0x00219500 Scalar_FLOAT64_IEEE 0 main_quad_rev3_21_200pm_CM_double -1.7E+308 1.7E+308 /end CHARACTERISTIC
/begin CHARACTERISTIC main_quad_rev3_21_200p_cal_impl.Gain6_Gain "" VALUE 0x002194D8 Scalar_FLOAT64_IEEE 0 main_quad_rev3_21_200pm_CM_double -1.7E+308 1.7E+308 /end CHARACTERISTIC
/begin CHARACTERISTIC main_quad_rev3_21_200p_cal_impl.Gain7_Gain "" VALUE 0x002194E0 Scalar_FLOAT64_IEEE 0 main_quad_rev3_21_200pm_CM_double -1.7E+308 1.7E+308 /end CHARACTERISTIC
/begin CHARACTERISTIC main_quad_rev3_21_200p_cal_impl.Gain8_Gain "" VALUE 0x002194E8 Scalar_FLOAT64_IEEE 0 main_quad_rev3_21_200pm_CM_double -1.7E+308 1.7E+308 /end CHARACTERISTIC
/begin CHARACTERISTIC main_quad_rev3_21_200p_cal_impl.Gain9_Gain "" VALUE 0x00219510 Scalar_FLOAT64_IEEE 0 main_quad_rev3_21_200pm_CM_double -1.7E+308 1.7E+308 /end CHARACTERISTIC
/begin CHARACTERISTIC main_quad_rev3_21_200p_cal_impl.P1_Y0 "" VALUE 0x002192C0 Scalar_FLOAT64_IEEE 0 main_quad_rev3_21_200pm_CM_double -1.7E+308 1.7E+308 /end CHARACTERISTIC
/begin CHARACTERISTIC main_quad_rev3_21_200p_cal_impl.P2_Y0 "" VALUE 0x00219260 Scalar_FLOAT64_IEEE 0 main_quad_rev3_21_200pm_CM_double -1.7E+308 1.7E+308 /end CHARACTERISTIC
/begin CHARACTERISTIC main_quad_rev3_21_200p_cal_impl.P3_Y0 "" VALUE 0x002192C8 Scalar_FLOAT64_IEEE 0 main_quad_rev3_21_200pm_CM_double -1.7E+308 1.7E+308 /end CHARACTERISTIC
/begin CHARACTERISTIC main_quad_rev3_21_200p_cal_impl.P4_Y0 "" VALUE 0x00219268 Scalar_FLOAT64_IEEE 0 main_quad_rev3_21_200pm_CM_double -1.7E+308 1.7E+308 /end CHARACTERISTIC
/begin CHARACTERISTIC main_quad_rev3_21_200p_cal_impl.P5_Y0 "" VALUE 0x002192D0 Scalar_FLOAT64_IEEE 0 main_quad_rev3_21_200pm_CM_double -1.7E+308 1.7E+308 /end CHARACTERISTIC
/begin CHARACTERISTIC main_quad_rev3_21_200p_cal_impl.P6_Y0 "" VALUE 0x00219270 Scalar_FLOAT64_IEEE 0 main_quad_rev3_21_200pm_CM_double -1.7E+308 1.7E+308 /end CHARACTERISTIC
/begin CHARACTERISTIC main_quad_rev3_21_200p_cal_impl.P7_Y0 "" VALUE 0x002192D8 Scalar_FLOAT64_IEEE 0 main_quad_rev3_21_200pm_CM_double -1.7E+308 1.7E+308 /end CHARACTERISTIC
/begin CHARACTERISTIC main_quad_rev3_21_200p_cal_impl.P8_Y0 "" VALUE 0x00219278 Scalar_FLOAT64_IEEE 0 main_quad_rev3_21_200pm_CM_double -1.7E+308 1.7E+308 /end CHARACTERISTIC
/begin MEASUREMENT main_quad_rev3_21_200pm_B.Add "" FLOAT64_IEEE main_quad_rev3_21_200pm_CM_double 0 0 -1.7E+308 1.7E+308 ECU_ADDRESS 0x0021FB68 /end MEASUREMENT
/begin MEASUREMENT main_quad_rev3_21_200pm_B.Add1 "" FLOAT64_IEEE main_quad_rev3_21_200pm_CM_double 0 0 -1.7E+308 1.7E+308 ECU_ADDRESS 0x0021FB70 /end MEASUREMENT
/begin MEASUREMENT main_quad_rev3_21_200pm_B.BytePacking "" UBYTE main_quad_rev3_21_200pm_CM_uint8 0 0 0 255 LAYOUT COLUMN_DIR MATRIX_DIM 8 ECU_ADDRESS 0x0021FD40 /end MEASUREMENT
/begin MEASUREMENT main_quad_rev3_21_200pm_B.BytePacking_a "" UBYTE main_quad_rev3_21_200pm_CM_uint8 0 0 0 255 LAYOUT COLUMN_DIR MATRIX_DIM 8 ECU_ADDRESS 0x0021FD60 /end MEASUREMENT
/begin MEASUREMENT main_quad_rev3_21_200pm_B.BytePacking_d "" UBYTE main_quad_rev3_21_200pm_CM_uint8 0 0 0 255 LAYOUT COLUMN_DIR MATRIX_DIM 8 ECU_ADDRESS 0x0021FD90 /end MEASUREMENT
/begin MEASUREMENT main_quad_rev3_21_200pm_B.BytePacking_f "" UBYTE main_quad_rev3_21_200pm_CM_uint8 0 0 0 255 LAYOUT COLUMN_DIR MATRIX_DIM 8 ECU_ADDRESS 0x0021FD70 /end MEASUREMENT
/begin MEASUREMENT main_quad_rev3_21_200pm_B.BytePacking_k "" UBYTE main_quad_rev3_21_200pm_CM_uint8 0 0 0 255 LAYOUT COLUMN_DIR MATRIX_DIM 8 ECU_ADDRESS 0x0021FDA0 /end MEASUREMENT
/begin MEASUREMENT main_quad_rev3_21_200pm_B.BytePacking_o "" UBYTE main_quad_rev3_21_200pm_CM_uint8 0 0 0 255 LAYOUT COLUMN_DIR MATRIX_DIM 8 ECU_ADDRESS 0x0021FD50 /end MEASUREMENT
/begin MEASUREMENT main_quad_rev3_21_200pm_B.BytePacking_or "" UBYTE main_quad_rev3_21_200pm_CM_uint8 0 0 0 255 LAYOUT COLUMN_DIR MATRIX_DIM 8 ECU_ADDRESS 0x0021FDB0 /end MEASUREMENT
/begin MEASUREMENT main_quad_rev3_21_200pm_B.BytePacking_p "" UBYTE main_quad_rev3_21_200pm_CM_uint8 0 0 0 255 LAYOUT COLUMN_DIR MATRIX_DIM 8 ECU_ADDRESS 0x0021FD80 /end MEASUREMENT
/begin MEASUREMENT main_quad_rev3_21_200pm_B.CANRead_o1 "" UBYTE main_quad_rev3_21_200pm_CM_logical 0 0 0 1 ECU_ADDRESS 0x0021FDB8 /end MEASUREMENT
/begin MEASUREMENT main_quad_rev3_21_200pm_B.CANRead_o1_d "" UBYTE main_quad_rev3_21_200pm_CM_logical 0 0 0 1 ECU_ADDRESS 0x0021FDB9 /end MEASUREMENT
/begin MEASUREMENT main_quad_rev3_21_200pm_B.CANUnpack_o1 "" FLOAT64_IEEE main_quad_rev3_21_200pm_CM_double 0 0 -1.7E+308 1.7E+308 ECU_ADDRESS 0x0021FB90 /end MEASUREMENT
/begin MEASUREMENT main_quad_rev3_21_200pm_B.CANUnpack_o1_c "" FLOAT64_IEEE main_quad_rev3_21_200pm_CM_double 0 0 -1.7E+308 1.7E+308 ECU_ADDRESS 0x0021FC30 /end MEASUREMENT
/begin MEASUREMENT main_quad_rev3_21_200pm_B.CANUnpack_o1_h "" FLOAT64_IEEE main_quad_rev3_21_200pm_CM_double 0 0 -1.7E+308 1.7E+308 ECU_ADDRESS 0x0021FBD0 /end MEASUREMENT
/begin MEASUREMENT main_quad_rev3_21_200pm_B.CANUnpack_o1_j "" FLOAT64_IEEE main_quad_rev3_21_200pm_CM_double 0 0 -1.7E+308 1.7E+308 ECU_ADDRESS 0x0021FBB0 /end MEASUREMENT
/begin MEASUREMENT main_quad_rev3_21_200pm_B.CANUnpack_o1_k "" FLOAT64_IEEE main_quad_rev3_21_200pm_CM_double 0 0 -1.7E+308 1.7E+308 ECU_ADDRESS 0x0021FBF0 /end MEASUREMENT
/begin MEASUREMENT main_quad_rev3_21_200pm_B.CANUnpack_o1_l "" FLOAT64_IEEE main_quad_rev3_21_200pm_CM_double 0 0 -1.7E+308 1.7E+308 ECU_ADDRESS 0x0021FC50 /end MEASUREMENT
/begin MEASUREMENT main_quad_rev3_21_200pm_B.CANUnpack_o1_lm "" FLOAT64_IEEE main_quad_rev3_21_200pm_CM_double 0 0 -1.7E+308 1.7E+308 ECU_ADDRESS 0x0021FC70 /end MEASUREMENT
/begin MEASUREMENT main_quad_rev3_21_200pm_B.CANUnpack_o1_p "" FLOAT64_IEEE main_quad_rev3_21_200pm_CM_double 0 0 -1.7E+308 1.7E+308 ECU_ADDRESS 0x0021FC10 /end MEASUREMENT
/begin MEASUREMENT main_quad_rev3_21_200pm_B.CANUnpack_o2 "" FLOAT64_IEEE main_quad_rev3_21_200pm_CM_double 0 0 -1.7E+308 1.7E+308 ECU_ADDRESS 0x0021FB98 /end MEASUREMENT
/begin MEASUREMENT main_quad_rev3_21_200pm_B.CANUnpack_o2_b "" FLOAT64_IEEE main_quad_rev3_21_200pm_CM_double 0 0 -1.7E+308 1.7E+308 ECU_ADDRESS 0x0021FC38 /end MEASUREMENT
/begin MEASUREMENT main_quad_rev3_21_200pm_B.CANUnpack_o2_d "" FLOAT64_IEEE main_quad_rev3_21_200pm_CM_double 0 0 -1.7E+308 1.7E+308 ECU_ADDRESS 0x0021FC78 /end MEASUREMENT
/begin MEASUREMENT main_quad_rev3_21_200pm_B.CANUnpack_o2_g "" FLOAT64_IEEE main_quad_rev3_21_200pm_CM_double 0 0 -1.7E+308 1.7E+308 ECU_ADDRESS 0x0021FBB8 /end MEASUREMENT
/begin MEASUREMENT main_quad_rev3_21_200pm_B.CANUnpack_o2_h "" FLOAT64_IEEE main_quad_rev3_21_200pm_CM_double 0 0 -1.7E+308 1.7E+308 ECU_ADDRESS 0x0021FBF8 /end MEASUREMENT
/begin MEASUREMENT main_quad_rev3_21_200pm_B.CANUnpack_o2_k "" FLOAT64_IEEE main_quad_rev3_21_200pm_CM_double 0 0 -1.7E+308 1.7E+308 ECU_ADDRESS 0x0021FBD8 /end MEASUREMENT
/begin MEASUREMENT main_quad_rev3_21_200pm_B.CANUnpack_o2_kk "" FLOAT64_IEEE main_quad_rev3_21_200pm_CM_double 0 0 -1.7E+308 1.7E+308 ECU_ADDRESS 0x0021FC18 /end MEASUREMENT
/begin MEASUREMENT main_quad_rev3_21_200pm_B.CANUnpack_o2_o "" FLOAT64_IEEE main_quad_rev3_21_200pm_CM_double 0 0 -1.7E+308 1.7E+308 ECU_ADDRESS 0x0021FC58 /end MEASUREMENT
/begin MEASUREMENT main_quad_rev3_21_200pm_B.CANUnpack_o3 "" FLOAT64_IEEE main_quad_rev3_21_200pm_CM_double 0 0 -1.7E+308 1.7E+308 ECU_ADDRESS 0x0021FBA0 /end MEASUREMENT
/begin MEASUREMENT main_quad_rev3_21_200pm_B.CANUnpack_o3_a "" FLOAT64_IEEE main_quad_rev3_21_200pm_CM_double 0 0 -1.7E+308 1.7E+308 ECU_ADDRESS 0x0021FC00 /end MEASUREMENT
/begin MEASUREMENT main_quad_rev3_21_200pm_B.CANUnpack_o3_d "" FLOAT64_IEEE main_quad_rev3_21_200pm_CM_double 0 0 -1.7E+308 1.7E+308 ECU_ADDRESS 0x0021FC60 /end MEASUREMENT
/begin MEASUREMENT main_quad_rev3_21_200pm_B.CANUnpack_o3_e "" FLOAT64_IEEE main_quad_rev3_21_200pm_CM_double 0 0 -1.7E+308 1.7E+308 ECU_ADDRESS 0x0021FC20 /end MEASUREMENT
/begin MEASUREMENT main_quad_rev3_21_200pm_B.CANUnpack_o3_g "" FLOAT64_IEEE main_quad_rev3_21_200pm_CM_double 0 0 -1.7E+308 1.7E+308 ECU_ADDRESS 0x0021FC40 /end MEASUREMENT
/begin MEASUREMENT main_quad_rev3_21_200pm_B.CANUnpack_o3_i "" FLOAT64_IEEE main_quad_rev3_21_200pm_CM_double 0 0 -1.7E+308 1.7E+308 ECU_ADDRESS 0x0021FBE0 /end MEASUREMENT
/begin MEASUREMENT main_quad_rev3_21_200pm_B.CANUnpack_o3_m "" FLOAT64_IEEE main_quad_rev3_21_200pm_CM_double 0 0 -1.7E+308 1.7E+308 ECU_ADDRESS 0x0021FC80 /end MEASUREMENT
/begin MEASUREMENT main_quad_rev3_21_200pm_B.CANUnpack_o3_p "" FLOAT64_IEEE main_quad_rev3_21_200pm_CM_double 0 0 -1.7E+308 1.7E+308 ECU_ADDRESS 0x0021FBC0 /end MEASUREMENT
/begin MEASUREMENT main_quad_rev3_21_200pm_B.CANUnpack_o4 "" FLOAT64_IEEE main_quad_rev3_21_200pm_CM_double 0 0 -1.7E+308 1.7E+308 ECU_ADDRESS 0x0021FBA8 /end MEASUREMENT
/begin MEASUREMENT main_quad_rev3_21_200pm_B.CANUnpack_o4_a "" FLOAT64_IEEE main_quad_rev3_21_200pm_CM_double 0 0 -1.7E+308 1.7E+308 ECU_ADDRESS 0x0021FC88 /end MEASUREMENT
/begin MEASUREMENT main_quad_rev3_21_200pm_B.CANUnpack_o4_f "" FLOAT64_IEEE main_quad_rev3_21_200pm_CM_double 0 0 -1.7E+308 1.7E+308 ECU_ADDRESS 0x0021FC28 /end MEASUREMENT
/begin MEASUREMENT main_quad_rev3_21_200pm_B.CANUnpack_o4_j "" FLOAT64_IEEE main_quad_rev3_21_200pm_CM_double 0 0 -1.7E+308 1.7E+308 ECU_ADDRESS 0x0021FC68 /end MEASUREMENT
/begin MEASUREMENT main_quad_rev3_21_200pm_B.CANUnpack_o4_k "" FLOAT64_IEEE main_quad_rev3_21_200pm_CM_double 0 0 -1.7E+308 1.7E+308 ECU_ADDRESS 0x0021FBC8 /end MEASUREMENT
/begin MEASUREMENT main_quad_rev3_21_200pm_B.CANUnpack_o4_kw "" FLOAT64_IEEE main_quad_rev3_21_200pm_CM_double 0 0 -1.7E+308 1.7E+308 ECU_ADDRESS 0x0021FC48 /end MEASUREMENT
/begin MEASUREMENT main_quad_rev3_21_200pm_B.CANUnpack_o4_l "" FLOAT64_IEEE main_quad_rev3_21_200pm_CM_double 0 0 -1.7E+308 1.7E+308 ECU_ADDRESS 0x0021FC08 /end MEASUREMENT
/begin MEASUREMENT main_quad_rev3_21_200pm_B.CANUnpack_o4_o "" FLOAT64_IEEE main_quad_rev3_21_200pm_CM_double 0 0 -1.7E+308 1.7E+308 ECU_ADDRESS 0x0021FBE8 /end MEASUREMENT
/begin MEASUREMENT main_quad_rev3_21_200pm_B.CANUnpack_o5 "" UBYTE main_quad_rev3_21_200pm_CM_uint8 0 0 0 255 ECU_ADDRESS 0x0021FD30 /end MEASUREMENT
/begin MEASUREMENT main_quad_rev3_21_200pm_B.CANUnpack_o5_a "" UBYTE main_quad_rev3_21_200pm_CM_uint8 0 0 0 255 ECU_ADDRESS 0x0021FD33 /end MEASUREMENT
/begin MEASUREMENT main_quad_rev3_21_200pm_B.CANUnpack_o5_e "" UBYTE main_quad_rev3_21_200pm_CM_uint8 0 0 0 255 ECU_ADDRESS 0x0021FD32 /end MEASUREMENT
/begin MEASUREMENT main_quad_rev3_21_200pm_B.CANUnpack_o5_f "" UBYTE main_quad_rev3_21_200pm_CM_uint8 0 0 0 255 ECU_ADDRESS 0x0021FD37 /end MEASUREMENT
/begin MEASUREMENT main_quad_rev3_21_200pm_B.CANUnpack_o5_g "" UBYTE main_quad_rev3_21_200pm_CM_uint8 0 0 0 255 ECU_ADDRESS 0x0021FD34 /end MEASUREMENT
/begin MEASUREMENT main_quad_rev3_21_200pm_B.CANUnpack_o5_gy "" UBYTE main_quad_rev3_21_200pm_CM_uint8 0 0 0 255 ECU_ADDRESS 0x0021FD36 /end MEASUREMENT
/begin MEASUREMENT main_quad_rev3_21_200pm_B.CANUnpack_o5_i "" UBYTE main_quad_rev3_21_200pm_CM_uint8 0 0 0 255 ECU_ADDRESS 0x0021FD35 /end MEASUREMENT
/begin MEASUREMENT main_quad_rev3_21_200pm_B.CANUnpack_o5_n "" UBYTE main_quad_rev3_21_200pm_CM_uint8 0 0 0 255 ECU_ADDRESS 0x0021FD31 /end MEASUREMENT
/begin MEASUREMENT main_quad_rev3_21_200pm_B.Clock "" FLOAT64_IEEE main_quad_rev3_21_200pm_CM_double 0 0 -1.7E+308 1.7E+308 ECU_ADDRESS 0x0021FB88 /end MEASUREMENT
/begin MEASUREMENT main_quad_rev3_21_200pm_B.Constant "" FLOAT64_IEEE main_quad_rev3_21_200pm_CM_double 0 0 -1.7E+308 1.7E+308 ECU_ADDRESS 0x0021FAA0 /end MEASUREMENT
/begin MEASUREMENT main_quad_rev3_21_200pm_B.Delay "" FLOAT64_IEEE main_quad_rev3_21_200pm_CM_double 0 0 -1.7E+308 1.7E+308 ECU_ADDRESS 0x0021FA90 /end MEASUREMENT
/begin MEASUREMENT main_quad_rev3_21_200pm_B.Delay1 "" FLOAT64_IEEE main_quad_rev3_21_200pm_CM_double 0 0 -1.7E+308 1.7E+308 ECU_ADDRESS 0x0021FA98 /end MEASUREMENT
/begin MEASUREMENT main_quad_rev3_21_200pm_B.Gain1 "" FLOAT64_IEEE main_quad_rev3_21_200pm_CM_double 0 0 -1.7E+308 1.7E+308 ECU_ADDRESS 0x0021FAA8 /end MEASUREMENT
/begin MEASUREMENT main_quad_rev3_21_200pm_B.Gain10 "" FLOAT64_IEEE main_quad_rev3_21_200pm_CM_double 0 0 -1.7E+308 1.7E+308 ECU_ADDRESS 0x0021FAF8 /end MEASUREMENT
/begin MEASUREMENT main_quad_rev3_21_200pm_B.Gain11 "" FLOAT64_IEEE main_quad_rev3_21_200pm_CM_double 0 0 -1.7E+308 1.7E+308 ECU_ADDRESS 0x0021FB00 /end MEASUREMENT
/begin MEASUREMENT main_quad_rev3_21_200pm_B.Gain12 "" FLOAT64_IEEE main_quad_rev3_21_200pm_CM_double 0 0 -1.7E+308 1.7E+308 ECU_ADDRESS 0x0021FB08 /end MEASUREMENT
/begin MEASUREMENT main_quad_rev3_21_200pm_B.Gain13 "" FLOAT64_IEEE main_quad_rev3_21_200pm_CM_double 0 0 -1.7E+308 1.7E+308 ECU_ADDRESS 0x0021FB10 /end MEASUREMENT
/begin MEASUREMENT main_quad_rev3_21_200pm_B.Gain14 "" FLOAT64_IEEE main_quad_rev3_21_200pm_CM_double 0 0 -1.7E+308 1.7E+308 ECU_ADDRESS 0x0021FB18 /end MEASUREMENT
/begin MEASUREMENT main_quad_rev3_21_200pm_B.Gain15 "" FLOAT64_IEEE main_quad_rev3_21_200pm_CM_double 0 0 -1.7E+308 1.7E+308 ECU_ADDRESS 0x0021FB20 /end MEASUREMENT
/begin MEASUREMENT main_quad_rev3_21_200pm_B.Gain16 "" FLOAT64_IEEE main_quad_rev3_21_200pm_CM_double 0 0 -1.7E+308 1.7E+308 ECU_ADDRESS 0x0021FB28 /end MEASUREMENT
/begin MEASUREMENT main_quad_rev3_21_200pm_B.Gain17 "" FLOAT64_IEEE main_quad_rev3_21_200pm_CM_double 0 0 -1.7E+308 1.7E+308 ECU_ADDRESS 0x0021FB30 /end MEASUREMENT
/begin MEASUREMENT main_quad_rev3_21_200pm_B.Gain18 "" FLOAT64_IEEE main_quad_rev3_21_200pm_CM_double 0 0 -1.7E+308 1.7E+308 ECU_ADDRESS 0x0021FB38 /end MEASUREMENT
/begin MEASUREMENT main_quad_rev3_21_200pm_B.Gain19 "" FLOAT64_IEEE main_quad_rev3_21_200pm_CM_double 0 0 -1.7E+308 1.7E+308 ECU_ADDRESS 0x0021FB40 /end MEASUREMENT
/begin MEASUREMENT main_quad_rev3_21_200pm_B.Gain2 "" FLOAT64_IEEE main_quad_rev3_21_200pm_CM_double 0 0 -1.7E+308 1.7E+308 ECU_ADDRESS 0x0021FAB0 /end MEASUREMENT
/begin MEASUREMENT main_quad_rev3_21_200pm_B.Gain20 "" FLOAT64_IEEE main_quad_rev3_21_200pm_CM_double 0 0 -1.7E+308 1.7E+308 ECU_ADDRESS 0x0021FB48 /end MEASUREMENT
/begin MEASUREMENT main_quad_rev3_21_200pm_B.Gain21 "" FLOAT64_IEEE main_quad_rev3_21_200pm_CM_double 0 0 -1.7E+308 1.7E+308 ECU_ADDRESS 0x0021FB50 /end MEASUREMENT
/begin MEASUREMENT main_quad_rev3_21_200pm_B.Gain22 "" FLOAT64_IEEE main_quad_rev3_21_200pm_CM_double 0 0 -1.7E+308 1.7E+308 ECU_ADDRESS 0x0021FB58 /end MEASUREMENT
/begin MEASUREMENT main_quad_rev3_21_200pm_B.Gain23 "" FLOAT64_IEEE main_quad_rev3_21_200pm_CM_double 0 0 -1.7E+308 1.7E+308 ECU_ADDRESS 0x0021FB60 /end MEASUREMENT
/begin MEASUREMENT main_quad_rev3_21_200pm_B.Gain24 "" FLOAT64_IEEE main_quad_rev3_21_200pm_CM_double 0 0 -1.7E+308 1.7E+308 ECU_ADDRESS 0x0021FB78 /end MEASUREMENT
/begin MEASUREMENT main_quad_rev3_21_200pm_B.Gain25 "" FLOAT64_IEEE main_quad_rev3_21_200pm_CM_double 0 0 -1.7E+308 1.7E+308 ECU_ADDRESS 0x0021FB80 /end MEASUREMENT
/begin MEASUREMENT main_quad_rev3_21_200pm_B.Gain26 "" FLOAT64_IEEE main_quad_rev3_21_200pm_CM_double 0 0 -1.7E+308 1.7E+308 ECU_ADDRESS 0x0021FAE8 /end MEASUREMENT
/begin MEASUREMENT main_quad_rev3_21_200pm_B.Gain3 "" FLOAT64_IEEE main_quad_rev3_21_200pm_CM_double 0 0 -1.7E+308 1.7E+308 ECU_ADDRESS 0x0021FAB8 /end MEASUREMENT
/begin MEASUREMENT main_quad_rev3_21_200pm_B.Gain4 "" FLOAT64_IEEE main_quad_rev3_21_200pm_CM_double 0 0 -1.7E+308 1.7E+308 ECU_ADDRESS 0x0021FAD8 /end MEASUREMENT
/begin MEASUREMENT main_quad_rev3_21_200pm_B.Gain5 "" FLOAT64_IEEE main_quad_rev3_21_200pm_CM_double 0 0 -1.7E+308 1.7E+308 ECU_ADDRESS 0x0021FAE0 /end MEASUREMENT
/begin MEASUREMENT main_quad_rev3_21_200pm_B.Gain6 "" FLOAT64_IEEE main_quad_rev3_21_200pm_CM_double 0 0 -1.7E+308 1.7E+308 ECU_ADDRESS 0x0021FAC0 /end MEASUREMENT
/begin MEASUREMENT main_quad_rev3_21_200pm_B.Gain7 "" FLOAT64_IEEE main_quad_rev3_21_200pm_CM_double 0 0 -1.7E+308 1.7E+308 ECU_ADDRESS 0x0021FAC8 /end MEASUREMENT
/begin MEASUREMENT main_quad_rev3_21_200pm_B.Gain8 "" FLOAT64_IEEE main_quad_rev3_21_200pm_CM_double 0 0 -1.7E+308 1.7E+308 ECU_ADDRESS 0x0021FAD0 /end MEASUREMENT
/begin MEASUREMENT main_quad_rev3_21_200pm_B.Gain9 "" FLOAT64_IEEE main_quad_rev3_21_200pm_CM_double 0 0 -1.7E+308 1.7E+308 ECU_ADDRESS 0x0021FAF0 /end MEASUREMENT
/begin MEASUREMENT main_quad_rev3_21_200pm_B.Kd1 "" FLOAT64_IEEE main_quad_rev3_21_200pm_CM_double 0 0 -1.7E+308 1.7E+308 ECU_ADDRESS 0x0021FD18 /end MEASUREMENT
/begin MEASUREMENT main_quad_rev3_21_200pm_B.Kd2 "" FLOAT64_IEEE main_quad_rev3_21_200pm_CM_double 0 0 -1.7E+308 1.7E+308 ECU_ADDRESS 0x0021FD20 /end MEASUREMENT
/begin MEASUREMENT main_quad_rev3_21_200pm_B.Kp1 "" FLOAT64_IEEE main_quad_rev3_21_200pm_CM_double 0 0 -1.7E+308 1.7E+308 ECU_ADDRESS 0x0021FD08 /end MEASUREMENT
/begin MEASUREMENT main_quad_rev3_21_200pm_B.Kp2 "" FLOAT64_IEEE main_quad_rev3_21_200pm_CM_double 0 0 -1.7E+308 1.7E+308 ECU_ADDRESS 0x0021FD10 /end MEASUREMENT
/begin MEASUREMENT main_quad_rev3_21_200pm_B.MultiportSwitch "" UBYTE main_quad_rev3_21_200pm_CM_uint8 0 0 0 255 LAYOUT COLUMN_DIR MATRIX_DIM 8 ECU_ADDRESS 0x0021FD38 /end MEASUREMENT
/begin MEASUREMENT main_quad_rev3_21_200pm_B.MultiportSwitch_a "" UBYTE main_quad_rev3_21_200pm_CM_uint8 0 0 0 255 LAYOUT COLUMN_DIR MATRIX_DIM 8 ECU_ADDRESS 0x0021FD48 /end MEASUREMENT
/begin MEASUREMENT main_quad_rev3_21_200pm_B.MultiportSwitch_c "" UBYTE main_quad_rev3_21_200pm_CM_uint8 0 0 0 255 LAYOUT COLUMN_DIR MATRIX_DIM 8 ECU_ADDRESS 0x0021FD68 /end MEASUREMENT
/begin MEASUREMENT main_quad_rev3_21_200pm_B.MultiportSwitch_ce "" UBYTE main_quad_rev3_21_200pm_CM_uint8 0 0 0 255 LAYOUT COLUMN_DIR MATRIX_DIM 8 ECU_ADDRESS 0x0021FD78 /end MEASUREMENT
/begin MEASUREMENT main_quad_rev3_21_200pm_B.MultiportSwitch_f "" UBYTE main_quad_rev3_21_200pm_CM_uint8 0 0 0 255 LAYOUT COLUMN_DIR MATRIX_DIM 8 ECU_ADDRESS 0x0021FDA8 /end MEASUREMENT
/begin MEASUREMENT main_quad_rev3_21_200pm_B.MultiportSwitch_i "" UBYTE main_quad_rev3_21_200pm_CM_uint8 0 0 0 255 LAYOUT COLUMN_DIR MATRIX_DIM 8 ECU_ADDRESS 0x0021FD88 /end MEASUREMENT
/begin MEASUREMENT main_quad_rev3_21_200pm_B.MultiportSwitch_p "" UBYTE main_quad_rev3_21_200pm_CM_uint8 0 0 0 255 LAYOUT COLUMN_DIR MATRIX_DIM 8 ECU_ADDRESS 0x0021FD58 /end MEASUREMENT
/begin MEASUREMENT main_quad_rev3_21_200pm_B.MultiportSwitch_p2 "" UBYTE main_quad_rev3_21_200pm_CM_uint8 0 0 0 255 LAYOUT COLUMN_DIR MATRIX_DIM 8 ECU_ADDRESS 0x0021FD98 /end MEASUREMENT
/begin MEASUREMENT main_quad_rev3_21_200pm_B.T1 "" FLOAT64_IEEE main_quad_rev3_21_200pm_CM_double 0 0 -1.7E+308 1.7E+308 ECU_ADDRESS 0x0021FCF8 /end MEASUREMENT
/begin MEASUREMENT main_quad_rev3_21_200pm_B.T2 "" FLOAT64_IEEE main_quad_rev3_21_200pm_CM_double 0 0 -1.7E+308 1.7E+308 ECU_ADDRESS 0x0021FD00 /end MEASUREMENT
/begin MEASUREMENT main_quad_rev3_21_200pm_B.TmpSignalConversionAtSFunctionI "" FLOAT64_IEEE main_quad_rev3_21_200pm_CM_double 0 0 -1.7E+308 1.7E+308 LAYOUT COLUMN_DIR MATRIX_DIM 8 ECU_ADDRESS 0x0021FC90 /end MEASUREMENT
/begin MEASUREMENT main_quad_rev3_21_200pm_B.WhileIterator "" SLONG main_quad_rev3_21_200pm_CM_int32 0 0 -2147483648 2147483647 ECU_ADDRESS 0x0021FD28 /end MEASUREMENT
/begin MEASUREMENT main_quad_rev3_21_200pm_B.WhileIterator_m "" SLONG main_quad_rev3_21_200pm_CM_int32 0 0 -2147483648 2147483647 ECU_ADDRESS 0x0021FD2C /end MEASUREMENT
/begin MEASUREMENT main_quad_rev3_21_200pm_B.c "" FLOAT64_IEEE main_quad_rev3_21_200pm_CM_double 0 0 -1.7E+308 1.7E+308 ECU_ADDRESS 0x0021FCF0 /end MEASUREMENT
/begin MEASUREMENT main_quad_rev3_21_200pm_B.danger "" FLOAT64_IEEE main_quad_rev3_21_200pm_CM_double 0 0 -1.7E+308 1.7E+308 ECU_ADDRESS 0x0021FCD0 /end MEASUREMENT
/begin MEASUREMENT main_quad_rev3_21_200pm_B.sf_bytesfloats.I_ff "" FLOAT64_IEEE main_quad_rev3_21_200pm_CM_double 0 0 -1.7E+308 1.7E+308 ECU_ADDRESS 0x0021FE78 /end MEASUREMENT
/begin MEASUREMENT main_quad_rev3_21_200pm_B.sf_bytesfloats.position "" FLOAT64_IEEE main_quad_rev3_21_200pm_CM_double 0 0 -1.7E+308 1.7E+308 ECU_ADDRESS 0x0021FE68 /end MEASUREMENT
/begin MEASUREMENT main_quad_rev3_21_200pm_B.sf_bytesfloats.velocity "" FLOAT64_IEEE main_quad_rev3_21_200pm_CM_double 0 0 -1.7E+308 1.7E+308 ECU_ADDRESS 0x0021FE70 /end MEASUREMENT
/begin MEASUREMENT main_quad_rev3_21_200pm_B.sf_bytesfloats_a.I_ff "" FLOAT64_IEEE main_quad_rev3_21_200pm_CM_double 0 0 -1.7E+308 1.7E+308 ECU_ADDRESS 0x0021FE18 /end MEASUREMENT
/begin MEASUREMENT main_quad_rev3_21_200pm_B.sf_bytesfloats_a.position "" FLOAT64_IEEE main_quad_rev3_21_200pm_CM_double 0 0 -1.7E+308 1.7E+308 ECU_ADDRESS 0x0021FE08 /end MEASUREMENT
/begin MEASUREMENT main_quad_rev3_21_200pm_B.sf_bytesfloats_a.velocity "" FLOAT64_IEEE main_quad_rev3_21_200pm_CM_double 0 0 -1.7E+308 1.7E+308 ECU_ADDRESS 0x0021FE10 /end MEASUREMENT
/begin MEASUREMENT main_quad_rev3_21_200pm_B.sf_bytesfloats_b.I_ff "" FLOAT64_IEEE main_quad_rev3_21_200pm_CM_double 0 0 -1.7E+308 1.7E+308 ECU_ADDRESS 0x0021FE00 /end MEASUREMENT
/begin MEASUREMENT main_quad_rev3_21_200pm_B.sf_bytesfloats_b.position "" FLOAT64_IEEE main_quad_rev3_21_200pm_CM_double 0 0 -1.7E+308 1.7E+308 ECU_ADDRESS 0x0021FDF0 /end MEASUREMENT
/begin MEASUREMENT main_quad_rev3_21_200pm_B.sf_bytesfloats_b.velocity "" FLOAT64_IEEE main_quad_rev3_21_200pm_CM_double 0 0 -1.7E+308 1.7E+308 ECU_ADDRESS 0x0021FDF8 /end MEASUREMENT
/begin MEASUREMENT main_quad_rev3_21_200pm_B.sf_bytesfloats_c.I_ff "" FLOAT64_IEEE main_quad_rev3_21_200pm_CM_double 0 0 -1.7E+308 1.7E+308 ECU_ADDRESS 0x0021FE60 /end MEASUREMENT
/begin MEASUREMENT main_quad_rev3_21_200pm_B.sf_bytesfloats_c.position "" FLOAT64_IEEE main_quad_rev3_21_200pm_CM_double 0 0 -1.7E+308 1.7E+308 ECU_ADDRESS 0x0021FE50 /end MEASUREMENT
/begin MEASUREMENT main_quad_rev3_21_200pm_B.sf_bytesfloats_c.velocity "" FLOAT64_IEEE main_quad_rev3_21_200pm_CM_double 0 0 -1.7E+308 1.7E+308 ECU_ADDRESS 0x0021FE58 /end MEASUREMENT
/begin MEASUREMENT main_quad_rev3_21_200pm_B.sf_bytesfloats_cd.I_ff "" FLOAT64_IEEE main_quad_rev3_21_200pm_CM_double 0 0 -1.7E+308 1.7E+308 ECU_ADDRESS 0x0021FDE8 /end MEASUREMENT
/begin MEASUREMENT main_quad_rev3_21_200pm_B.sf_bytesfloats_cd.position "" FLOAT64_IEEE main_quad_rev3_21_200pm_CM_double 0 0 -1.7E+308 1.7E+308 ECU_ADDRESS 0x0021FDD8 /end MEASUREMENT
/begin MEASUREMENT main_quad_rev3_21_200pm_B.sf_bytesfloats_cd.velocity "" FLOAT64_IEEE main_quad_rev3_21_200pm_CM_double 0 0 -1.7E+308 1.7E+308 ECU_ADDRESS 0x0021FDE0 /end MEASUREMENT
/begin MEASUREMENT main_quad_rev3_21_200pm_B.sf_bytesfloats_f.I_ff "" FLOAT64_IEEE main_quad_rev3_21_200pm_CM_double 0 0 -1.7E+308 1.7E+308 ECU_ADDRESS 0x0021FDD0 /end MEASUREMENT
/begin MEASUREMENT main_quad_rev3_21_200pm_B.sf_bytesfloats_f.position "" FLOAT64_IEEE main_quad_rev3_21_200pm_CM_double 0 0 -1.7E+308 1.7E+308 ECU_ADDRESS 0x0021FDC0 /end MEASUREMENT
/begin MEASUREMENT main_quad_rev3_21_200pm_B.sf_bytesfloats_f.velocity "" FLOAT64_IEEE main_quad_rev3_21_200pm_CM_double 0 0 -1.7E+308 1.7E+308 ECU_ADDRESS 0x0021FDC8 /end MEASUREMENT
/begin MEASUREMENT main_quad_rev3_21_200pm_B.sf_bytesfloats_j.I_ff "" FLOAT64_IEEE main_quad_rev3_21_200pm_CM_double 0 0 -1.7E+308 1.7E+308 ECU_ADDRESS 0x0021FE30 /end MEASUREMENT
/begin MEASUREMENT main_quad_rev3_21_200pm_B.sf_bytesfloats_j.position "" FLOAT64_IEEE main_quad_rev3_21_200pm_CM_double 0 0 -1.7E+308 1.7E+308 ECU_ADDRESS 0x0021FE20 /end MEASUREMENT
/begin MEASUREMENT main_quad_rev3_21_200pm_B.sf_bytesfloats_j.velocity "" FLOAT64_IEEE main_quad_rev3_21_200pm_CM_double 0 0 -1.7E+308 1.7E+308 ECU_ADDRESS 0x0021FE28 /end MEASUREMENT
/begin MEASUREMENT main_quad_rev3_21_200pm_B.sf_bytesfloats_l.I_ff "" FLOAT64_IEEE main_quad_rev3_21_200pm_CM_double 0 0 -1.7E+308 1.7E+308 ECU_ADDRESS 0x0021FE48 /end MEASUREMENT
/begin MEASUREMENT main_quad_rev3_21_200pm_B.sf_bytesfloats_l.position "" FLOAT64_IEEE main_quad_rev3_21_200pm_CM_double 0 0 -1.7E+308 1.7E+308 ECU_ADDRESS 0x0021FE38 /end MEASUREMENT
/begin MEASUREMENT main_quad_rev3_21_200pm_B.sf_bytesfloats_l.velocity "" FLOAT64_IEEE main_quad_rev3_21_200pm_CM_double 0 0 -1.7E+308 1.7E+308 ECU_ADDRESS 0x0021FE40 /end MEASUREMENT
/begin MEASUREMENT main_quad_rev3_21_200pm_B.sf_floatsbytes.b "" UBYTE main_quad_rev3_21_200pm_CM_uint8 0 0 0 255 LAYOUT COLUMN_DIR MATRIX_DIM 8 ECU_ADDRESS 0x0021FEB8 /end MEASUREMENT
/begin MEASUREMENT main_quad_rev3_21_200pm_B.sf_floatsbytes_b.b "" UBYTE main_quad_rev3_21_200pm_CM_uint8 0 0 0 255 LAYOUT COLUMN_DIR MATRIX_DIM 8 ECU_ADDRESS 0x0021FEB0 /end MEASUREMENT
/begin MEASUREMENT main_quad_rev3_21_200pm_B.sf_floatsbytes_bb.b "" UBYTE main_quad_rev3_21_200pm_CM_uint8 0 0 0 255 LAYOUT COLUMN_DIR MATRIX_DIM 8 ECU_ADDRESS 0x0021FE90 /end MEASUREMENT
/begin MEASUREMENT main_quad_rev3_21_200pm_B.sf_floatsbytes_i.b "" UBYTE main_quad_rev3_21_200pm_CM_uint8 0 0 0 255 LAYOUT COLUMN_DIR MATRIX_DIM 8 ECU_ADDRESS 0x0021FEA0 /end MEASUREMENT
/begin MEASUREMENT main_quad_rev3_21_200pm_B.sf_floatsbytes_if.b "" UBYTE main_quad_rev3_21_200pm_CM_uint8 0 0 0 255 LAYOUT COLUMN_DIR MATRIX_DIM 8 ECU_ADDRESS 0x0021FE98 /end MEASUREMENT
/begin MEASUREMENT main_quad_rev3_21_200pm_B.sf_floatsbytes_k.b "" UBYTE main_quad_rev3_21_200pm_CM_uint8 0 0 0 255 LAYOUT COLUMN_DIR MATRIX_DIM 8 ECU_ADDRESS 0x0021FE88 /end MEASUREMENT
/begin MEASUREMENT main_quad_rev3_21_200pm_B.sf_floatsbytes_kd.b "" UBYTE main_quad_rev3_21_200pm_CM_uint8 0 0 0 255 LAYOUT COLUMN_DIR MATRIX_DIM 8 ECU_ADDRESS 0x0021FE80 /end MEASUREMENT
/begin MEASUREMENT main_quad_rev3_21_200pm_B.sf_floatsbytes_o.b "" UBYTE main_quad_rev3_21_200pm_CM_uint8 0 0 0 255 LAYOUT COLUMN_DIR MATRIX_DIM 8 ECU_ADDRESS 0x0021FEA8 /end MEASUREMENT
/begin MEASUREMENT main_quad_rev3_21_200pm_B.stop "" FLOAT64_IEEE main_quad_rev3_21_200pm_CM_double 0 0 -1.7E+308 1.7E+308 ECU_ADDRESS 0x0021FCD8 /end MEASUREMENT
/begin MEASUREMENT main_quad_rev3_21_200pm_B.theta1 "" FLOAT64_IEEE main_quad_rev3_21_200pm_CM_double 0 0 -1.7E+308 1.7E+308 ECU_ADDRESS 0x0021FCE0 /end MEASUREMENT
/begin MEASUREMENT main_quad_rev3_21_200pm_B.theta2 "" FLOAT64_IEEE main_quad_rev3_21_200pm_CM_double 0 0 -1.7E+308 1.7E+308 ECU_ADDRESS 0x0021FCE8 /end MEASUREMENT
/begin MEASUREMENT main_quad_rev3_21_200pm_DW.CANUnpack_ModeSignalID "" SLONG main_quad_rev3_21_200pm_CM_int_T 0 0 -2147483648 2147483647 ECU_ADDRESS 0x0021F904 /end MEASUREMENT
/begin MEASUREMENT main_quad_rev3_21_200pm_DW.CANUnpack_ModeSignalID_a "" SLONG main_quad_rev3_21_200pm_CM_int_T 0 0 -2147483648 2147483647 ECU_ADDRESS 0x0021F92C /end MEASUREMENT
/begin MEASUREMENT main_quad_rev3_21_200pm_DW.CANUnpack_ModeSignalID_d "" SLONG main_quad_rev3_21_200pm_CM_int_T 0 0 -2147483648 2147483647 ECU_ADDRESS 0x0021F924 /end MEASUREMENT
/begin MEASUREMENT main_quad_rev3_21_200pm_DW.CANUnpack_ModeSignalID_j "" SLONG main_quad_rev3_21_200pm_CM_int_T 0 0 -2147483648 2147483647 ECU_ADDRESS 0x0021F90C /end MEASUREMENT
/begin MEASUREMENT main_quad_rev3_21_200pm_DW.CANUnpack_ModeSignalID_jt "" SLONG main_quad_rev3_21_200pm_CM_int_T 0 0 -2147483648 2147483647 ECU_ADDRESS 0x0021F934 /end MEASUREMENT
/begin MEASUREMENT main_quad_rev3_21_200pm_DW.CANUnpack_ModeSignalID_m "" SLONG main_quad_rev3_21_200pm_CM_int_T 0 0 -2147483648 2147483647 ECU_ADDRESS 0x0021F914 /end MEASUREMENT
/begin MEASUREMENT main_quad_rev3_21_200pm_DW.CANUnpack_ModeSignalID_o "" SLONG main_quad_rev3_21_200pm_CM_int_T 0 0 -2147483648 2147483647 ECU_ADDRESS 0x0021F91C /end MEASUREMENT
/begin MEASUREMENT main_quad_rev3_21_200pm_DW.CANUnpack_ModeSignalID_or "" SLONG main_quad_rev3_21_200pm_CM_int_T 0 0 -2147483648 2147483647 ECU_ADDRESS 0x0021F93C /end MEASUREMENT
/begin MEASUREMENT main_quad_rev3_21_200pm_DW.CANUnpack_StatusPortID "" SLONG main_quad_rev3_21_200pm_CM_int_T 0 0 -2147483648 2147483647 ECU_ADDRESS 0x0021F908 /end MEASUREMENT
/begin MEASUREMENT main_quad_rev3_21_200pm_DW.CANUnpack_StatusPortID_e "" SLONG main_quad_rev3_21_200pm_CM_int_T 0 0 -2147483648 2147483647 ECU_ADDRESS 0x0021F940 /end MEASUREMENT
/begin MEASUREMENT main_quad_rev3_21_200pm_DW.CANUnpack_StatusPortID_i "" SLONG main_quad_rev3_21_200pm_CM_int_T 0 0 -2147483648 2147483647 ECU_ADDRESS 0x0021F930 /end MEASUREMENT
/begin MEASUREMENT main_quad_rev3_21_200pm_DW.CANUnpack_StatusPortID_j "" SLONG main_quad_rev3_21_200pm_CM_int_T 0 0 -2147483648 2147483647 ECU_ADDRESS 0x0021F920 /end MEASUREMENT
/begin MEASUREMENT main_quad_rev3_21_200pm_DW.CANUnpack_StatusPortID_l "" SLONG main_quad_rev3_21_200pm_CM_int_T 0 0 -2147483648 2147483647 ECU_ADDRESS 0x0021F918 /end MEASUREMENT
/begin MEASUREMENT main_quad_rev3_21_200pm_DW.CANUnpack_StatusPortID_o "" SLONG main_quad_rev3_21_200pm_CM_int_T 0 0 -2147483648 2147483647 ECU_ADDRESS 0x0021F928 /end MEASUREMENT
/begin MEASUREMENT main_quad_rev3_21_200pm_DW.CANUnpack_StatusPortID_o4 "" SLONG main_quad_rev3_21_200pm_CM_int_T 0 0 -2147483648 2147483647 ECU_ADDRESS 0x0021F938 /end MEASUREMENT
/begin MEASUREMENT main_quad_rev3_21_200pm_DW.CANUnpack_StatusPortID_p "" SLONG main_quad_rev3_21_200pm_CM_int_T 0 0 -2147483648 2147483647 ECU_ADDRESS 0x0021F910 /end MEASUREMENT
/begin MEASUREMENT main_quad_rev3_21_200pm_DW.Delay1_DSTATE "" FLOAT64_IEEE main_quad_rev3_21_200pm_CM_double 0 0 -1.7E+308 1.7E+308 ECU_ADDRESS 0x0021F648 /end MEASUREMENT
/begin MEASUREMENT main_quad_rev3_21_200pm_DW.Delay_DSTATE "" FLOAT64_IEEE main_quad_rev3_21_200pm_CM_double 0 0 -1.7E+308 1.7E+308 ECU_ADDRESS 0x0021F640 /end MEASUREMENT
/begin MEASUREMENT main_quad_rev3_21_200pm_DW.Th2Th1 "" FLOAT64_IEEE main_quad_rev3_21_200pm_CM_double 0 0 -1.7E+308 1.7E+308 ECU_ADDRESS 0x0021F690 /end MEASUREMENT
/begin MEASUREMENT main_quad_rev3_21_200pm_DW.done "" FLOAT64_IEEE main_quad_rev3_21_200pm_CM_double 0 0 -1.7E+308 1.7E+308 ECU_ADDRESS 0x0021F650 /end MEASUREMENT
/begin MEASUREMENT main_quad_rev3_21_200pm_DW.is_Command "" ULONG main_quad_rev3_21_200pm_CM_uint32 0 0 0 2147483646 ECU_ADDRESS 0x0021F878 /end MEASUREMENT
/begin MEASUREMENT main_quad_rev3_21_200pm_DW.is_active_c8_main_quad_rev3_21_ "" UBYTE main_quad_rev3_21_200pm_CM_uint8 0 0 0 255 ECU_ADDRESS 0x0021F986 /end MEASUREMENT
/begin MEASUREMENT main_quad_rev3_21_200pm_DW.is_c8_main_quad_rev3_21_200pm "" ULONG main_quad_rev3_21_200pm_CM_uint32 0 0 0 2147483646 ECU_ADDRESS 0x0021F874 /end MEASUREMENT
/begin MEASUREMENT main_quad_rev3_21_200pm_DW.pf "" FLOAT64_IEEE main_quad_rev3_21_200pm_CM_double 0 0 -1.7E+308 1.7E+308 ECU_ADDRESS 0x0021F658 /end MEASUREMENT
/begin MEASUREMENT main_quad_rev3_21_200pm_DW.po1 "" FLOAT64_IEEE main_quad_rev3_21_200pm_CM_double 0 0 -1.7E+308 1.7E+308 ECU_ADDRESS 0x0021F670 /end MEASUREMENT
/begin MEASUREMENT main_quad_rev3_21_200pm_DW.po2 "" FLOAT64_IEEE main_quad_rev3_21_200pm_CM_double 0 0 -1.7E+308 1.7E+308 ECU_ADDRESS 0x0021F678 /end MEASUREMENT
/begin MEASUREMENT main_quad_rev3_21_200pm_DW.sfEvent "" SLONG main_quad_rev3_21_200pm_CM_int32 0 0 -2147483648 2147483647 ECU_ADDRESS 0x0021F870 /end MEASUREMENT
/begin MEASUREMENT main_quad_rev3_21_200pm_DW.slope1 "" FLOAT64_IEEE main_quad_rev3_21_200pm_CM_double 0 0 -1.7E+308 1.7E+308 ECU_ADDRESS 0x0021F680 /end MEASUREMENT
/begin MEASUREMENT main_quad_rev3_21_200pm_DW.slope2 "" FLOAT64_IEEE main_quad_rev3_21_200pm_CM_double 0 0 -1.7E+308 1.7E+308 ECU_ADDRESS 0x0021F688 /end MEASUREMENT
/begin MEASUREMENT main_quad_rev3_21_200pm_DW.temporalCounter_i1 "" UWORD main_quad_rev3_21_200pm_CM_uint16 0 0 0 65535 ECU_ADDRESS 0x0021F984 /end MEASUREMENT
/begin MEASUREMENT main_quad_rev3_21_200pm_DW.to "" FLOAT64_IEEE main_quad_rev3_21_200pm_CM_double 0 0 -1.7E+308 1.7E+308 ECU_ADDRESS 0x0021F668 /end MEASUREMENT
/begin MEASUREMENT main_quad_rev3_21_200pm_DW.tstep "" FLOAT64_IEEE main_quad_rev3_21_200pm_CM_double 0 0 -1.7E+308 1.7E+308 ECU_ADDRESS 0x0021F660 /end MEASUREMENT
/begin COMPU_METHOD main_quad_rev3_21_200pm_CM_double "" IDENTICAL "%15.10" "" /end COMPU_METHOD
/begin COMPU_METHOD main_quad_rev3_21_200pm_CM_int32 "" IDENTICAL "%10.0" "" /end COMPU_METHOD
/begin COMPU_METHOD main_quad_rev3_21_200pm_CM_int_T "" IDENTICAL "customformat" "" /end COMPU_METHOD
/begin COMPU_METHOD main_quad_rev3_21_200pm_CM_logical "" IDENTICAL "%1.0" "" /end COMPU_METHOD
/begin COMPU_METHOD main_quad_rev3_21_200pm_CM_uint16 "" IDENTICAL "%5.0" "" /end COMPU_METHOD
/begin COMPU_METHOD main_quad_rev3_21_200pm_CM_uint32 "" IDENTICAL "%10.0" "" /end COMPU_METHOD
/begin COMPU_METHOD main_quad_rev3_21_200pm_CM_uint8 "" IDENTICAL "%3.0" "" /end COMPU_METHOD
/begin RECORD_LAYOUT Scalar_BOOLEAN FNC_VALUES 1 UBYTE COLUMN_DIR DIRECT /end RECORD_LAYOUT
/begin RECORD_LAYOUT Scalar_FLOAT64_IEEE FNC_VALUES 1 FLOAT64_IEEE COLUMN_DIR DIRECT /end RECORD_LAYOUT
/begin RECORD_LAYOUT Scalar_SLONG FNC_VALUES 1 SLONG COLUMN_DIR DIRECT /end RECORD_LAYOUT
/begin RECORD_LAYOUT Scalar_UBYTE FNC_VALUES 1 UBYTE COLUMN_DIR DIRECT /end RECORD_LAYOUT
/begin RECORD_LAYOUT Scalar_ULONG FNC_VALUES 1 ULONG COLUMN_DIR DIRECT /end RECORD_LAYOUT
/begin RECORD_LAYOUT Scalar_UWORD FNC_VALUES 1 UWORD COLUMN_DIR DIRECT /end RECORD_LAYOUT
/begin GROUP main_quad_rev3_21_200pm "main_quad_rev3_21_200pm" ROOT /end GROUP
/end MODULE
/end PROJECT
