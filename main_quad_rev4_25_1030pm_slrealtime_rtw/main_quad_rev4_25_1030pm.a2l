/******************************************************************************
* ASAP2 file: main_quad_rev4_25_1030pm.a2l
* Academic License - for use in teaching, academic research, and meeting
* course requirements at degree granting institutions only. Not for
* government, commercial, or other organizational use.
* Code generation for model "main_quad_rev4_25_1030pm".
* Model version : 1.58
* Simulink Coder version : 10.3 R2021a
* C source code generated on : Thu May 26 16:46:32 2022
* Target selection: slrealtime.tlc
* Embedded hardware selection: Intel->x86-64 (Linux 64)
* Code generation objectives: Unspecified
* Validation result: Not run
* (add additional file header information here)
******************************************************************************/ ASAP2_VERSION 1 71
/begin PROJECT ProjectName "Project Comment Goes Here"
/begin HEADER "Header Comments go here" /end HEADER
/begin MODULE ModuleName "Module Comment Goes Here"
/begin IF_DATA XCP
 /begin PROTOCOL_LAYER 0x0100 0x03E8 0x00C8 0x0000 0x0000 0x0000 0x0000 0x0000 0xFC 0x0578 BYTE_ORDER_MSB_LAST ADDRESS_GRANULARITY_BYTE OPTIONAL_CMD ALLOC_ODT_ENTRY OPTIONAL_CMD ALLOC_ODT OPTIONAL_CMD ALLOC_DAQ OPTIONAL_CMD FREE_DAQ OPTIONAL_CMD GET_DAQ_RESOLUTION_INFO OPTIONAL_CMD GET_DAQ_PROCESSOR_INFO OPTIONAL_CMD START_STOP_SYNCH OPTIONAL_CMD START_STOP_DAQ_LIST OPTIONAL_CMD SET_DAQ_LIST_MODE OPTIONAL_CMD WRITE_DAQ OPTIONAL_CMD SET_DAQ_PTR OPTIONAL_CMD GET_CAL_PAGE OPTIONAL_CMD SET_CAL_PAGE OPTIONAL_CMD COPY_CAL_PAGE OPTIONAL_CMD SHORT_DOWNLOAD OPTIONAL_CMD DOWNLOAD_MAX OPTIONAL_CMD DOWNLOAD OPTIONAL_CMD SHORT_UPLOAD OPTIONAL_CMD UPLOAD OPTIONAL_CMD SET_MTA /end PROTOCOL_LAYER
 /begin DAQ DYNAMIC 0x0000 0x0080 0x00 OPTIMISATION_TYPE_DEFAULT ADDRESS_EXTENSION_FREE IDENTIFICATION_FIELD_TYPE_RELATIVE_WORD_ALIGNED GRANULARITY_ODT_ENTRY_SIZE_DAQ_BYTE 0xFF OVERLOAD_INDICATION_PID PRESCALER_SUPPORTED /begin STIM GRANULARITY_ODT_ENTRY_SIZE_STIM_BYTE 0xFF /end STIM /begin TIMESTAMP_SUPPORTED 0x0001 SIZE_DWORD UNIT_1US TIMESTAMP_FIXED /end TIMESTAMP_SUPPORTED /begin EVENT "5 ms" "5 ms" 0x0000 DAQ 0xFF 0x05 0x06 0x00 /end EVENT /end DAQ
 /begin XCP_ON_UDP_IP 0x0100 0x15B3 ADDRESS "192.168.7.5" /end XCP_ON_UDP_IP
/end IF_DATA
/begin MOD_PAR "MOD PAR Comment Goes Here"
 /begin MEMORY_SEGMENT main_quad_rev4_25_1030_cal_impl "main_quad_rev4_25_1030_cal_impl" DATA FLASH INTERN 0x0021A020 0x9C8 -1 -1 -1 -1 -1
  /begin IF_DATA XCP
   /begin SEGMENT 0x00 0x02 0x00 0x00 0x00
    /begin PAGE 0x00 ECU_ACCESS_DONT_CARE XCP_READ_ACCESS_DONT_CARE XCP_WRITE_ACCESS_NOT_ALLOWED /end PAGE
    /begin PAGE 0x01 ECU_ACCESS_DONT_CARE XCP_READ_ACCESS_DONT_CARE XCP_WRITE_ACCESS_DONT_CARE /end PAGE
   /end SEGMENT
  /end IF_DATA
 /end MEMORY_SEGMENT
/end MOD_PAR
/begin MOD_COMMON "Mod Common Comment Here" BYTE_ORDER MSB_LAST ALIGNMENT_BYTE 1 ALIGNMENT_WORD 2 ALIGNMENT_LONG 8 ALIGNMENT_FLOAT32_IEEE 4 ALIGNMENT_FLOAT64_IEEE 8 ALIGNMENT_INT64 4 /end MOD_COMMON
/begin CHARACTERISTIC main_quad_rev4_25_1030_cal_impl.CANRead_P1 "" VAL_BLK 0x0021A290 Scalar_FLOAT64_IEEE 0 main_quad_rev4_25_1030pm_CM_double -1.7E+308 1.7E+308 MATRIX_DIM 6 1 /end CHARACTERISTIC
/begin CHARACTERISTIC main_quad_rev4_25_1030_cal_impl.CANRead_P1_j "" VAL_BLK 0x0021A310 Scalar_FLOAT64_IEEE 0 main_quad_rev4_25_1030pm_CM_double -1.7E+308 1.7E+308 MATRIX_DIM 6 1 /end CHARACTERISTIC
/begin CHARACTERISTIC main_quad_rev4_25_1030_cal_impl.CANSetup_P1 "" VAL_BLK 0x0021A370 Scalar_FLOAT64_IEEE 0 main_quad_rev4_25_1030pm_CM_double -1.7E+308 1.7E+308 MATRIX_DIM 40 1 /end CHARACTERISTIC
/begin CHARACTERISTIC main_quad_rev4_25_1030_cal_impl.CANSetup_P2 "" VALUE 0x0021A4C0 Scalar_FLOAT64_IEEE 0 main_quad_rev4_25_1030pm_CM_double -1.7E+308 1.7E+308 /end CHARACTERISTIC
/begin CHARACTERISTIC main_quad_rev4_25_1030_cal_impl.CANSetup_P3 "" VALUE 0x0021A4D8 Scalar_FLOAT64_IEEE 0 main_quad_rev4_25_1030pm_CM_double -1.7E+308 1.7E+308 /end CHARACTERISTIC
/begin CHARACTERISTIC main_quad_rev4_25_1030_cal_impl.CANStatus_P1 "" VALUE 0x0021A608 Scalar_FLOAT64_IEEE 0 main_quad_rev4_25_1030pm_CM_double -1.7E+308 1.7E+308 /end CHARACTERISTIC
/begin CHARACTERISTIC main_quad_rev4_25_1030_cal_impl.CANStatus_P10 "" VALUE 0x0021A6E0 Scalar_FLOAT64_IEEE 0 main_quad_rev4_25_1030pm_CM_double -1.7E+308 1.7E+308 /end CHARACTERISTIC
/begin CHARACTERISTIC main_quad_rev4_25_1030_cal_impl.CANStatus_P11 "" VALUE 0x0021A6F8 Scalar_FLOAT64_IEEE 0 main_quad_rev4_25_1030pm_CM_double -1.7E+308 1.7E+308 /end CHARACTERISTIC
/begin CHARACTERISTIC main_quad_rev4_25_1030_cal_impl.CANStatus_P12 "" VALUE 0x0021A710 Scalar_FLOAT64_IEEE 0 main_quad_rev4_25_1030pm_CM_double -1.7E+308 1.7E+308 /end CHARACTERISTIC
/begin CHARACTERISTIC main_quad_rev4_25_1030_cal_impl.CANStatus_P13 "" VALUE 0x0021A728 Scalar_FLOAT64_IEEE 0 main_quad_rev4_25_1030pm_CM_double -1.7E+308 1.7E+308 /end CHARACTERISTIC
/begin CHARACTERISTIC main_quad_rev4_25_1030_cal_impl.CANStatus_P14 "" VALUE 0x0021A740 Scalar_FLOAT64_IEEE 0 main_quad_rev4_25_1030pm_CM_double -1.7E+308 1.7E+308 /end CHARACTERISTIC
/begin CHARACTERISTIC main_quad_rev4_25_1030_cal_impl.CANStatus_P15 "" VALUE 0x0021A758 Scalar_FLOAT64_IEEE 0 main_quad_rev4_25_1030pm_CM_double -1.7E+308 1.7E+308 /end CHARACTERISTIC
/begin CHARACTERISTIC main_quad_rev4_25_1030_cal_impl.CANStatus_P16 "" VALUE 0x0021A770 Scalar_FLOAT64_IEEE 0 main_quad_rev4_25_1030pm_CM_double -1.7E+308 1.7E+308 /end CHARACTERISTIC
/begin CHARACTERISTIC main_quad_rev4_25_1030_cal_impl.CANStatus_P17 "" VALUE 0x0021A788 Scalar_FLOAT64_IEEE 0 main_quad_rev4_25_1030pm_CM_double -1.7E+308 1.7E+308 /end CHARACTERISTIC
/begin CHARACTERISTIC main_quad_rev4_25_1030_cal_impl.CANStatus_P18 "" VALUE 0x0021A7A0 Scalar_FLOAT64_IEEE 0 main_quad_rev4_25_1030pm_CM_double -1.7E+308 1.7E+308 /end CHARACTERISTIC
/begin CHARACTERISTIC main_quad_rev4_25_1030_cal_impl.CANStatus_P19 "" VALUE 0x0021A7B8 Scalar_FLOAT64_IEEE 0 main_quad_rev4_25_1030pm_CM_double -1.7E+308 1.7E+308 /end CHARACTERISTIC
/begin CHARACTERISTIC main_quad_rev4_25_1030_cal_impl.CANStatus_P2 "" VALUE 0x0021A620 Scalar_FLOAT64_IEEE 0 main_quad_rev4_25_1030pm_CM_double -1.7E+308 1.7E+308 /end CHARACTERISTIC
/begin CHARACTERISTIC main_quad_rev4_25_1030_cal_impl.CANStatus_P20 "" VALUE 0x0021A7D0 Scalar_FLOAT64_IEEE 0 main_quad_rev4_25_1030pm_CM_double -1.7E+308 1.7E+308 /end CHARACTERISTIC
/begin CHARACTERISTIC main_quad_rev4_25_1030_cal_impl.CANStatus_P21 "" VALUE 0x0021A7E8 Scalar_FLOAT64_IEEE 0 main_quad_rev4_25_1030pm_CM_double -1.7E+308 1.7E+308 /end CHARACTERISTIC
/begin CHARACTERISTIC main_quad_rev4_25_1030_cal_impl.CANStatus_P22 "" VALUE 0x0021A800 Scalar_FLOAT64_IEEE 0 main_quad_rev4_25_1030pm_CM_double -1.7E+308 1.7E+308 /end CHARACTERISTIC
/begin CHARACTERISTIC main_quad_rev4_25_1030_cal_impl.CANStatus_P23 "" VALUE 0x0021A818 Scalar_FLOAT64_IEEE 0 main_quad_rev4_25_1030pm_CM_double -1.7E+308 1.7E+308 /end CHARACTERISTIC
/begin CHARACTERISTIC main_quad_rev4_25_1030_cal_impl.CANStatus_P24 "" VALUE 0x0021A830 Scalar_FLOAT64_IEEE 0 main_quad_rev4_25_1030pm_CM_double -1.7E+308 1.7E+308 /end CHARACTERISTIC
/begin CHARACTERISTIC main_quad_rev4_25_1030_cal_impl.CANStatus_P25 "" VALUE 0x0021A848 Scalar_FLOAT64_IEEE 0 main_quad_rev4_25_1030pm_CM_double -1.7E+308 1.7E+308 /end CHARACTERISTIC
/begin CHARACTERISTIC main_quad_rev4_25_1030_cal_impl.CANStatus_P26 "" VALUE 0x0021A860 Scalar_FLOAT64_IEEE 0 main_quad_rev4_25_1030pm_CM_double -1.7E+308 1.7E+308 /end CHARACTERISTIC
/begin CHARACTERISTIC main_quad_rev4_25_1030_cal_impl.CANStatus_P27 "" VALUE 0x0021A878 Scalar_FLOAT64_IEEE 0 main_quad_rev4_25_1030pm_CM_double -1.7E+308 1.7E+308 /end CHARACTERISTIC
/begin CHARACTERISTIC main_quad_rev4_25_1030_cal_impl.CANStatus_P28 "" VALUE 0x0021A890 Scalar_FLOAT64_IEEE 0 main_quad_rev4_25_1030pm_CM_double -1.7E+308 1.7E+308 /end CHARACTERISTIC
/begin CHARACTERISTIC main_quad_rev4_25_1030_cal_impl.CANStatus_P29 "" VALUE 0x0021A8A8 Scalar_FLOAT64_IEEE 0 main_quad_rev4_25_1030pm_CM_double -1.7E+308 1.7E+308 /end CHARACTERISTIC
/begin CHARACTERISTIC main_quad_rev4_25_1030_cal_impl.CANStatus_P3 "" VALUE 0x0021A638 Scalar_FLOAT64_IEEE 0 main_quad_rev4_25_1030pm_CM_double -1.7E+308 1.7E+308 /end CHARACTERISTIC
/begin CHARACTERISTIC main_quad_rev4_25_1030_cal_impl.CANStatus_P30 "" VALUE 0x0021A8C0 Scalar_FLOAT64_IEEE 0 main_quad_rev4_25_1030pm_CM_double -1.7E+308 1.7E+308 /end CHARACTERISTIC
/begin CHARACTERISTIC main_quad_rev4_25_1030_cal_impl.CANStatus_P31 "" VALUE 0x0021A8D8 Scalar_FLOAT64_IEEE 0 main_quad_rev4_25_1030pm_CM_double -1.7E+308 1.7E+308 /end CHARACTERISTIC
/begin CHARACTERISTIC main_quad_rev4_25_1030_cal_impl.CANStatus_P32 "" VALUE 0x0021A8F0 Scalar_FLOAT64_IEEE 0 main_quad_rev4_25_1030pm_CM_double -1.7E+308 1.7E+308 /end CHARACTERISTIC
/begin CHARACTERISTIC main_quad_rev4_25_1030_cal_impl.CANStatus_P33 "" VALUE 0x0021A908 Scalar_FLOAT64_IEEE 0 main_quad_rev4_25_1030pm_CM_double -1.7E+308 1.7E+308 /end CHARACTERISTIC
/begin CHARACTERISTIC main_quad_rev4_25_1030_cal_impl.CANStatus_P34 "" VALUE 0x0021A920 Scalar_FLOAT64_IEEE 0 main_quad_rev4_25_1030pm_CM_double -1.7E+308 1.7E+308 /end CHARACTERISTIC
/begin CHARACTERISTIC main_quad_rev4_25_1030_cal_impl.CANStatus_P4 "" VALUE 0x0021A650 Scalar_FLOAT64_IEEE 0 main_quad_rev4_25_1030pm_CM_double -1.7E+308 1.7E+308 /end CHARACTERISTIC
/begin CHARACTERISTIC main_quad_rev4_25_1030_cal_impl.CANStatus_P5 "" VALUE 0x0021A668 Scalar_FLOAT64_IEEE 0 main_quad_rev4_25_1030pm_CM_double -1.7E+308 1.7E+308 /end CHARACTERISTIC
/begin CHARACTERISTIC main_quad_rev4_25_1030_cal_impl.CANStatus_P6 "" VALUE 0x0021A680 Scalar_FLOAT64_IEEE 0 main_quad_rev4_25_1030pm_CM_double -1.7E+308 1.7E+308 /end CHARACTERISTIC
/begin CHARACTERISTIC main_quad_rev4_25_1030_cal_impl.CANStatus_P7 "" VALUE 0x0021A698 Scalar_FLOAT64_IEEE 0 main_quad_rev4_25_1030pm_CM_double -1.7E+308 1.7E+308 /end CHARACTERISTIC
/begin CHARACTERISTIC main_quad_rev4_25_1030_cal_impl.CANStatus_P8 "" VALUE 0x0021A6B0 Scalar_FLOAT64_IEEE 0 main_quad_rev4_25_1030pm_CM_double -1.7E+308 1.7E+308 /end CHARACTERISTIC
/begin CHARACTERISTIC main_quad_rev4_25_1030_cal_impl.CANStatus_P9 "" VALUE 0x0021A6C8 Scalar_FLOAT64_IEEE 0 main_quad_rev4_25_1030pm_CM_double -1.7E+308 1.7E+308 /end CHARACTERISTIC
/begin CHARACTERISTIC main_quad_rev4_25_1030_cal_impl.CANWrite1_P1 "" VAL_BLK 0x0021A030 Scalar_FLOAT64_IEEE 0 main_quad_rev4_25_1030pm_CM_double -1.7E+308 1.7E+308 MATRIX_DIM 7 1 /end CHARACTERISTIC
/begin CHARACTERISTIC main_quad_rev4_25_1030_cal_impl.CANWrite1_P1_d "" VAL_BLK 0x0021A198 Scalar_FLOAT64_IEEE 0 main_quad_rev4_25_1030pm_CM_double -1.7E+308 1.7E+308 MATRIX_DIM 7 1 /end CHARACTERISTIC
/begin CHARACTERISTIC main_quad_rev4_25_1030_cal_impl.CANWrite1_P1_j "" VAL_BLK 0x0021A0C0 Scalar_FLOAT64_IEEE 0 main_quad_rev4_25_1030pm_CM_double -1.7E+308 1.7E+308 MATRIX_DIM 7 1 /end CHARACTERISTIC
/begin CHARACTERISTIC main_quad_rev4_25_1030_cal_impl.CANWrite1_P1_je "" VAL_BLK 0x0021A108 Scalar_FLOAT64_IEEE 0 main_quad_rev4_25_1030pm_CM_double -1.7E+308 1.7E+308 MATRIX_DIM 7 1 /end CHARACTERISTIC
/begin CHARACTERISTIC main_quad_rev4_25_1030_cal_impl.CANWrite1_P1_l "" VAL_BLK 0x0021A078 Scalar_FLOAT64_IEEE 0 main_quad_rev4_25_1030pm_CM_double -1.7E+308 1.7E+308 MATRIX_DIM 7 1 /end CHARACTERISTIC
/begin CHARACTERISTIC main_quad_rev4_25_1030_cal_impl.CANWrite1_P1_n "" VAL_BLK 0x0021A150 Scalar_FLOAT64_IEEE 0 main_quad_rev4_25_1030pm_CM_double -1.7E+308 1.7E+308 MATRIX_DIM 7 1 /end CHARACTERISTIC
/begin CHARACTERISTIC main_quad_rev4_25_1030_cal_impl.CANWrite1_P1_nj "" VAL_BLK 0x0021A1E0 Scalar_FLOAT64_IEEE 0 main_quad_rev4_25_1030pm_CM_double -1.7E+308 1.7E+308 MATRIX_DIM 7 1 /end CHARACTERISTIC
/begin CHARACTERISTIC main_quad_rev4_25_1030_cal_impl.CANWrite1_P1_p "" VAL_BLK 0x0021A228 Scalar_FLOAT64_IEEE 0 main_quad_rev4_25_1030pm_CM_double -1.7E+308 1.7E+308 MATRIX_DIM 7 1 /end CHARACTERISTIC
/begin CHARACTERISTIC main_quad_rev4_25_1030_cal_impl.Constant1_Value "" VAL_BLK 0x0021A930 Scalar_UBYTE 0 main_quad_rev4_25_1030pm_CM_uint8 0 255 MATRIX_DIM 8 1 /end CHARACTERISTIC
/begin CHARACTERISTIC main_quad_rev4_25_1030_cal_impl.Constant1_Value_a "" VAL_BLK 0x0021A9D8 Scalar_UBYTE 0 main_quad_rev4_25_1030pm_CM_uint8 0 255 MATRIX_DIM 8 1 /end CHARACTERISTIC
/begin CHARACTERISTIC main_quad_rev4_25_1030_cal_impl.Constant1_Value_e "" VAL_BLK 0x0021A960 Scalar_UBYTE 0 main_quad_rev4_25_1030pm_CM_uint8 0 255 MATRIX_DIM 8 1 /end CHARACTERISTIC
/begin CHARACTERISTIC main_quad_rev4_25_1030_cal_impl.Constant1_Value_f "" VAL_BLK 0x0021A978 Scalar_UBYTE 0 main_quad_rev4_25_1030pm_CM_uint8 0 255 MATRIX_DIM 8 1 /end CHARACTERISTIC
/begin CHARACTERISTIC main_quad_rev4_25_1030_cal_impl.Constant1_Value_h "" VAL_BLK 0x0021A990 Scalar_UBYTE 0 main_quad_rev4_25_1030pm_CM_uint8 0 255 MATRIX_DIM 8 1 /end CHARACTERISTIC
/begin CHARACTERISTIC main_quad_rev4_25_1030_cal_impl.Constant1_Value_i "" VAL_BLK 0x0021A9A8 Scalar_UBYTE 0 main_quad_rev4_25_1030pm_CM_uint8 0 255 MATRIX_DIM 8 1 /end CHARACTERISTIC
/begin CHARACTERISTIC main_quad_rev4_25_1030_cal_impl.Constant1_Value_k "" VAL_BLK 0x0021A948 Scalar_UBYTE 0 main_quad_rev4_25_1030pm_CM_uint8 0 255 MATRIX_DIM 8 1 /end CHARACTERISTIC
/begin CHARACTERISTIC main_quad_rev4_25_1030_cal_impl.Constant1_Value_m "" VAL_BLK 0x0021A9C0 Scalar_UBYTE 0 main_quad_rev4_25_1030pm_CM_uint8 0 255 MATRIX_DIM 8 1 /end CHARACTERISTIC
/begin CHARACTERISTIC main_quad_rev4_25_1030_cal_impl.Constant2_Value "" VALUE 0x0021A568 Scalar_FLOAT64_IEEE 0 main_quad_rev4_25_1030pm_CM_double -1.7E+308 1.7E+308 /end CHARACTERISTIC
/begin CHARACTERISTIC main_quad_rev4_25_1030_cal_impl.Constant2_Value_a "" VAL_BLK 0x0021A9E0 Scalar_UBYTE 0 main_quad_rev4_25_1030pm_CM_uint8 0 255 MATRIX_DIM 8 1 /end CHARACTERISTIC
/begin CHARACTERISTIC main_quad_rev4_25_1030_cal_impl.Constant2_Value_d "" VAL_BLK 0x0021A950 Scalar_UBYTE 0 main_quad_rev4_25_1030pm_CM_uint8 0 255 MATRIX_DIM 8 1 /end CHARACTERISTIC
/begin CHARACTERISTIC main_quad_rev4_25_1030_cal_impl.Constant2_Value_g "" VAL_BLK 0x0021A938 Scalar_UBYTE 0 main_quad_rev4_25_1030pm_CM_uint8 0 255 MATRIX_DIM 8 1 /end CHARACTERISTIC
/begin CHARACTERISTIC main_quad_rev4_25_1030_cal_impl.Constant2_Value_i "" VAL_BLK 0x0021A9C8 Scalar_UBYTE 0 main_quad_rev4_25_1030pm_CM_uint8 0 255 MATRIX_DIM 8 1 /end CHARACTERISTIC
/begin CHARACTERISTIC main_quad_rev4_25_1030_cal_impl.Constant2_Value_j "" VAL_BLK 0x0021A980 Scalar_UBYTE 0 main_quad_rev4_25_1030pm_CM_uint8 0 255 MATRIX_DIM 8 1 /end CHARACTERISTIC
/begin CHARACTERISTIC main_quad_rev4_25_1030_cal_impl.Constant2_Value_k "" VAL_BLK 0x0021A968 Scalar_UBYTE 0 main_quad_rev4_25_1030pm_CM_uint8 0 255 MATRIX_DIM 8 1 /end CHARACTERISTIC
/begin CHARACTERISTIC main_quad_rev4_25_1030_cal_impl.Constant2_Value_l "" VAL_BLK 0x0021A9B0 Scalar_UBYTE 0 main_quad_rev4_25_1030pm_CM_uint8 0 255 MATRIX_DIM 8 1 /end CHARACTERISTIC
/begin CHARACTERISTIC main_quad_rev4_25_1030_cal_impl.Constant2_Value_n "" VAL_BLK 0x0021A998 Scalar_UBYTE 0 main_quad_rev4_25_1030pm_CM_uint8 0 255 MATRIX_DIM 8 1 /end CHARACTERISTIC
/begin CHARACTERISTIC main_quad_rev4_25_1030_cal_impl.Constant8_Value "" VALUE 0x0021A530 Scalar_FLOAT64_IEEE 0 main_quad_rev4_25_1030pm_CM_double -1.7E+308 1.7E+308 /end CHARACTERISTIC
/begin CHARACTERISTIC main_quad_rev4_25_1030_cal_impl.Constant_Value "" VALUE 0x0021A4F0 Scalar_FLOAT64_IEEE 0 main_quad_rev4_25_1030pm_CM_double -1.7E+308 1.7E+308 /end CHARACTERISTIC
/begin CHARACTERISTIC main_quad_rev4_25_1030_cal_impl.Constant_Value_b "" VAL_BLK 0x0021A988 Scalar_UBYTE 0 main_quad_rev4_25_1030pm_CM_uint8 0 255 MATRIX_DIM 8 1 /end CHARACTERISTIC
/begin CHARACTERISTIC main_quad_rev4_25_1030_cal_impl.Constant_Value_bb "" VAL_BLK 0x0021A9A0 Scalar_UBYTE 0 main_quad_rev4_25_1030pm_CM_uint8 0 255 MATRIX_DIM 8 1 /end CHARACTERISTIC
/begin CHARACTERISTIC main_quad_rev4_25_1030_cal_impl.Constant_Value_i "" VAL_BLK 0x0021A958 Scalar_UBYTE 0 main_quad_rev4_25_1030pm_CM_uint8 0 255 MATRIX_DIM 8 1 /end CHARACTERISTIC
/begin CHARACTERISTIC main_quad_rev4_25_1030_cal_impl.Constant_Value_l "" VAL_BLK 0x0021A928 Scalar_UBYTE 0 main_quad_rev4_25_1030pm_CM_uint8 0 255 MATRIX_DIM 8 1 /end CHARACTERISTIC
/begin CHARACTERISTIC main_quad_rev4_25_1030_cal_impl.Constant_Value_le "" VAL_BLK 0x0021A970 Scalar_UBYTE 0 main_quad_rev4_25_1030pm_CM_uint8 0 255 MATRIX_DIM 8 1 /end CHARACTERISTIC
/begin CHARACTERISTIC main_quad_rev4_25_1030_cal_impl.Constant_Value_o "" VAL_BLK 0x0021A9B8 Scalar_UBYTE 0 main_quad_rev4_25_1030pm_CM_uint8 0 255 MATRIX_DIM 8 1 /end CHARACTERISTIC
/begin CHARACTERISTIC main_quad_rev4_25_1030_cal_impl.Constant_Value_ob "" VAL_BLK 0x0021A9D0 Scalar_UBYTE 0 main_quad_rev4_25_1030pm_CM_uint8 0 255 MATRIX_DIM 8 1 /end CHARACTERISTIC
/begin CHARACTERISTIC main_quad_rev4_25_1030_cal_impl.Constant_Value_p "" VAL_BLK 0x0021A940 Scalar_UBYTE 0 main_quad_rev4_25_1030pm_CM_uint8 0 255 MATRIX_DIM 8 1 /end CHARACTERISTIC
/begin CHARACTERISTIC main_quad_rev4_25_1030_cal_impl.Delay10_InitialCondition "" VALUE 0x0021A4F8 Scalar_FLOAT64_IEEE 0 main_quad_rev4_25_1030pm_CM_double -1.7E+308 1.7E+308 /end CHARACTERISTIC
/begin CHARACTERISTIC main_quad_rev4_25_1030_cal_impl.Delay11_InitialCondition "" VALUE 0x0021A510 Scalar_FLOAT64_IEEE 0 main_quad_rev4_25_1030pm_CM_double -1.7E+308 1.7E+308 /end CHARACTERISTIC
/begin CHARACTERISTIC main_quad_rev4_25_1030_cal_impl.Delay4_InitialCondition "" VALUE 0x0021A518 Scalar_FLOAT64_IEEE 0 main_quad_rev4_25_1030pm_CM_double -1.7E+308 1.7E+308 /end CHARACTERISTIC
/begin CHARACTERISTIC main_quad_rev4_25_1030_cal_impl.Delay5_InitialCondition "" VALUE 0x0021A4E8 Scalar_FLOAT64_IEEE 0 main_quad_rev4_25_1030pm_CM_double -1.7E+308 1.7E+308 /end CHARACTERISTIC
/begin CHARACTERISTIC main_quad_rev4_25_1030_cal_impl.Delay6_InitialCondition "" VALUE 0x0021A520 Scalar_FLOAT64_IEEE 0 main_quad_rev4_25_1030pm_CM_double -1.7E+308 1.7E+308 /end CHARACTERISTIC
/begin CHARACTERISTIC main_quad_rev4_25_1030_cal_impl.Delay7_InitialCondition "" VALUE 0x0021A500 Scalar_FLOAT64_IEEE 0 main_quad_rev4_25_1030pm_CM_double -1.7E+308 1.7E+308 /end CHARACTERISTIC
/begin CHARACTERISTIC main_quad_rev4_25_1030_cal_impl.Delay8_InitialCondition "" VALUE 0x0021A4E0 Scalar_FLOAT64_IEEE 0 main_quad_rev4_25_1030pm_CM_double -1.7E+308 1.7E+308 /end CHARACTERISTIC
/begin CHARACTERISTIC main_quad_rev4_25_1030_cal_impl.Delay9_InitialCondition "" VALUE 0x0021A508 Scalar_FLOAT64_IEEE 0 main_quad_rev4_25_1030pm_CM_double -1.7E+308 1.7E+308 /end CHARACTERISTIC
/begin CHARACTERISTIC main_quad_rev4_25_1030_cal_impl.Gain10_Gain "" VALUE 0x0021A580 Scalar_FLOAT64_IEEE 0 main_quad_rev4_25_1030pm_CM_double -1.7E+308 1.7E+308 /end CHARACTERISTIC
/begin CHARACTERISTIC main_quad_rev4_25_1030_cal_impl.Gain11_Gain "" VALUE 0x0021A588 Scalar_FLOAT64_IEEE 0 main_quad_rev4_25_1030pm_CM_double -1.7E+308 1.7E+308 /end CHARACTERISTIC
/begin CHARACTERISTIC main_quad_rev4_25_1030_cal_impl.Gain12_Gain "" VALUE 0x0021A598 Scalar_FLOAT64_IEEE 0 main_quad_rev4_25_1030pm_CM_double -1.7E+308 1.7E+308 /end CHARACTERISTIC
/begin CHARACTERISTIC main_quad_rev4_25_1030_cal_impl.Gain13_Gain "" VALUE 0x0021A5A0 Scalar_FLOAT64_IEEE 0 main_quad_rev4_25_1030pm_CM_double -1.7E+308 1.7E+308 /end CHARACTERISTIC
/begin CHARACTERISTIC main_quad_rev4_25_1030_cal_impl.Gain14_Gain "" VALUE 0x0021A5C0 Scalar_FLOAT64_IEEE 0 main_quad_rev4_25_1030pm_CM_double -1.7E+308 1.7E+308 /end CHARACTERISTIC
/begin CHARACTERISTIC main_quad_rev4_25_1030_cal_impl.Gain15_Gain "" VALUE 0x0021A5A8 Scalar_FLOAT64_IEEE 0 main_quad_rev4_25_1030pm_CM_double -1.7E+308 1.7E+308 /end CHARACTERISTIC
/begin CHARACTERISTIC main_quad_rev4_25_1030_cal_impl.Gain16_Gain "" VALUE 0x0021A5B0 Scalar_FLOAT64_IEEE 0 main_quad_rev4_25_1030pm_CM_double -1.7E+308 1.7E+308 /end CHARACTERISTIC
/begin CHARACTERISTIC main_quad_rev4_25_1030_cal_impl.Gain17_Gain "" VALUE 0x0021A5B8 Scalar_FLOAT64_IEEE 0 main_quad_rev4_25_1030pm_CM_double -1.7E+308 1.7E+308 /end CHARACTERISTIC
/begin CHARACTERISTIC main_quad_rev4_25_1030_cal_impl.Gain18_Gain "" VALUE 0x0021A5C8 Scalar_FLOAT64_IEEE 0 main_quad_rev4_25_1030pm_CM_double -1.7E+308 1.7E+308 /end CHARACTERISTIC
/begin CHARACTERISTIC main_quad_rev4_25_1030_cal_impl.Gain19_Gain "" VALUE 0x0021A5D0 Scalar_FLOAT64_IEEE 0 main_quad_rev4_25_1030pm_CM_double -1.7E+308 1.7E+308 /end CHARACTERISTIC
/begin CHARACTERISTIC main_quad_rev4_25_1030_cal_impl.Gain1_Gain "" VALUE 0x0021A2C8 Scalar_FLOAT64_IEEE 0 main_quad_rev4_25_1030pm_CM_double -1.7E+308 1.7E+308 /end CHARACTERISTIC
/begin CHARACTERISTIC main_quad_rev4_25_1030_cal_impl.Gain1_Gain_a "" VALUE 0x0021A348 Scalar_FLOAT64_IEEE 0 main_quad_rev4_25_1030pm_CM_double -1.7E+308 1.7E+308 /end CHARACTERISTIC
/begin CHARACTERISTIC main_quad_rev4_25_1030_cal_impl.Gain1_Gain_o "" VALUE 0x0021A528 Scalar_FLOAT64_IEEE 0 main_quad_rev4_25_1030pm_CM_double -1.7E+308 1.7E+308 /end CHARACTERISTIC
/begin CHARACTERISTIC main_quad_rev4_25_1030_cal_impl.Gain20_Gain "" VALUE 0x0021A5F0 Scalar_FLOAT64_IEEE 0 main_quad_rev4_25_1030pm_CM_double -1.7E+308 1.7E+308 /end CHARACTERISTIC
/begin CHARACTERISTIC main_quad_rev4_25_1030_cal_impl.Gain21_Gain "" VALUE 0x0021A5D8 Scalar_FLOAT64_IEEE 0 main_quad_rev4_25_1030pm_CM_double -1.7E+308 1.7E+308 /end CHARACTERISTIC
/begin CHARACTERISTIC main_quad_rev4_25_1030_cal_impl.Gain22_Gain "" VALUE 0x0021A5E0 Scalar_FLOAT64_IEEE 0 main_quad_rev4_25_1030pm_CM_double -1.7E+308 1.7E+308 /end CHARACTERISTIC
/begin CHARACTERISTIC main_quad_rev4_25_1030_cal_impl.Gain23_Gain "" VALUE 0x0021A5E8 Scalar_FLOAT64_IEEE 0 main_quad_rev4_25_1030pm_CM_double -1.7E+308 1.7E+308 /end CHARACTERISTIC
/begin CHARACTERISTIC main_quad_rev4_25_1030_cal_impl.Gain26_Gain "" VALUE 0x0021A578 Scalar_FLOAT64_IEEE 0 main_quad_rev4_25_1030pm_CM_double -1.7E+308 1.7E+308 /end CHARACTERISTIC
/begin CHARACTERISTIC main_quad_rev4_25_1030_cal_impl.Gain2_Gain "" VALUE 0x0021A2D0 Scalar_FLOAT64_IEEE 0 main_quad_rev4_25_1030pm_CM_double -1.7E+308 1.7E+308 /end CHARACTERISTIC
/begin CHARACTERISTIC main_quad_rev4_25_1030_cal_impl.Gain2_Gain_f "" VALUE 0x0021A350 Scalar_FLOAT64_IEEE 0 main_quad_rev4_25_1030pm_CM_double -1.7E+308 1.7E+308 /end CHARACTERISTIC
/begin CHARACTERISTIC main_quad_rev4_25_1030_cal_impl.Gain2_Gain_n "" VALUE 0x0021A538 Scalar_FLOAT64_IEEE 0 main_quad_rev4_25_1030pm_CM_double -1.7E+308 1.7E+308 /end CHARACTERISTIC
/begin CHARACTERISTIC main_quad_rev4_25_1030_cal_impl.Gain3_Gain "" VALUE 0x0021A2D8 Scalar_FLOAT64_IEEE 0 main_quad_rev4_25_1030pm_CM_double -1.7E+308 1.7E+308 /end CHARACTERISTIC
/begin CHARACTERISTIC main_quad_rev4_25_1030_cal_impl.Gain3_Gain_i "" VALUE 0x0021A358 Scalar_FLOAT64_IEEE 0 main_quad_rev4_25_1030pm_CM_double -1.7E+308 1.7E+308 /end CHARACTERISTIC
/begin CHARACTERISTIC main_quad_rev4_25_1030_cal_impl.Gain3_Gain_im "" VALUE 0x0021A540 Scalar_FLOAT64_IEEE 0 main_quad_rev4_25_1030pm_CM_double -1.7E+308 1.7E+308 /end CHARACTERISTIC
/begin CHARACTERISTIC main_quad_rev4_25_1030_cal_impl.Gain4_Gain "" VALUE 0x0021A560 Scalar_FLOAT64_IEEE 0 main_quad_rev4_25_1030pm_CM_double -1.7E+308 1.7E+308 /end CHARACTERISTIC
/begin CHARACTERISTIC main_quad_rev4_25_1030_cal_impl.Gain5_Gain "" VALUE 0x0021A570 Scalar_FLOAT64_IEEE 0 main_quad_rev4_25_1030pm_CM_double -1.7E+308 1.7E+308 /end CHARACTERISTIC
/begin CHARACTERISTIC main_quad_rev4_25_1030_cal_impl.Gain6_Gain "" VALUE 0x0021A548 Scalar_FLOAT64_IEEE 0 main_quad_rev4_25_1030pm_CM_double -1.7E+308 1.7E+308 /end CHARACTERISTIC
/begin CHARACTERISTIC main_quad_rev4_25_1030_cal_impl.Gain7_Gain "" VALUE 0x0021A550 Scalar_FLOAT64_IEEE 0 main_quad_rev4_25_1030pm_CM_double -1.7E+308 1.7E+308 /end CHARACTERISTIC
/begin CHARACTERISTIC main_quad_rev4_25_1030_cal_impl.Gain8_Gain "" VALUE 0x0021A590 Scalar_FLOAT64_IEEE 0 main_quad_rev4_25_1030pm_CM_double -1.7E+308 1.7E+308 /end CHARACTERISTIC
/begin CHARACTERISTIC main_quad_rev4_25_1030_cal_impl.Gain9_Gain "" VALUE 0x0021A558 Scalar_FLOAT64_IEEE 0 main_quad_rev4_25_1030pm_CM_double -1.7E+308 1.7E+308 /end CHARACTERISTIC
/begin CHARACTERISTIC main_quad_rev4_25_1030_cal_impl.Gain_Gain "" VALUE 0x0021A2C0 Scalar_FLOAT64_IEEE 0 main_quad_rev4_25_1030pm_CM_double -1.7E+308 1.7E+308 /end CHARACTERISTIC
/begin CHARACTERISTIC main_quad_rev4_25_1030_cal_impl.Gain_Gain_e "" VALUE 0x0021A340 Scalar_FLOAT64_IEEE 0 main_quad_rev4_25_1030pm_CM_double -1.7E+308 1.7E+308 /end CHARACTERISTIC
/begin CHARACTERISTIC main_quad_rev4_25_1030_cal_impl.P1_Y0 "" VALUE 0x0021A2E0 Scalar_FLOAT64_IEEE 0 main_quad_rev4_25_1030pm_CM_double -1.7E+308 1.7E+308 /end CHARACTERISTIC
/begin CHARACTERISTIC main_quad_rev4_25_1030_cal_impl.P2_Y0 "" VALUE 0x0021A260 Scalar_FLOAT64_IEEE 0 main_quad_rev4_25_1030pm_CM_double -1.7E+308 1.7E+308 /end CHARACTERISTIC
/begin CHARACTERISTIC main_quad_rev4_25_1030_cal_impl.P3_Y0 "" VALUE 0x0021A2E8 Scalar_FLOAT64_IEEE 0 main_quad_rev4_25_1030pm_CM_double -1.7E+308 1.7E+308 /end CHARACTERISTIC
/begin CHARACTERISTIC main_quad_rev4_25_1030_cal_impl.P4_Y0 "" VALUE 0x0021A268 Scalar_FLOAT64_IEEE 0 main_quad_rev4_25_1030pm_CM_double -1.7E+308 1.7E+308 /end CHARACTERISTIC
/begin CHARACTERISTIC main_quad_rev4_25_1030_cal_impl.P5_Y0 "" VALUE 0x0021A2F0 Scalar_FLOAT64_IEEE 0 main_quad_rev4_25_1030pm_CM_double -1.7E+308 1.7E+308 /end CHARACTERISTIC
/begin CHARACTERISTIC main_quad_rev4_25_1030_cal_impl.P6_Y0 "" VALUE 0x0021A270 Scalar_FLOAT64_IEEE 0 main_quad_rev4_25_1030pm_CM_double -1.7E+308 1.7E+308 /end CHARACTERISTIC
/begin CHARACTERISTIC main_quad_rev4_25_1030_cal_impl.P7_Y0 "" VALUE 0x0021A2F8 Scalar_FLOAT64_IEEE 0 main_quad_rev4_25_1030pm_CM_double -1.7E+308 1.7E+308 /end CHARACTERISTIC
/begin CHARACTERISTIC main_quad_rev4_25_1030_cal_impl.P8_Y0 "" VALUE 0x0021A278 Scalar_FLOAT64_IEEE 0 main_quad_rev4_25_1030pm_CM_double -1.7E+308 1.7E+308 /end CHARACTERISTIC
/begin MEASUREMENT main_quad_rev4_25_1030pm_B.BytePacking "" UBYTE main_quad_rev4_25_1030pm_CM_uint8 0 0 0 255 LAYOUT COLUMN_DIR MATRIX_DIM 8 ECU_ADDRESS 0x00220F20 /end MEASUREMENT
/begin MEASUREMENT main_quad_rev4_25_1030pm_B.BytePacking_a "" UBYTE main_quad_rev4_25_1030pm_CM_uint8 0 0 0 255 LAYOUT COLUMN_DIR MATRIX_DIM 8 ECU_ADDRESS 0x00220F40 /end MEASUREMENT
/begin MEASUREMENT main_quad_rev4_25_1030pm_B.BytePacking_d "" UBYTE main_quad_rev4_25_1030pm_CM_uint8 0 0 0 255 LAYOUT COLUMN_DIR MATRIX_DIM 8 ECU_ADDRESS 0x00220F70 /end MEASUREMENT
/begin MEASUREMENT main_quad_rev4_25_1030pm_B.BytePacking_f "" UBYTE main_quad_rev4_25_1030pm_CM_uint8 0 0 0 255 LAYOUT COLUMN_DIR MATRIX_DIM 8 ECU_ADDRESS 0x00220F50 /end MEASUREMENT
/begin MEASUREMENT main_quad_rev4_25_1030pm_B.BytePacking_k "" UBYTE main_quad_rev4_25_1030pm_CM_uint8 0 0 0 255 LAYOUT COLUMN_DIR MATRIX_DIM 8 ECU_ADDRESS 0x00220F80 /end MEASUREMENT
/begin MEASUREMENT main_quad_rev4_25_1030pm_B.BytePacking_o "" UBYTE main_quad_rev4_25_1030pm_CM_uint8 0 0 0 255 LAYOUT COLUMN_DIR MATRIX_DIM 8 ECU_ADDRESS 0x00220F30 /end MEASUREMENT
/begin MEASUREMENT main_quad_rev4_25_1030pm_B.BytePacking_or "" UBYTE main_quad_rev4_25_1030pm_CM_uint8 0 0 0 255 LAYOUT COLUMN_DIR MATRIX_DIM 8 ECU_ADDRESS 0x00220F90 /end MEASUREMENT
/begin MEASUREMENT main_quad_rev4_25_1030pm_B.BytePacking_p "" UBYTE main_quad_rev4_25_1030pm_CM_uint8 0 0 0 255 LAYOUT COLUMN_DIR MATRIX_DIM 8 ECU_ADDRESS 0x00220F60 /end MEASUREMENT
/begin MEASUREMENT main_quad_rev4_25_1030pm_B.CANRead_o1 "" UBYTE main_quad_rev4_25_1030pm_CM_logical 0 0 0 1 ECU_ADDRESS 0x00220F98 /end MEASUREMENT
/begin MEASUREMENT main_quad_rev4_25_1030pm_B.CANRead_o1_d "" UBYTE main_quad_rev4_25_1030pm_CM_logical 0 0 0 1 ECU_ADDRESS 0x00220F99 /end MEASUREMENT
/begin MEASUREMENT main_quad_rev4_25_1030pm_B.CANUnpack_o1 "" FLOAT64_IEEE main_quad_rev4_25_1030pm_CM_double 0 0 -1.7E+308 1.7E+308 ECU_ADDRESS 0x00220D20 /end MEASUREMENT
/begin MEASUREMENT main_quad_rev4_25_1030pm_B.CANUnpack_o1_c "" FLOAT64_IEEE main_quad_rev4_25_1030pm_CM_double 0 0 -1.7E+308 1.7E+308 ECU_ADDRESS 0x00220DE0 /end MEASUREMENT
/begin MEASUREMENT main_quad_rev4_25_1030pm_B.CANUnpack_o1_h "" FLOAT64_IEEE main_quad_rev4_25_1030pm_CM_double 0 0 -1.7E+308 1.7E+308 ECU_ADDRESS 0x00220D60 /end MEASUREMENT
/begin MEASUREMENT main_quad_rev4_25_1030pm_B.CANUnpack_o1_j "" FLOAT64_IEEE main_quad_rev4_25_1030pm_CM_double 0 0 -1.7E+308 1.7E+308 ECU_ADDRESS 0x00220D40 /end MEASUREMENT
/begin MEASUREMENT main_quad_rev4_25_1030pm_B.CANUnpack_o1_k "" FLOAT64_IEEE main_quad_rev4_25_1030pm_CM_double 0 0 -1.7E+308 1.7E+308 ECU_ADDRESS 0x00220D80 /end MEASUREMENT
/begin MEASUREMENT main_quad_rev4_25_1030pm_B.CANUnpack_o1_l "" FLOAT64_IEEE main_quad_rev4_25_1030pm_CM_double 0 0 -1.7E+308 1.7E+308 ECU_ADDRESS 0x00220E00 /end MEASUREMENT
/begin MEASUREMENT main_quad_rev4_25_1030pm_B.CANUnpack_o1_lm "" FLOAT64_IEEE main_quad_rev4_25_1030pm_CM_double 0 0 -1.7E+308 1.7E+308 ECU_ADDRESS 0x00220E20 /end MEASUREMENT
/begin MEASUREMENT main_quad_rev4_25_1030pm_B.CANUnpack_o1_p "" FLOAT64_IEEE main_quad_rev4_25_1030pm_CM_double 0 0 -1.7E+308 1.7E+308 ECU_ADDRESS 0x00220DC0 /end MEASUREMENT
/begin MEASUREMENT main_quad_rev4_25_1030pm_B.CANUnpack_o2 "" FLOAT64_IEEE main_quad_rev4_25_1030pm_CM_double 0 0 -1.7E+308 1.7E+308 ECU_ADDRESS 0x00220D28 /end MEASUREMENT
/begin MEASUREMENT main_quad_rev4_25_1030pm_B.CANUnpack_o2_b "" FLOAT64_IEEE main_quad_rev4_25_1030pm_CM_double 0 0 -1.7E+308 1.7E+308 ECU_ADDRESS 0x00220DE8 /end MEASUREMENT
/begin MEASUREMENT main_quad_rev4_25_1030pm_B.CANUnpack_o2_d "" FLOAT64_IEEE main_quad_rev4_25_1030pm_CM_double 0 0 -1.7E+308 1.7E+308 ECU_ADDRESS 0x00220E28 /end MEASUREMENT
/begin MEASUREMENT main_quad_rev4_25_1030pm_B.CANUnpack_o2_g "" FLOAT64_IEEE main_quad_rev4_25_1030pm_CM_double 0 0 -1.7E+308 1.7E+308 ECU_ADDRESS 0x00220D48 /end MEASUREMENT
/begin MEASUREMENT main_quad_rev4_25_1030pm_B.CANUnpack_o2_h "" FLOAT64_IEEE main_quad_rev4_25_1030pm_CM_double 0 0 -1.7E+308 1.7E+308 ECU_ADDRESS 0x00220D88 /end MEASUREMENT
/begin MEASUREMENT main_quad_rev4_25_1030pm_B.CANUnpack_o2_k "" FLOAT64_IEEE main_quad_rev4_25_1030pm_CM_double 0 0 -1.7E+308 1.7E+308 ECU_ADDRESS 0x00220D68 /end MEASUREMENT
/begin MEASUREMENT main_quad_rev4_25_1030pm_B.CANUnpack_o2_kk "" FLOAT64_IEEE main_quad_rev4_25_1030pm_CM_double 0 0 -1.7E+308 1.7E+308 ECU_ADDRESS 0x00220DC8 /end MEASUREMENT
/begin MEASUREMENT main_quad_rev4_25_1030pm_B.CANUnpack_o2_o "" FLOAT64_IEEE main_quad_rev4_25_1030pm_CM_double 0 0 -1.7E+308 1.7E+308 ECU_ADDRESS 0x00220E08 /end MEASUREMENT
/begin MEASUREMENT main_quad_rev4_25_1030pm_B.CANUnpack_o3 "" FLOAT64_IEEE main_quad_rev4_25_1030pm_CM_double 0 0 -1.7E+308 1.7E+308 ECU_ADDRESS 0x00220D30 /end MEASUREMENT
/begin MEASUREMENT main_quad_rev4_25_1030pm_B.CANUnpack_o3_a "" FLOAT64_IEEE main_quad_rev4_25_1030pm_CM_double 0 0 -1.7E+308 1.7E+308 ECU_ADDRESS 0x00220D90 /end MEASUREMENT
/begin MEASUREMENT main_quad_rev4_25_1030pm_B.CANUnpack_o3_d "" FLOAT64_IEEE main_quad_rev4_25_1030pm_CM_double 0 0 -1.7E+308 1.7E+308 ECU_ADDRESS 0x00220E10 /end MEASUREMENT
/begin MEASUREMENT main_quad_rev4_25_1030pm_B.CANUnpack_o3_e "" FLOAT64_IEEE main_quad_rev4_25_1030pm_CM_double 0 0 -1.7E+308 1.7E+308 ECU_ADDRESS 0x00220DD0 /end MEASUREMENT
/begin MEASUREMENT main_quad_rev4_25_1030pm_B.CANUnpack_o3_g "" FLOAT64_IEEE main_quad_rev4_25_1030pm_CM_double 0 0 -1.7E+308 1.7E+308 ECU_ADDRESS 0x00220DF0 /end MEASUREMENT
/begin MEASUREMENT main_quad_rev4_25_1030pm_B.CANUnpack_o3_i "" FLOAT64_IEEE main_quad_rev4_25_1030pm_CM_double 0 0 -1.7E+308 1.7E+308 ECU_ADDRESS 0x00220D70 /end MEASUREMENT
/begin MEASUREMENT main_quad_rev4_25_1030pm_B.CANUnpack_o3_m "" FLOAT64_IEEE main_quad_rev4_25_1030pm_CM_double 0 0 -1.7E+308 1.7E+308 ECU_ADDRESS 0x00220E30 /end MEASUREMENT
/begin MEASUREMENT main_quad_rev4_25_1030pm_B.CANUnpack_o3_p "" FLOAT64_IEEE main_quad_rev4_25_1030pm_CM_double 0 0 -1.7E+308 1.7E+308 ECU_ADDRESS 0x00220D50 /end MEASUREMENT
/begin MEASUREMENT main_quad_rev4_25_1030pm_B.CANUnpack_o4 "" FLOAT64_IEEE main_quad_rev4_25_1030pm_CM_double 0 0 -1.7E+308 1.7E+308 ECU_ADDRESS 0x00220D38 /end MEASUREMENT
/begin MEASUREMENT main_quad_rev4_25_1030pm_B.CANUnpack_o4_a "" FLOAT64_IEEE main_quad_rev4_25_1030pm_CM_double 0 0 -1.7E+308 1.7E+308 ECU_ADDRESS 0x00220E38 /end MEASUREMENT
/begin MEASUREMENT main_quad_rev4_25_1030pm_B.CANUnpack_o4_f "" FLOAT64_IEEE main_quad_rev4_25_1030pm_CM_double 0 0 -1.7E+308 1.7E+308 ECU_ADDRESS 0x00220DD8 /end MEASUREMENT
/begin MEASUREMENT main_quad_rev4_25_1030pm_B.CANUnpack_o4_j "" FLOAT64_IEEE main_quad_rev4_25_1030pm_CM_double 0 0 -1.7E+308 1.7E+308 ECU_ADDRESS 0x00220E18 /end MEASUREMENT
/begin MEASUREMENT main_quad_rev4_25_1030pm_B.CANUnpack_o4_k "" FLOAT64_IEEE main_quad_rev4_25_1030pm_CM_double 0 0 -1.7E+308 1.7E+308 ECU_ADDRESS 0x00220D58 /end MEASUREMENT
/begin MEASUREMENT main_quad_rev4_25_1030pm_B.CANUnpack_o4_kw "" FLOAT64_IEEE main_quad_rev4_25_1030pm_CM_double 0 0 -1.7E+308 1.7E+308 ECU_ADDRESS 0x00220DF8 /end MEASUREMENT
/begin MEASUREMENT main_quad_rev4_25_1030pm_B.CANUnpack_o4_l "" FLOAT64_IEEE main_quad_rev4_25_1030pm_CM_double 0 0 -1.7E+308 1.7E+308 ECU_ADDRESS 0x00220D98 /end MEASUREMENT
/begin MEASUREMENT main_quad_rev4_25_1030pm_B.CANUnpack_o4_o "" FLOAT64_IEEE main_quad_rev4_25_1030pm_CM_double 0 0 -1.7E+308 1.7E+308 ECU_ADDRESS 0x00220D78 /end MEASUREMENT
/begin MEASUREMENT main_quad_rev4_25_1030pm_B.CANUnpack_o5 "" UBYTE main_quad_rev4_25_1030pm_CM_uint8 0 0 0 255 ECU_ADDRESS 0x00220F10 /end MEASUREMENT
/begin MEASUREMENT main_quad_rev4_25_1030pm_B.CANUnpack_o5_a "" UBYTE main_quad_rev4_25_1030pm_CM_uint8 0 0 0 255 ECU_ADDRESS 0x00220F13 /end MEASUREMENT
/begin MEASUREMENT main_quad_rev4_25_1030pm_B.CANUnpack_o5_e "" UBYTE main_quad_rev4_25_1030pm_CM_uint8 0 0 0 255 ECU_ADDRESS 0x00220F12 /end MEASUREMENT
/begin MEASUREMENT main_quad_rev4_25_1030pm_B.CANUnpack_o5_f "" UBYTE main_quad_rev4_25_1030pm_CM_uint8 0 0 0 255 ECU_ADDRESS 0x00220F17 /end MEASUREMENT
/begin MEASUREMENT main_quad_rev4_25_1030pm_B.CANUnpack_o5_g "" UBYTE main_quad_rev4_25_1030pm_CM_uint8 0 0 0 255 ECU_ADDRESS 0x00220F14 /end MEASUREMENT
/begin MEASUREMENT main_quad_rev4_25_1030pm_B.CANUnpack_o5_gy "" UBYTE main_quad_rev4_25_1030pm_CM_uint8 0 0 0 255 ECU_ADDRESS 0x00220F16 /end MEASUREMENT
/begin MEASUREMENT main_quad_rev4_25_1030pm_B.CANUnpack_o5_i "" UBYTE main_quad_rev4_25_1030pm_CM_uint8 0 0 0 255 ECU_ADDRESS 0x00220F15 /end MEASUREMENT
/begin MEASUREMENT main_quad_rev4_25_1030pm_B.CANUnpack_o5_n "" UBYTE main_quad_rev4_25_1030pm_CM_uint8 0 0 0 255 ECU_ADDRESS 0x00220F11 /end MEASUREMENT
/begin MEASUREMENT main_quad_rev4_25_1030pm_B.Clock "" FLOAT64_IEEE main_quad_rev4_25_1030pm_CM_double 0 0 -1.7E+308 1.7E+308 ECU_ADDRESS 0x00220CF8 /end MEASUREMENT
/begin MEASUREMENT main_quad_rev4_25_1030pm_B.Constant "" FLOAT64_IEEE main_quad_rev4_25_1030pm_CM_double 0 0 -1.7E+308 1.7E+308 ECU_ADDRESS 0x00220C00 /end MEASUREMENT
/begin MEASUREMENT main_quad_rev4_25_1030pm_B.Gain "" FLOAT64_IEEE main_quad_rev4_25_1030pm_CM_double 0 0 -1.7E+308 1.7E+308 ECU_ADDRESS 0x00220D00 /end MEASUREMENT
/begin MEASUREMENT main_quad_rev4_25_1030pm_B.Gain1 "" FLOAT64_IEEE main_quad_rev4_25_1030pm_CM_double 0 0 -1.7E+308 1.7E+308 ECU_ADDRESS 0x00220C38 /end MEASUREMENT
/begin MEASUREMENT main_quad_rev4_25_1030pm_B.Gain10 "" FLOAT64_IEEE main_quad_rev4_25_1030pm_CM_double 0 0 -1.7E+308 1.7E+308 ECU_ADDRESS 0x00220C80 /end MEASUREMENT
/begin MEASUREMENT main_quad_rev4_25_1030pm_B.Gain11 "" FLOAT64_IEEE main_quad_rev4_25_1030pm_CM_double 0 0 -1.7E+308 1.7E+308 ECU_ADDRESS 0x00220C88 /end MEASUREMENT
/begin MEASUREMENT main_quad_rev4_25_1030pm_B.Gain12 "" FLOAT64_IEEE main_quad_rev4_25_1030pm_CM_double 0 0 -1.7E+308 1.7E+308 ECU_ADDRESS 0x00220C98 /end MEASUREMENT
/begin MEASUREMENT main_quad_rev4_25_1030pm_B.Gain13 "" FLOAT64_IEEE main_quad_rev4_25_1030pm_CM_double 0 0 -1.7E+308 1.7E+308 ECU_ADDRESS 0x00220CA0 /end MEASUREMENT
/begin MEASUREMENT main_quad_rev4_25_1030pm_B.Gain14 "" FLOAT64_IEEE main_quad_rev4_25_1030pm_CM_double 0 0 -1.7E+308 1.7E+308 ECU_ADDRESS 0x00220CC0 /end MEASUREMENT
/begin MEASUREMENT main_quad_rev4_25_1030pm_B.Gain15 "" FLOAT64_IEEE main_quad_rev4_25_1030pm_CM_double 0 0 -1.7E+308 1.7E+308 ECU_ADDRESS 0x00220CA8 /end MEASUREMENT
/begin MEASUREMENT main_quad_rev4_25_1030pm_B.Gain16 "" FLOAT64_IEEE main_quad_rev4_25_1030pm_CM_double 0 0 -1.7E+308 1.7E+308 ECU_ADDRESS 0x00220CB0 /end MEASUREMENT
/begin MEASUREMENT main_quad_rev4_25_1030pm_B.Gain17 "" FLOAT64_IEEE main_quad_rev4_25_1030pm_CM_double 0 0 -1.7E+308 1.7E+308 ECU_ADDRESS 0x00220CB8 /end MEASUREMENT
/begin MEASUREMENT main_quad_rev4_25_1030pm_B.Gain18 "" FLOAT64_IEEE main_quad_rev4_25_1030pm_CM_double 0 0 -1.7E+308 1.7E+308 ECU_ADDRESS 0x00220CC8 /end MEASUREMENT
/begin MEASUREMENT main_quad_rev4_25_1030pm_B.Gain19 "" FLOAT64_IEEE main_quad_rev4_25_1030pm_CM_double 0 0 -1.7E+308 1.7E+308 ECU_ADDRESS 0x00220CD0 /end MEASUREMENT
/begin MEASUREMENT main_quad_rev4_25_1030pm_B.Gain1_f "" FLOAT64_IEEE main_quad_rev4_25_1030pm_CM_double 0 0 -1.7E+308 1.7E+308 ECU_ADDRESS 0x00220DA8 /end MEASUREMENT
/begin MEASUREMENT main_quad_rev4_25_1030pm_B.Gain1_k "" FLOAT64_IEEE main_quad_rev4_25_1030pm_CM_double 0 0 -1.7E+308 1.7E+308 ECU_ADDRESS 0x00220D08 /end MEASUREMENT
/begin MEASUREMENT main_quad_rev4_25_1030pm_B.Gain2 "" FLOAT64_IEEE main_quad_rev4_25_1030pm_CM_double 0 0 -1.7E+308 1.7E+308 ECU_ADDRESS 0x00220C40 /end MEASUREMENT
/begin MEASUREMENT main_quad_rev4_25_1030pm_B.Gain20 "" FLOAT64_IEEE main_quad_rev4_25_1030pm_CM_double 0 0 -1.7E+308 1.7E+308 ECU_ADDRESS 0x00220CF0 /end MEASUREMENT
/begin MEASUREMENT main_quad_rev4_25_1030pm_B.Gain21 "" FLOAT64_IEEE main_quad_rev4_25_1030pm_CM_double 0 0 -1.7E+308 1.7E+308 ECU_ADDRESS 0x00220CD8 /end MEASUREMENT
/begin MEASUREMENT main_quad_rev4_25_1030pm_B.Gain22 "" FLOAT64_IEEE main_quad_rev4_25_1030pm_CM_double 0 0 -1.7E+308 1.7E+308 ECU_ADDRESS 0x00220CE0 /end MEASUREMENT
/begin MEASUREMENT main_quad_rev4_25_1030pm_B.Gain23 "" FLOAT64_IEEE main_quad_rev4_25_1030pm_CM_double 0 0 -1.7E+308 1.7E+308 ECU_ADDRESS 0x00220CE8 /end MEASUREMENT
/begin MEASUREMENT main_quad_rev4_25_1030pm_B.Gain26 "" FLOAT64_IEEE main_quad_rev4_25_1030pm_CM_double 0 0 -1.7E+308 1.7E+308 ECU_ADDRESS 0x00220C78 /end MEASUREMENT
/begin MEASUREMENT main_quad_rev4_25_1030pm_B.Gain2_b "" FLOAT64_IEEE main_quad_rev4_25_1030pm_CM_double 0 0 -1.7E+308 1.7E+308 ECU_ADDRESS 0x00220DB0 /end MEASUREMENT
/begin MEASUREMENT main_quad_rev4_25_1030pm_B.Gain2_n "" FLOAT64_IEEE main_quad_rev4_25_1030pm_CM_double 0 0 -1.7E+308 1.7E+308 ECU_ADDRESS 0x00220D10 /end MEASUREMENT
/begin MEASUREMENT main_quad_rev4_25_1030pm_B.Gain3 "" FLOAT64_IEEE main_quad_rev4_25_1030pm_CM_double 0 0 -1.7E+308 1.7E+308 ECU_ADDRESS 0x00220C48 /end MEASUREMENT
/begin MEASUREMENT main_quad_rev4_25_1030pm_B.Gain3_a "" FLOAT64_IEEE main_quad_rev4_25_1030pm_CM_double 0 0 -1.7E+308 1.7E+308 ECU_ADDRESS 0x00220DB8 /end MEASUREMENT
/begin MEASUREMENT main_quad_rev4_25_1030pm_B.Gain3_b "" FLOAT64_IEEE main_quad_rev4_25_1030pm_CM_double 0 0 -1.7E+308 1.7E+308 ECU_ADDRESS 0x00220D18 /end MEASUREMENT
/begin MEASUREMENT main_quad_rev4_25_1030pm_B.Gain4 "" FLOAT64_IEEE main_quad_rev4_25_1030pm_CM_double 0 0 -1.7E+308 1.7E+308 ECU_ADDRESS 0x00220C68 /end MEASUREMENT
/begin MEASUREMENT main_quad_rev4_25_1030pm_B.Gain5 "" FLOAT64_IEEE main_quad_rev4_25_1030pm_CM_double 0 0 -1.7E+308 1.7E+308 ECU_ADDRESS 0x00220C70 /end MEASUREMENT
/begin MEASUREMENT main_quad_rev4_25_1030pm_B.Gain6 "" FLOAT64_IEEE main_quad_rev4_25_1030pm_CM_double 0 0 -1.7E+308 1.7E+308 ECU_ADDRESS 0x00220C50 /end MEASUREMENT
/begin MEASUREMENT main_quad_rev4_25_1030pm_B.Gain7 "" FLOAT64_IEEE main_quad_rev4_25_1030pm_CM_double 0 0 -1.7E+308 1.7E+308 ECU_ADDRESS 0x00220C58 /end MEASUREMENT
/begin MEASUREMENT main_quad_rev4_25_1030pm_B.Gain8 "" FLOAT64_IEEE main_quad_rev4_25_1030pm_CM_double 0 0 -1.7E+308 1.7E+308 ECU_ADDRESS 0x00220C90 /end MEASUREMENT
/begin MEASUREMENT main_quad_rev4_25_1030pm_B.Gain9 "" FLOAT64_IEEE main_quad_rev4_25_1030pm_CM_double 0 0 -1.7E+308 1.7E+308 ECU_ADDRESS 0x00220C60 /end MEASUREMENT
/begin MEASUREMENT main_quad_rev4_25_1030pm_B.Gain_p "" FLOAT64_IEEE main_quad_rev4_25_1030pm_CM_double 0 0 -1.7E+308 1.7E+308 ECU_ADDRESS 0x00220DA0 /end MEASUREMENT
/begin MEASUREMENT main_quad_rev4_25_1030pm_B.Kd1 "" FLOAT64_IEEE main_quad_rev4_25_1030pm_CM_double 0 0 -1.7E+308 1.7E+308 ECU_ADDRESS 0x00220EC8 /end MEASUREMENT
/begin MEASUREMENT main_quad_rev4_25_1030pm_B.Kd2 "" FLOAT64_IEEE main_quad_rev4_25_1030pm_CM_double 0 0 -1.7E+308 1.7E+308 ECU_ADDRESS 0x00220ED0 /end MEASUREMENT
/begin MEASUREMENT main_quad_rev4_25_1030pm_B.Kp1 "" FLOAT64_IEEE main_quad_rev4_25_1030pm_CM_double 0 0 -1.7E+308 1.7E+308 ECU_ADDRESS 0x00220EB8 /end MEASUREMENT
/begin MEASUREMENT main_quad_rev4_25_1030pm_B.Kp2 "" FLOAT64_IEEE main_quad_rev4_25_1030pm_CM_double 0 0 -1.7E+308 1.7E+308 ECU_ADDRESS 0x00220EC0 /end MEASUREMENT
/begin MEASUREMENT main_quad_rev4_25_1030pm_B.MultiportSwitch "" UBYTE main_quad_rev4_25_1030pm_CM_uint8 0 0 0 255 LAYOUT COLUMN_DIR MATRIX_DIM 8 ECU_ADDRESS 0x00220F18 /end MEASUREMENT
/begin MEASUREMENT main_quad_rev4_25_1030pm_B.MultiportSwitch_a "" UBYTE main_quad_rev4_25_1030pm_CM_uint8 0 0 0 255 LAYOUT COLUMN_DIR MATRIX_DIM 8 ECU_ADDRESS 0x00220F28 /end MEASUREMENT
/begin MEASUREMENT main_quad_rev4_25_1030pm_B.MultiportSwitch_c "" UBYTE main_quad_rev4_25_1030pm_CM_uint8 0 0 0 255 LAYOUT COLUMN_DIR MATRIX_DIM 8 ECU_ADDRESS 0x00220F48 /end MEASUREMENT
/begin MEASUREMENT main_quad_rev4_25_1030pm_B.MultiportSwitch_ce "" UBYTE main_quad_rev4_25_1030pm_CM_uint8 0 0 0 255 LAYOUT COLUMN_DIR MATRIX_DIM 8 ECU_ADDRESS 0x00220F58 /end MEASUREMENT
/begin MEASUREMENT main_quad_rev4_25_1030pm_B.MultiportSwitch_f "" UBYTE main_quad_rev4_25_1030pm_CM_uint8 0 0 0 255 LAYOUT COLUMN_DIR MATRIX_DIM 8 ECU_ADDRESS 0x00220F88 /end MEASUREMENT
/begin MEASUREMENT main_quad_rev4_25_1030pm_B.MultiportSwitch_i "" UBYTE main_quad_rev4_25_1030pm_CM_uint8 0 0 0 255 LAYOUT COLUMN_DIR MATRIX_DIM 8 ECU_ADDRESS 0x00220F68 /end MEASUREMENT
/begin MEASUREMENT main_quad_rev4_25_1030pm_B.MultiportSwitch_p "" UBYTE main_quad_rev4_25_1030pm_CM_uint8 0 0 0 255 LAYOUT COLUMN_DIR MATRIX_DIM 8 ECU_ADDRESS 0x00220F38 /end MEASUREMENT
/begin MEASUREMENT main_quad_rev4_25_1030pm_B.MultiportSwitch_p2 "" UBYTE main_quad_rev4_25_1030pm_CM_uint8 0 0 0 255 LAYOUT COLUMN_DIR MATRIX_DIM 8 ECU_ADDRESS 0x00220F78 /end MEASUREMENT
/begin MEASUREMENT main_quad_rev4_25_1030pm_B.P1 "" FLOAT64_IEEE main_quad_rev4_25_1030pm_CM_double 0 0 -1.7E+308 1.7E+308 ECU_ADDRESS 0x00220C08 /end MEASUREMENT
/begin MEASUREMENT main_quad_rev4_25_1030pm_B.P2 "" FLOAT64_IEEE main_quad_rev4_25_1030pm_CM_double 0 0 -1.7E+308 1.7E+308 ECU_ADDRESS 0x00220C10 /end MEASUREMENT
/begin MEASUREMENT main_quad_rev4_25_1030pm_B.P3 "" FLOAT64_IEEE main_quad_rev4_25_1030pm_CM_double 0 0 -1.7E+308 1.7E+308 ECU_ADDRESS 0x00220BF0 /end MEASUREMENT
/begin MEASUREMENT main_quad_rev4_25_1030pm_B.P4 "" FLOAT64_IEEE main_quad_rev4_25_1030pm_CM_double 0 0 -1.7E+308 1.7E+308 ECU_ADDRESS 0x00220BF8 /end MEASUREMENT
/begin MEASUREMENT main_quad_rev4_25_1030pm_B.P5 "" FLOAT64_IEEE main_quad_rev4_25_1030pm_CM_double 0 0 -1.7E+308 1.7E+308 ECU_ADDRESS 0x00220C30 /end MEASUREMENT
/begin MEASUREMENT main_quad_rev4_25_1030pm_B.P6 "" FLOAT64_IEEE main_quad_rev4_25_1030pm_CM_double 0 0 -1.7E+308 1.7E+308 ECU_ADDRESS 0x00220C20 /end MEASUREMENT
/begin MEASUREMENT main_quad_rev4_25_1030pm_B.P7 "" FLOAT64_IEEE main_quad_rev4_25_1030pm_CM_double 0 0 -1.7E+308 1.7E+308 ECU_ADDRESS 0x00220C28 /end MEASUREMENT
/begin MEASUREMENT main_quad_rev4_25_1030pm_B.P8 "" FLOAT64_IEEE main_quad_rev4_25_1030pm_CM_double 0 0 -1.7E+308 1.7E+308 ECU_ADDRESS 0x00220C18 /end MEASUREMENT
/begin MEASUREMENT main_quad_rev4_25_1030pm_B.T1 "" FLOAT64_IEEE main_quad_rev4_25_1030pm_CM_double 0 0 -1.7E+308 1.7E+308 ECU_ADDRESS 0x00220EA8 /end MEASUREMENT
/begin MEASUREMENT main_quad_rev4_25_1030pm_B.T2 "" FLOAT64_IEEE main_quad_rev4_25_1030pm_CM_double 0 0 -1.7E+308 1.7E+308 ECU_ADDRESS 0x00220EB0 /end MEASUREMENT
/begin MEASUREMENT main_quad_rev4_25_1030pm_B.TmpSignalConversionAtSFunctionI "" FLOAT64_IEEE main_quad_rev4_25_1030pm_CM_double 0 0 -1.7E+308 1.7E+308 LAYOUT COLUMN_DIR MATRIX_DIM 8 ECU_ADDRESS 0x00220E40 /end MEASUREMENT
/begin MEASUREMENT main_quad_rev4_25_1030pm_B.WhileIterator "" SLONG main_quad_rev4_25_1030pm_CM_int32 0 0 -2147483648 2147483647 ECU_ADDRESS 0x00220F08 /end MEASUREMENT
/begin MEASUREMENT main_quad_rev4_25_1030pm_B.WhileIterator_m "" SLONG main_quad_rev4_25_1030pm_CM_int32 0 0 -2147483648 2147483647 ECU_ADDRESS 0x00220F0C /end MEASUREMENT
/begin MEASUREMENT main_quad_rev4_25_1030pm_B.c "" FLOAT64_IEEE main_quad_rev4_25_1030pm_CM_double 0 0 -1.7E+308 1.7E+308 ECU_ADDRESS 0x00220EA0 /end MEASUREMENT
/begin MEASUREMENT main_quad_rev4_25_1030pm_B.danger "" FLOAT64_IEEE main_quad_rev4_25_1030pm_CM_double 0 0 -1.7E+308 1.7E+308 ECU_ADDRESS 0x00220E80 /end MEASUREMENT
/begin MEASUREMENT main_quad_rev4_25_1030pm_B.sf_bytesfloats.I_ff "" FLOAT64_IEEE main_quad_rev4_25_1030pm_CM_double 0 0 -1.7E+308 1.7E+308 ECU_ADDRESS 0x00221058 /end MEASUREMENT
/begin MEASUREMENT main_quad_rev4_25_1030pm_B.sf_bytesfloats.position "" FLOAT64_IEEE main_quad_rev4_25_1030pm_CM_double 0 0 -1.7E+308 1.7E+308 ECU_ADDRESS 0x00221048 /end MEASUREMENT
/begin MEASUREMENT main_quad_rev4_25_1030pm_B.sf_bytesfloats.velocity "" FLOAT64_IEEE main_quad_rev4_25_1030pm_CM_double 0 0 -1.7E+308 1.7E+308 ECU_ADDRESS 0x00221050 /end MEASUREMENT
/begin MEASUREMENT main_quad_rev4_25_1030pm_B.sf_bytesfloats_a.I_ff "" FLOAT64_IEEE main_quad_rev4_25_1030pm_CM_double 0 0 -1.7E+308 1.7E+308 ECU_ADDRESS 0x00220FF8 /end MEASUREMENT
/begin MEASUREMENT main_quad_rev4_25_1030pm_B.sf_bytesfloats_a.position "" FLOAT64_IEEE main_quad_rev4_25_1030pm_CM_double 0 0 -1.7E+308 1.7E+308 ECU_ADDRESS 0x00220FE8 /end MEASUREMENT
/begin MEASUREMENT main_quad_rev4_25_1030pm_B.sf_bytesfloats_a.velocity "" FLOAT64_IEEE main_quad_rev4_25_1030pm_CM_double 0 0 -1.7E+308 1.7E+308 ECU_ADDRESS 0x00220FF0 /end MEASUREMENT
/begin MEASUREMENT main_quad_rev4_25_1030pm_B.sf_bytesfloats_b.I_ff "" FLOAT64_IEEE main_quad_rev4_25_1030pm_CM_double 0 0 -1.7E+308 1.7E+308 ECU_ADDRESS 0x00220FE0 /end MEASUREMENT
/begin MEASUREMENT main_quad_rev4_25_1030pm_B.sf_bytesfloats_b.position "" FLOAT64_IEEE main_quad_rev4_25_1030pm_CM_double 0 0 -1.7E+308 1.7E+308 ECU_ADDRESS 0x00220FD0 /end MEASUREMENT
/begin MEASUREMENT main_quad_rev4_25_1030pm_B.sf_bytesfloats_b.velocity "" FLOAT64_IEEE main_quad_rev4_25_1030pm_CM_double 0 0 -1.7E+308 1.7E+308 ECU_ADDRESS 0x00220FD8 /end MEASUREMENT
/begin MEASUREMENT main_quad_rev4_25_1030pm_B.sf_bytesfloats_c.I_ff "" FLOAT64_IEEE main_quad_rev4_25_1030pm_CM_double 0 0 -1.7E+308 1.7E+308 ECU_ADDRESS 0x00221040 /end MEASUREMENT
/begin MEASUREMENT main_quad_rev4_25_1030pm_B.sf_bytesfloats_c.position "" FLOAT64_IEEE main_quad_rev4_25_1030pm_CM_double 0 0 -1.7E+308 1.7E+308 ECU_ADDRESS 0x00221030 /end MEASUREMENT
/begin MEASUREMENT main_quad_rev4_25_1030pm_B.sf_bytesfloats_c.velocity "" FLOAT64_IEEE main_quad_rev4_25_1030pm_CM_double 0 0 -1.7E+308 1.7E+308 ECU_ADDRESS 0x00221038 /end MEASUREMENT
/begin MEASUREMENT main_quad_rev4_25_1030pm_B.sf_bytesfloats_cd.I_ff "" FLOAT64_IEEE main_quad_rev4_25_1030pm_CM_double 0 0 -1.7E+308 1.7E+308 ECU_ADDRESS 0x00220FC8 /end MEASUREMENT
/begin MEASUREMENT main_quad_rev4_25_1030pm_B.sf_bytesfloats_cd.position "" FLOAT64_IEEE main_quad_rev4_25_1030pm_CM_double 0 0 -1.7E+308 1.7E+308 ECU_ADDRESS 0x00220FB8 /end MEASUREMENT
/begin MEASUREMENT main_quad_rev4_25_1030pm_B.sf_bytesfloats_cd.velocity "" FLOAT64_IEEE main_quad_rev4_25_1030pm_CM_double 0 0 -1.7E+308 1.7E+308 ECU_ADDRESS 0x00220FC0 /end MEASUREMENT
/begin MEASUREMENT main_quad_rev4_25_1030pm_B.sf_bytesfloats_f.I_ff "" FLOAT64_IEEE main_quad_rev4_25_1030pm_CM_double 0 0 -1.7E+308 1.7E+308 ECU_ADDRESS 0x00220FB0 /end MEASUREMENT
/begin MEASUREMENT main_quad_rev4_25_1030pm_B.sf_bytesfloats_f.position "" FLOAT64_IEEE main_quad_rev4_25_1030pm_CM_double 0 0 -1.7E+308 1.7E+308 ECU_ADDRESS 0x00220FA0 /end MEASUREMENT
/begin MEASUREMENT main_quad_rev4_25_1030pm_B.sf_bytesfloats_f.velocity "" FLOAT64_IEEE main_quad_rev4_25_1030pm_CM_double 0 0 -1.7E+308 1.7E+308 ECU_ADDRESS 0x00220FA8 /end MEASUREMENT
/begin MEASUREMENT main_quad_rev4_25_1030pm_B.sf_bytesfloats_j.I_ff "" FLOAT64_IEEE main_quad_rev4_25_1030pm_CM_double 0 0 -1.7E+308 1.7E+308 ECU_ADDRESS 0x00221010 /end MEASUREMENT
/begin MEASUREMENT main_quad_rev4_25_1030pm_B.sf_bytesfloats_j.position "" FLOAT64_IEEE main_quad_rev4_25_1030pm_CM_double 0 0 -1.7E+308 1.7E+308 ECU_ADDRESS 0x00221000 /end MEASUREMENT
/begin MEASUREMENT main_quad_rev4_25_1030pm_B.sf_bytesfloats_j.velocity "" FLOAT64_IEEE main_quad_rev4_25_1030pm_CM_double 0 0 -1.7E+308 1.7E+308 ECU_ADDRESS 0x00221008 /end MEASUREMENT
/begin MEASUREMENT main_quad_rev4_25_1030pm_B.sf_bytesfloats_l.I_ff "" FLOAT64_IEEE main_quad_rev4_25_1030pm_CM_double 0 0 -1.7E+308 1.7E+308 ECU_ADDRESS 0x00221028 /end MEASUREMENT
/begin MEASUREMENT main_quad_rev4_25_1030pm_B.sf_bytesfloats_l.position "" FLOAT64_IEEE main_quad_rev4_25_1030pm_CM_double 0 0 -1.7E+308 1.7E+308 ECU_ADDRESS 0x00221018 /end MEASUREMENT
/begin MEASUREMENT main_quad_rev4_25_1030pm_B.sf_bytesfloats_l.velocity "" FLOAT64_IEEE main_quad_rev4_25_1030pm_CM_double 0 0 -1.7E+308 1.7E+308 ECU_ADDRESS 0x00221020 /end MEASUREMENT
/begin MEASUREMENT main_quad_rev4_25_1030pm_B.sf_floatsbytes.b "" UBYTE main_quad_rev4_25_1030pm_CM_uint8 0 0 0 255 LAYOUT COLUMN_DIR MATRIX_DIM 8 ECU_ADDRESS 0x00221098 /end MEASUREMENT
/begin MEASUREMENT main_quad_rev4_25_1030pm_B.sf_floatsbytes_b.b "" UBYTE main_quad_rev4_25_1030pm_CM_uint8 0 0 0 255 LAYOUT COLUMN_DIR MATRIX_DIM 8 ECU_ADDRESS 0x00221090 /end MEASUREMENT
/begin MEASUREMENT main_quad_rev4_25_1030pm_B.sf_floatsbytes_bb.b "" UBYTE main_quad_rev4_25_1030pm_CM_uint8 0 0 0 255 LAYOUT COLUMN_DIR MATRIX_DIM 8 ECU_ADDRESS 0x00221070 /end MEASUREMENT
/begin MEASUREMENT main_quad_rev4_25_1030pm_B.sf_floatsbytes_i.b "" UBYTE main_quad_rev4_25_1030pm_CM_uint8 0 0 0 255 LAYOUT COLUMN_DIR MATRIX_DIM 8 ECU_ADDRESS 0x00221080 /end MEASUREMENT
/begin MEASUREMENT main_quad_rev4_25_1030pm_B.sf_floatsbytes_if.b "" UBYTE main_quad_rev4_25_1030pm_CM_uint8 0 0 0 255 LAYOUT COLUMN_DIR MATRIX_DIM 8 ECU_ADDRESS 0x00221078 /end MEASUREMENT
/begin MEASUREMENT main_quad_rev4_25_1030pm_B.sf_floatsbytes_k.b "" UBYTE main_quad_rev4_25_1030pm_CM_uint8 0 0 0 255 LAYOUT COLUMN_DIR MATRIX_DIM 8 ECU_ADDRESS 0x00221068 /end MEASUREMENT
/begin MEASUREMENT main_quad_rev4_25_1030pm_B.sf_floatsbytes_kd.b "" UBYTE main_quad_rev4_25_1030pm_CM_uint8 0 0 0 255 LAYOUT COLUMN_DIR MATRIX_DIM 8 ECU_ADDRESS 0x00221060 /end MEASUREMENT
/begin MEASUREMENT main_quad_rev4_25_1030pm_B.sf_floatsbytes_o.b "" UBYTE main_quad_rev4_25_1030pm_CM_uint8 0 0 0 255 LAYOUT COLUMN_DIR MATRIX_DIM 8 ECU_ADDRESS 0x00221088 /end MEASUREMENT
/begin MEASUREMENT main_quad_rev4_25_1030pm_B.stop "" FLOAT64_IEEE main_quad_rev4_25_1030pm_CM_double 0 0 -1.7E+308 1.7E+308 ECU_ADDRESS 0x00220E88 /end MEASUREMENT
/begin MEASUREMENT main_quad_rev4_25_1030pm_B.theta1 "" FLOAT64_IEEE main_quad_rev4_25_1030pm_CM_double 0 0 -1.7E+308 1.7E+308 ECU_ADDRESS 0x00220E90 /end MEASUREMENT
/begin MEASUREMENT main_quad_rev4_25_1030pm_B.theta1b "" FLOAT64_IEEE main_quad_rev4_25_1030pm_CM_double 0 0 -1.7E+308 1.7E+308 ECU_ADDRESS 0x00220F00 /end MEASUREMENT
/begin MEASUREMENT main_quad_rev4_25_1030pm_B.theta1r "" FLOAT64_IEEE main_quad_rev4_25_1030pm_CM_double 0 0 -1.7E+308 1.7E+308 ECU_ADDRESS 0x00220ED8 /end MEASUREMENT
/begin MEASUREMENT main_quad_rev4_25_1030pm_B.theta1rb "" FLOAT64_IEEE main_quad_rev4_25_1030pm_CM_double 0 0 -1.7E+308 1.7E+308 ECU_ADDRESS 0x00220EF8 /end MEASUREMENT
/begin MEASUREMENT main_quad_rev4_25_1030pm_B.theta2 "" FLOAT64_IEEE main_quad_rev4_25_1030pm_CM_double 0 0 -1.7E+308 1.7E+308 ECU_ADDRESS 0x00220E98 /end MEASUREMENT
/begin MEASUREMENT main_quad_rev4_25_1030pm_B.theta2b "" FLOAT64_IEEE main_quad_rev4_25_1030pm_CM_double 0 0 -1.7E+308 1.7E+308 ECU_ADDRESS 0x00220EF0 /end MEASUREMENT
/begin MEASUREMENT main_quad_rev4_25_1030pm_B.theta2r "" FLOAT64_IEEE main_quad_rev4_25_1030pm_CM_double 0 0 -1.7E+308 1.7E+308 ECU_ADDRESS 0x00220EE0 /end MEASUREMENT
/begin MEASUREMENT main_quad_rev4_25_1030pm_B.theta2rb "" FLOAT64_IEEE main_quad_rev4_25_1030pm_CM_double 0 0 -1.7E+308 1.7E+308 ECU_ADDRESS 0x00220EE8 /end MEASUREMENT
/begin MEASUREMENT main_quad_rev4_25_1030pm_DW.CANUnpack_ModeSignalID "" SLONG main_quad_rev4_25_1030pm_CM_int_T 0 0 -2147483648 2147483647 ECU_ADDRESS 0x00220A78 /end MEASUREMENT
/begin MEASUREMENT main_quad_rev4_25_1030pm_DW.CANUnpack_ModeSignalID_a "" SLONG main_quad_rev4_25_1030pm_CM_int_T 0 0 -2147483648 2147483647 ECU_ADDRESS 0x00220AA0 /end MEASUREMENT
/begin MEASUREMENT main_quad_rev4_25_1030pm_DW.CANUnpack_ModeSignalID_d "" SLONG main_quad_rev4_25_1030pm_CM_int_T 0 0 -2147483648 2147483647 ECU_ADDRESS 0x00220A98 /end MEASUREMENT
/begin MEASUREMENT main_quad_rev4_25_1030pm_DW.CANUnpack_ModeSignalID_j "" SLONG main_quad_rev4_25_1030pm_CM_int_T 0 0 -2147483648 2147483647 ECU_ADDRESS 0x00220A80 /end MEASUREMENT
/begin MEASUREMENT main_quad_rev4_25_1030pm_DW.CANUnpack_ModeSignalID_jt "" SLONG main_quad_rev4_25_1030pm_CM_int_T 0 0 -2147483648 2147483647 ECU_ADDRESS 0x00220AA8 /end MEASUREMENT
/begin MEASUREMENT main_quad_rev4_25_1030pm_DW.CANUnpack_ModeSignalID_m "" SLONG main_quad_rev4_25_1030pm_CM_int_T 0 0 -2147483648 2147483647 ECU_ADDRESS 0x00220A88 /end MEASUREMENT
/begin MEASUREMENT main_quad_rev4_25_1030pm_DW.CANUnpack_ModeSignalID_o "" SLONG main_quad_rev4_25_1030pm_CM_int_T 0 0 -2147483648 2147483647 ECU_ADDRESS 0x00220A90 /end MEASUREMENT
/begin MEASUREMENT main_quad_rev4_25_1030pm_DW.CANUnpack_ModeSignalID_or "" SLONG main_quad_rev4_25_1030pm_CM_int_T 0 0 -2147483648 2147483647 ECU_ADDRESS 0x00220AB0 /end MEASUREMENT
/begin MEASUREMENT main_quad_rev4_25_1030pm_DW.CANUnpack_StatusPortID "" SLONG main_quad_rev4_25_1030pm_CM_int_T 0 0 -2147483648 2147483647 ECU_ADDRESS 0x00220A7C /end MEASUREMENT
/begin MEASUREMENT main_quad_rev4_25_1030pm_DW.CANUnpack_StatusPortID_e "" SLONG main_quad_rev4_25_1030pm_CM_int_T 0 0 -2147483648 2147483647 ECU_ADDRESS 0x00220AB4 /end MEASUREMENT
/begin MEASUREMENT main_quad_rev4_25_1030pm_DW.CANUnpack_StatusPortID_i "" SLONG main_quad_rev4_25_1030pm_CM_int_T 0 0 -2147483648 2147483647 ECU_ADDRESS 0x00220AA4 /end MEASUREMENT
/begin MEASUREMENT main_quad_rev4_25_1030pm_DW.CANUnpack_StatusPortID_j "" SLONG main_quad_rev4_25_1030pm_CM_int_T 0 0 -2147483648 2147483647 ECU_ADDRESS 0x00220A94 /end MEASUREMENT
/begin MEASUREMENT main_quad_rev4_25_1030pm_DW.CANUnpack_StatusPortID_l "" SLONG main_quad_rev4_25_1030pm_CM_int_T 0 0 -2147483648 2147483647 ECU_ADDRESS 0x00220A8C /end MEASUREMENT
/begin MEASUREMENT main_quad_rev4_25_1030pm_DW.CANUnpack_StatusPortID_o "" SLONG main_quad_rev4_25_1030pm_CM_int_T 0 0 -2147483648 2147483647 ECU_ADDRESS 0x00220A9C /end MEASUREMENT
/begin MEASUREMENT main_quad_rev4_25_1030pm_DW.CANUnpack_StatusPortID_o4 "" SLONG main_quad_rev4_25_1030pm_CM_int_T 0 0 -2147483648 2147483647 ECU_ADDRESS 0x00220AAC /end MEASUREMENT
/begin MEASUREMENT main_quad_rev4_25_1030pm_DW.CANUnpack_StatusPortID_p "" SLONG main_quad_rev4_25_1030pm_CM_int_T 0 0 -2147483648 2147483647 ECU_ADDRESS 0x00220A84 /end MEASUREMENT
/begin MEASUREMENT main_quad_rev4_25_1030pm_DW.Delay10_DSTATE "" FLOAT64_IEEE main_quad_rev4_25_1030pm_CM_double 0 0 -1.7E+308 1.7E+308 ECU_ADDRESS 0x002206B0 /end MEASUREMENT
/begin MEASUREMENT main_quad_rev4_25_1030pm_DW.Delay11_DSTATE "" FLOAT64_IEEE main_quad_rev4_25_1030pm_CM_double 0 0 -1.7E+308 1.7E+308 ECU_ADDRESS 0x002206C8 /end MEASUREMENT
/begin MEASUREMENT main_quad_rev4_25_1030pm_DW.Delay4_DSTATE "" FLOAT64_IEEE main_quad_rev4_25_1030pm_CM_double 0 0 -1.7E+308 1.7E+308 ECU_ADDRESS 0x002206D0 /end MEASUREMENT
/begin MEASUREMENT main_quad_rev4_25_1030pm_DW.Delay5_DSTATE "" FLOAT64_IEEE main_quad_rev4_25_1030pm_CM_double 0 0 -1.7E+308 1.7E+308 ECU_ADDRESS 0x002206A8 /end MEASUREMENT
/begin MEASUREMENT main_quad_rev4_25_1030pm_DW.Delay6_DSTATE "" FLOAT64_IEEE main_quad_rev4_25_1030pm_CM_double 0 0 -1.7E+308 1.7E+308 ECU_ADDRESS 0x002206D8 /end MEASUREMENT
/begin MEASUREMENT main_quad_rev4_25_1030pm_DW.Delay7_DSTATE "" FLOAT64_IEEE main_quad_rev4_25_1030pm_CM_double 0 0 -1.7E+308 1.7E+308 ECU_ADDRESS 0x002206B8 /end MEASUREMENT
/begin MEASUREMENT main_quad_rev4_25_1030pm_DW.Delay8_DSTATE "" FLOAT64_IEEE main_quad_rev4_25_1030pm_CM_double 0 0 -1.7E+308 1.7E+308 ECU_ADDRESS 0x002206A0 /end MEASUREMENT
/begin MEASUREMENT main_quad_rev4_25_1030pm_DW.Delay9_DSTATE "" FLOAT64_IEEE main_quad_rev4_25_1030pm_CM_double 0 0 -1.7E+308 1.7E+308 ECU_ADDRESS 0x002206C0 /end MEASUREMENT
/begin MEASUREMENT main_quad_rev4_25_1030pm_DW.Th2Th1 "" FLOAT64_IEEE main_quad_rev4_25_1030pm_CM_double 0 0 -1.7E+308 1.7E+308 ECU_ADDRESS 0x00220720 /end MEASUREMENT
/begin MEASUREMENT main_quad_rev4_25_1030pm_DW.done "" FLOAT64_IEEE main_quad_rev4_25_1030pm_CM_double 0 0 -1.7E+308 1.7E+308 ECU_ADDRESS 0x002206E0 /end MEASUREMENT
/begin MEASUREMENT main_quad_rev4_25_1030pm_DW.is_LeftBack "" ULONG main_quad_rev4_25_1030pm_CM_uint32 0 0 0 2147483646 ECU_ADDRESS 0x002209E8 /end MEASUREMENT
/begin MEASUREMENT main_quad_rev4_25_1030pm_DW.is_LeftFront "" ULONG main_quad_rev4_25_1030pm_CM_uint32 0 0 0 2147483646 ECU_ADDRESS 0x002209E4 /end MEASUREMENT
/begin MEASUREMENT main_quad_rev4_25_1030pm_DW.is_RightBack "" ULONG main_quad_rev4_25_1030pm_CM_uint32 0 0 0 2147483646 ECU_ADDRESS 0x002209EC /end MEASUREMENT
/begin MEASUREMENT main_quad_rev4_25_1030pm_DW.is_RightFront "" ULONG main_quad_rev4_25_1030pm_CM_uint32 0 0 0 2147483646 ECU_ADDRESS 0x002209E0 /end MEASUREMENT
/begin MEASUREMENT main_quad_rev4_25_1030pm_DW.is_active_LeftBack "" UBYTE main_quad_rev4_25_1030pm_CM_uint8 0 0 0 255 ECU_ADDRESS 0x00220AFD /end MEASUREMENT
/begin MEASUREMENT main_quad_rev4_25_1030pm_DW.is_active_LeftFront "" UBYTE main_quad_rev4_25_1030pm_CM_uint8 0 0 0 255 ECU_ADDRESS 0x00220AFC /end MEASUREMENT
/begin MEASUREMENT main_quad_rev4_25_1030pm_DW.is_active_RightBack "" UBYTE main_quad_rev4_25_1030pm_CM_uint8 0 0 0 255 ECU_ADDRESS 0x00220AFE /end MEASUREMENT
/begin MEASUREMENT main_quad_rev4_25_1030pm_DW.is_active_RightFront "" UBYTE main_quad_rev4_25_1030pm_CM_uint8 0 0 0 255 ECU_ADDRESS 0x00220AFB /end MEASUREMENT
/begin MEASUREMENT main_quad_rev4_25_1030pm_DW.is_active_c8_main_quad_rev4_25_ "" UBYTE main_quad_rev4_25_1030pm_CM_uint8 0 0 0 255 ECU_ADDRESS 0x00220AFA /end MEASUREMENT
/begin MEASUREMENT main_quad_rev4_25_1030pm_DW.is_c8_main_quad_rev4_25_1030pm "" ULONG main_quad_rev4_25_1030pm_CM_uint32 0 0 0 2147483646 ECU_ADDRESS 0x002209DC /end MEASUREMENT
/begin MEASUREMENT main_quad_rev4_25_1030pm_DW.pf "" FLOAT64_IEEE main_quad_rev4_25_1030pm_CM_double 0 0 -1.7E+308 1.7E+308 ECU_ADDRESS 0x002206E8 /end MEASUREMENT
/begin MEASUREMENT main_quad_rev4_25_1030pm_DW.pfb "" FLOAT64_IEEE main_quad_rev4_25_1030pm_CM_double 0 0 -1.7E+308 1.7E+308 ECU_ADDRESS 0x00220750 /end MEASUREMENT
/begin MEASUREMENT main_quad_rev4_25_1030pm_DW.pfr "" FLOAT64_IEEE main_quad_rev4_25_1030pm_CM_double 0 0 -1.7E+308 1.7E+308 ECU_ADDRESS 0x00220728 /end MEASUREMENT
/begin MEASUREMENT main_quad_rev4_25_1030pm_DW.pfrb "" FLOAT64_IEEE main_quad_rev4_25_1030pm_CM_double 0 0 -1.7E+308 1.7E+308 ECU_ADDRESS 0x00220760 /end MEASUREMENT
/begin MEASUREMENT main_quad_rev4_25_1030pm_DW.po1 "" FLOAT64_IEEE main_quad_rev4_25_1030pm_CM_double 0 0 -1.7E+308 1.7E+308 ECU_ADDRESS 0x00220700 /end MEASUREMENT
/begin MEASUREMENT main_quad_rev4_25_1030pm_DW.po1b "" FLOAT64_IEEE main_quad_rev4_25_1030pm_CM_double 0 0 -1.7E+308 1.7E+308 ECU_ADDRESS 0x00220768 /end MEASUREMENT
/begin MEASUREMENT main_quad_rev4_25_1030pm_DW.po1r "" FLOAT64_IEEE main_quad_rev4_25_1030pm_CM_double 0 0 -1.7E+308 1.7E+308 ECU_ADDRESS 0x00220730 /end MEASUREMENT
/begin MEASUREMENT main_quad_rev4_25_1030pm_DW.po1rb "" FLOAT64_IEEE main_quad_rev4_25_1030pm_CM_double 0 0 -1.7E+308 1.7E+308 ECU_ADDRESS 0x00220770 /end MEASUREMENT
/begin MEASUREMENT main_quad_rev4_25_1030pm_DW.po2 "" FLOAT64_IEEE main_quad_rev4_25_1030pm_CM_double 0 0 -1.7E+308 1.7E+308 ECU_ADDRESS 0x00220708 /end MEASUREMENT
/begin MEASUREMENT main_quad_rev4_25_1030pm_DW.po2b "" FLOAT64_IEEE main_quad_rev4_25_1030pm_CM_double 0 0 -1.7E+308 1.7E+308 ECU_ADDRESS 0x00220778 /end MEASUREMENT
/begin MEASUREMENT main_quad_rev4_25_1030pm_DW.po2r "" FLOAT64_IEEE main_quad_rev4_25_1030pm_CM_double 0 0 -1.7E+308 1.7E+308 ECU_ADDRESS 0x00220738 /end MEASUREMENT
/begin MEASUREMENT main_quad_rev4_25_1030pm_DW.po2rb "" FLOAT64_IEEE main_quad_rev4_25_1030pm_CM_double 0 0 -1.7E+308 1.7E+308 ECU_ADDRESS 0x00220780 /end MEASUREMENT
/begin MEASUREMENT main_quad_rev4_25_1030pm_DW.sfEvent "" SLONG main_quad_rev4_25_1030pm_CM_int32 0 0 -2147483648 2147483647 ECU_ADDRESS 0x002209D8 /end MEASUREMENT
/begin MEASUREMENT main_quad_rev4_25_1030pm_DW.slope1 "" FLOAT64_IEEE main_quad_rev4_25_1030pm_CM_double 0 0 -1.7E+308 1.7E+308 ECU_ADDRESS 0x00220710 /end MEASUREMENT
/begin MEASUREMENT main_quad_rev4_25_1030pm_DW.slope1b "" FLOAT64_IEEE main_quad_rev4_25_1030pm_CM_double 0 0 -1.7E+308 1.7E+308 ECU_ADDRESS 0x00220788 /end MEASUREMENT
/begin MEASUREMENT main_quad_rev4_25_1030pm_DW.slope1r "" FLOAT64_IEEE main_quad_rev4_25_1030pm_CM_double 0 0 -1.7E+308 1.7E+308 ECU_ADDRESS 0x00220740 /end MEASUREMENT
/begin MEASUREMENT main_quad_rev4_25_1030pm_DW.slope1rb "" FLOAT64_IEEE main_quad_rev4_25_1030pm_CM_double 0 0 -1.7E+308 1.7E+308 ECU_ADDRESS 0x00220790 /end MEASUREMENT
/begin MEASUREMENT main_quad_rev4_25_1030pm_DW.slope2 "" FLOAT64_IEEE main_quad_rev4_25_1030pm_CM_double 0 0 -1.7E+308 1.7E+308 ECU_ADDRESS 0x00220718 /end MEASUREMENT
/begin MEASUREMENT main_quad_rev4_25_1030pm_DW.slope2b "" FLOAT64_IEEE main_quad_rev4_25_1030pm_CM_double 0 0 -1.7E+308 1.7E+308 ECU_ADDRESS 0x00220798 /end MEASUREMENT
/begin MEASUREMENT main_quad_rev4_25_1030pm_DW.slope2r "" FLOAT64_IEEE main_quad_rev4_25_1030pm_CM_double 0 0 -1.7E+308 1.7E+308 ECU_ADDRESS 0x00220748 /end MEASUREMENT
/begin MEASUREMENT main_quad_rev4_25_1030pm_DW.slope2rb "" FLOAT64_IEEE main_quad_rev4_25_1030pm_CM_double 0 0 -1.7E+308 1.7E+308 ECU_ADDRESS 0x002207A0 /end MEASUREMENT
/begin MEASUREMENT main_quad_rev4_25_1030pm_DW.temporalCounter_i1 "" UWORD main_quad_rev4_25_1030pm_CM_uint16 0 0 0 65535 ECU_ADDRESS 0x00220AF8 /end MEASUREMENT
/begin MEASUREMENT main_quad_rev4_25_1030pm_DW.to "" FLOAT64_IEEE main_quad_rev4_25_1030pm_CM_double 0 0 -1.7E+308 1.7E+308 ECU_ADDRESS 0x002206F8 /end MEASUREMENT
/begin MEASUREMENT main_quad_rev4_25_1030pm_DW.tob "" FLOAT64_IEEE main_quad_rev4_25_1030pm_CM_double 0 0 -1.7E+308 1.7E+308 ECU_ADDRESS 0x002207A8 /end MEASUREMENT
/begin MEASUREMENT main_quad_rev4_25_1030pm_DW.tor "" FLOAT64_IEEE main_quad_rev4_25_1030pm_CM_double 0 0 -1.7E+308 1.7E+308 ECU_ADDRESS 0x002207B0 /end MEASUREMENT
/begin MEASUREMENT main_quad_rev4_25_1030pm_DW.torb "" FLOAT64_IEEE main_quad_rev4_25_1030pm_CM_double 0 0 -1.7E+308 1.7E+308 ECU_ADDRESS 0x002207B8 /end MEASUREMENT
/begin MEASUREMENT main_quad_rev4_25_1030pm_DW.tstep "" FLOAT64_IEEE main_quad_rev4_25_1030pm_CM_double 0 0 -1.7E+308 1.7E+308 ECU_ADDRESS 0x002206F0 /end MEASUREMENT
/begin MEASUREMENT main_quad_rev4_25_1030pm_DW.wasReady "" FLOAT64_IEEE main_quad_rev4_25_1030pm_CM_double 0 0 -1.7E+308 1.7E+308 ECU_ADDRESS 0x00220758 /end MEASUREMENT
/begin COMPU_METHOD main_quad_rev4_25_1030pm_CM_double "" IDENTICAL "%15.10" "" /end COMPU_METHOD
/begin COMPU_METHOD main_quad_rev4_25_1030pm_CM_int32 "" IDENTICAL "%10.0" "" /end COMPU_METHOD
/begin COMPU_METHOD main_quad_rev4_25_1030pm_CM_int_T "" IDENTICAL "customformat" "" /end COMPU_METHOD
/begin COMPU_METHOD main_quad_rev4_25_1030pm_CM_logical "" IDENTICAL "%1.0" "" /end COMPU_METHOD
/begin COMPU_METHOD main_quad_rev4_25_1030pm_CM_uint16 "" IDENTICAL "%5.0" "" /end COMPU_METHOD
/begin COMPU_METHOD main_quad_rev4_25_1030pm_CM_uint32 "" IDENTICAL "%10.0" "" /end COMPU_METHOD
/begin COMPU_METHOD main_quad_rev4_25_1030pm_CM_uint8 "" IDENTICAL "%3.0" "" /end COMPU_METHOD
/begin RECORD_LAYOUT Scalar_BOOLEAN FNC_VALUES 1 UBYTE COLUMN_DIR DIRECT /end RECORD_LAYOUT
/begin RECORD_LAYOUT Scalar_FLOAT64_IEEE FNC_VALUES 1 FLOAT64_IEEE COLUMN_DIR DIRECT /end RECORD_LAYOUT
/begin RECORD_LAYOUT Scalar_SLONG FNC_VALUES 1 SLONG COLUMN_DIR DIRECT /end RECORD_LAYOUT
/begin RECORD_LAYOUT Scalar_UBYTE FNC_VALUES 1 UBYTE COLUMN_DIR DIRECT /end RECORD_LAYOUT
/begin RECORD_LAYOUT Scalar_ULONG FNC_VALUES 1 ULONG COLUMN_DIR DIRECT /end RECORD_LAYOUT
/begin RECORD_LAYOUT Scalar_UWORD FNC_VALUES 1 UWORD COLUMN_DIR DIRECT /end RECORD_LAYOUT
/begin GROUP main_quad_rev4_25_1030pm "main_quad_rev4_25_1030pm" ROOT /end GROUP
/end MODULE
/end PROJECT
